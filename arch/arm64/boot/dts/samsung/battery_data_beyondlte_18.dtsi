/*
 * SAMSUNG UNIVERSAL9820 board device tree source
 *
 * Copyright (c) 2018 Samsung Electronics Co., Ltd.
 *		http://www.samsung.com
 *
 * This program is free software; you can redistribute it and/or modify
 * it under the terms of the GNU General Public License version 2 as
 * published by the Free Software Foundation.
 */

#include "battery_data_beyondlte_common.dtsi"

/ {
	fragment@battery {
		target-path = "/";
		__overlay__ {
			battery {
				battery,wpc_en = <&expander_gpios 8 0>;
			};
		}; /* end of __overlay__ */
	}; /* end of fragment */
};

