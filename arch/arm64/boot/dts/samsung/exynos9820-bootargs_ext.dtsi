/*
 * SAMSUNG bootargs_ext device tree source
 *
 * Copyright (c) 2018 Samsung Electronics Co., Ltd.
 *             http://www.samsung.com
 *
 * This program is free software; you can redistribute it and/or modify
 * it under the terms of the GNU General Public License version 2 as
 * published by the Free Software Foundation.
 */

#include <generated/autoconf.h>

/ {
	fragment@model {
		target-path = "/";
		__overlay__ {
			#address-cells = <2>;
			#size-cells = <1>;

		}; /* end of __overlay__ */
	}; /* end of fragment */
}; /* end of root */

&chosen {
#ifndef CONFIG_ANDROID_SYSTEM_AS_ROOT
	bootargs_ext = "root=/dev/ram0";
#else
	bootargs_ext = "skip_initramfs rootwait ro init=/init";
#endif
};

#ifdef CONFIG_ANDROID_SYSTEM_AS_ROOT
/*
&android {
	vbmeta {
		compatible = "android,vbmeta";
		parts = "vbmeta,boot,system,vendor";
	};
};
&system {
	fsmgr_flags = "wait,avb";
	status = "disabled";
};
&vendor {
	fsmgr_flags = "wait,avb";
	status = "okay";
};
*/
#endif

