/*
 * SAMSUNG EXYNOS9820 board device tree source
 *
 * Copyright (c) 2018 Samsung Electronics Co., Ltd.
 *		http://www.samsung.com
 *
 * This program is free software; you can redistribute it and/or modify
 * it under the terms of the GNU General Public License version 2 as
 * published by the Free Software Foundation.
*/

&hsi2c_43 {
	status = "okay";
	cs40l25@40 {
		compatible = "cirrus,cs40l25";
		//pinctrl-names = "default";
		//pinctrl-0 = <&motor_rst_n>;
		reg = <0x40>;
		reset-gpios = <&expander_gpios 6 0>;
		//VA-supply = <&dummy_vreg>;
		//VP-supply = <&dummy_vreg>;
		cirrus,boost-ind-nanohenry = <1000>;
		cirrus,boost-cap-microfarad = <4>;
		cirrus,boost-ipk-milliamp = <4100>;
		cirrus,refclk-gpio2;
	};
};