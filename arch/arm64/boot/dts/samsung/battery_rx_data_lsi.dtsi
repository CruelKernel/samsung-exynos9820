/*
 * SAMSUNG UNIVERSAL9820 board device tree source
 *
 * Copyright (c) 2018 Samsung Electronics Co., Ltd.
 *		http://www.samsung.com
 *
 * This program is free software; you can redistribute it and/or modify
 * it under the terms of the GNU General Public License version 2 as
 * published by the Free Software Foundation.
 */

/ {
};

&hsi2c_46 {
	#address-cells = <1>;
	#size-cells = <0>;
	status = "okay";
	samsung,stop-after-trans;
	samsung,stand-mode;
	clock-frequency = <100000>;

	mfc-s2miw04-charger@3b {
		compatible = "lsi,mfc-s2miw04-charger";
		reg = <0x3b>;
		status = "okay";

		pinctrl-names = "default";
		pinctrl-0 = <&wpc_int &wpc_det>;

		battery,wpc_int = <&gpa3 1 0>;
		battery,wpc_det = <&gpa2 0 0>;
		battery,pdet_b = <&gpa2 1 0>;
		battery,mst_pwr_en = <&gpp2 1 0>;
		battery,wpc_en = <&gpp1 7 0>;
		battery,ping_nen = <&gpp2 2 0>;

		battery,charger_name = "max77705-charger";
		battery,fuelgauge_name = "max77705-fuelgauge";
		battery,wireless_charger_name = "mfc-charger";
		battery,fod_data = <0x0C 0xA1 0x0C 0x9A 0x0C 0x86 0x0C 0x88 0x0C 0x8C 0x0C 0x8C 0x0C 0x8C 0x0C 0x8C 0x0C 0x8C 0x0C 0x8C>;
		battery,fod_data_cv = <0x0C 0xBF 0x0C 0xB8 0x0C 0xA4 0x0C 0xA6 0x0C 0xAA 0x0C 0xAA 0x0C 0xAA 0x0C 0xAA 0x0C 0xAA 0x0C 0xAA>;
		battery,fod_hero_5v_data = <0x0C 0xA1 0x0C 0x9A 0x0C 0x86 0x0C 0x88 0x0C 0x8C 0x0C 0x8C 0x0C 0x8C 0x0C 0x8C 0x0C 0x8C 0x0C 0x8C>;
		battery,fod_dream_data = <0x0C 0xA1 0x0C 0x9A 0x0C 0x86 0x0C 0x88 0x0C 0x8C 0x0C 0x8C 0x0C 0x8C 0x0C 0x8C 0x0C 0x8C 0x0C 0x8C>;
		battery,fod_dream_cv_data = <0x0C 0xA1 0x0C 0x9A 0x0C 0x86 0x0C 0x88 0x0C 0x8C 0x0C 0x8C 0x0C 0x8C 0x0C 0x8C 0x0C 0x8C 0x0C 0x8C>;
		battery,wc_cover_rpp = <0x44>;
		battery,wireless20_vout_list = <9 9 9>; /* WIRELESS_VOUT_11V, 11V, 11V */
		battery,wireless20_vrect_list = <10 11 11>; /* MFC_AFC_CONF_12V_TX, 12.5V, 12.5V */
		battery,wireless20_max_power_list = <2 3 3>; /* SEC_WIRELESS_RX_POWER_12W, 15W, 15W */
	};
};
