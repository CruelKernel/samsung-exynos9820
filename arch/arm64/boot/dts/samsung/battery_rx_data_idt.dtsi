/*
 * SAMSUNG UNIVERSAL9820 board device tree source
 *
 * Copyright (c) 2018 Samsung Electronics Co., Ltd.
 *		http://www.samsung.com
 *
 * This program is free software; you can redistribute it and/or modify
 * it under the terms of the GNU General Public License version 2 as
 * published by the Free Software Foundation.
 */

/ {
};

&hsi2c_46 {
	#address-cells = <1>;
	#size-cells = <0>;
	status = "okay";
	samsung,stop-after-trans;
	samsung,stand-mode;
	clock-frequency = <100000>;

	mfc-charger@3b {
		compatible = "idt,mfc-charger";
		reg = <0x3b>;
		status = "okay";

		pinctrl-names = "default";
		pinctrl-0 = <&wpc_int &wpc_det &pdet_b &wpc_en &ping_nen &vrect_int>;

		battery,wpc_int = <&gpa3 1 0>;
		battery,wpc_det = <&gpa2 0 0>;
		battery,pdet_b = <&gpa2 1 0>;
		battery,mst_pwr_en = <&gpp2 1 0>;
		battery,wpc_en = <&gpp1 7 0>;
		battery,ping_nen = <&gpp2 2 0>;
		battery,vrect_int = <&gpa3 2 0>;

		battery,charger_name = "max77705-charger";
		battery,fuelgauge_name = "max77705-fuelgauge";
		battery,wireless_charger_name = "mfc-charger";
		battery,fod_data = <150 64 142 54 150 41 150 40 155 27 156 24>;
		battery,fod_data_cv = <150 94 142 84 150 71 150 70 155 57 156 54>;
		battery,fod_hero_5v_data = <150 2 142 (-6) 150 (-20) 150 (-28) 165 185 156 (-39)>;
		battery,wc_cover_rpp = <0x44>;
		battery,oc_fod1 = <1100>;
		battery,phone_fod_threshold = <0x3b>;
		battery,wireless20_vout_list = <9 9 9>; /* WIRELESS_VOUT_11V, 11V, 11V */
		battery,wireless20_vrect_list = <10 11 11>; /* MFC_AFC_CONF_12V_TX, 12.5V, 12.5V */
		battery,wireless20_max_power_list = <2 3 3>; /* SEC_WIRELESS_RX_POWER_12W, 15W, 15W */
	};
};
