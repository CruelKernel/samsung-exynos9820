/*
 * Exynos CPU Performance
 * Device driver handle for testing kernel memcpy bandwidth
 */

/ {
	exynos_perf_ncmemcpy {
		compatible = "samsung,exynos_perf_ncmemcpy";
		cal-id-mif = <ACPM_DVFS_MIF>;
		cal-id-g3d = <ACPM_DVFS_G3D>;
	};
};
