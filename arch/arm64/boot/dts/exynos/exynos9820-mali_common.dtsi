/*
 * SAMSUNG EXYNOS7885 SoC device tree source
 *
 * Copyright (c) 2018 Samsung Electronics Co., Ltd.
 *		http://www.samsung.com
 *
 * This program is free software; you can redistribute it and/or modify
 * it under the terms of the GNU General Public License version 2 as
 * published by the Free Software Foundation.
*/

/ {
	/* mali */
    mali: mali@18500000 {
        compatible = "arm,mali";
        reg = <0x0 0x18500000 0x5000>;
        interrupts = <0 288 0>,
                     <0 287 0>,
                     <0 289 0>;
        interrupt-names = "JOB", "MMU", "GPU";
        g3d_cmu_cal_id = <ACPM_DVFS_G3D>;
        samsung,power-domain = <&pd_embedded_g3d>;
        g3d_genpd_name = "pd-embedded_g3d"; /*KC: pg-g3d, LT,MK: pd-embedded_g3d*/
        #cooling-cells = <2>; /* min followed by max */
		governor = "interactive";
		interactive_info = <260000 94 0>;
		gpu_dvfs_table_size = <9 8>; /*<row col>*/
		/*  8 columns      freq  down   up  stay  mif    little  middle   big  */
		gpu_dvfs_table = <  702000    78  100   9  2093000 1456000       0 1820000
		                    650000    78   98   5  2093000 1456000       0 2080000
		                    572000    78   98   5  1794000       0       0       0
		                    433000    78   95   1  1352000       0       0       0
		                    377000    78   90   1  1352000       0       0       0
		                    325000    78   85   1  1014000       0       0       0
		                    260000    78   85   1   676000       0       0       0
		                    200000    78   85   1   676000       0       0       0
		                    156000     0   85   1   676000       0       0       0 >;
		gpu_sustainable_info = <433000 95 949000 1690000 520000>;
		gpu_pmqos_cpu_cluster_num = <3>;
		gpu_pmu_status_reg_offset = <0x2104>;
		gpu_pmu_status_local_pwr_mask = <0x1>; /*0x1 << 0*/
		gpu_max_clock = <702000>;
		gpu_max_clock_limit = <702000>;
		gpu_min_clock = <156000>;
		gpu_dvfs_start_clock = <260000>;
		gpu_dvfs_bl_config_clock = <156000>;
		gpu_default_voltage = <800000>;
		gpu_cold_minimum_vol = <0>;
		gpu_voltage_offset_margin = <37500>;
		gpu_tmu_control = <1>;
		gpu_temp_throttling_level_num = <6>;
		gpu_temp_throttling = <650000 572000 455000 325000 260000 156000>;
		gpu_power_coeff = <625>;
		gpu_dvfs_time_interval = <5>; /*1 tick : 10ms*/
		gpu_default_wakeup_lock = <1>;
		gpu_dynamic_abb = <0>;
		gpu_early_clk_gating = <0>;
		gpu_dvs = <0>;
		gpu_inter_frame_pm = <0>;
		gpu_perf_gathering = <0>;
		gpu_runtime_pm_delay_time = <50>;
		gpu_dvfs_polling_time = <30>;
		gpu_pmqos_int_disable = <1>;
		gpu_pmqos_mif_max_clock = <2094000>;
		gpu_pmqos_mif_max_clock_base = <650000>;
		gpu_cl_dvfs_start_base = <377000>;
		gpu_debug_level = <3>; /*DEBUG(1) INFO(2) WARNING(3) ERROR(4)*/
		gpu_trace_level = <8>; /*TRACE_ALL*/
		gpu_mo_min_clock = <377000>;
		gpu_boost_gpu_min_lock = <0>;
		gpu_boost_egl_min_lock = <1872000>;
		gpu_vk_boost_max_lock = <325000>;
		gpu_vk_boost_mif_min_lock = <1014000>;
		gpu_bts_support = <1>;
		gpu_asv_cali_lock_val = <0>; /*Should check this value when MALI_ASV_CALIBRATION_SUPPORT is enabled*/
		gpu_set_pmu_duration_reg = <0>; /* only for KC for now*/
		gpu_set_pmu_duration_val = <0>; /* only for KC for now*/
		gpu_ess_id_type = <ESS_FLAG_G3D>; /* for dbg snapshot */
	 };
};
