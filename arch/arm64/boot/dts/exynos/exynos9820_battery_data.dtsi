/*
 * SAMSUNG UNIVERSAL5433 board device tree source
 *
 * Copyright (c) 2013 Samsung Electronics Co., Ltd.
 *		http://www.samsung.com
 *
 * This program is free software; you can redistribute it and/or modify
 * it under the terms of the GNU General Public License version 2 as
 * published by the Free Software Foundation.
 */

/ {
	fragment@battery {
		target-path = "/";
		__overlay__ {
			battery {
				status = "okay";
				compatible = "samsung,sec-battery";

				pinctrl-names = "default";

				battery,vendor = "SDI SDI";
				battery,charger_name = "s2mu004-charger";
				battery,fuelgauge_name = "s2mu004-fuelgauge";
				battery,technology = <2>; /* POWER_SUPPLY_TECHNOLOGY_LION */

				battery,temp_high = <500>;
				battery,temp_high_recovery = <450>;
				battery,temp_low = <100>;
				battery,temp_low_recovery = <150>;

				battery,full_check_count = <3>;
				battery,chg_full_vcell = <4310>;
				battery,chg_recharge_vcell = <4250>;

				battery,max_rawsoc = <100>;

				battery,default_input_current = <1000>;
				battery,default_charging_current = <1000>;
				battery,default_full_check_current = <300>;

				battery,max_input_current = <1500>;
				battery,max_charging_current = <1500>;

				/* Order of current setting must be same with
				 * POWER_SUPPLY_TYPE_~~~ of power_supply.h
				 */
				battery,input_current_limit =
					<500 450 500 1200 500 1200 1000 500 500 500
					500 500 500 500 1000 1000 500 500 500 500
					500 500 500 500 1200 1200 500 500 500 500
					500 500 500 500 500 500 500 500 500 500
					1200 1200 1200 500 500 500 500>;
				battery,fast_charging_current =
					<500 450 500 1200 500 1200 1000 500 500 500
					500 500 500 500 1000 1000 500 500 500 500
					500 500 500 500 1200 1200 500 500 500 500
					500 500 500 500 500 500 500 500 500 500
					1200 1200 1200 500 500 500 500>;
				battery,full_check_current =
					<300 0 300 300 300 300 300 300 300 300
					300 300 300 300 300 300 300 300 300 300
					300 300 300 300 300 300 300 300 300 300
					300 300 300 300 300 300 300 300 300 300
					300 300 300 300 300 300 300>;

				battery,battery_table3 =
					<204 11 61 11 175 10 34 10 169 9
					55 9 206 8 107 8 230 7 166 7
					77 7 234 6 174 6 130 6 95 6
					67 6 36 6 253 5 197 5 147 5
					42 5 168 1 247 8 136 8 24 8
					169 7 58 7 202 6 91 6 236 5
					124 5 13 5 158 4 47 4 191 3
					80 3 225 2 113 2 2 2 147 1
					36 1 180 0 69 0 214 15>;

				battery,battery_table4 =
					<62 62 61 60 61 60 59 60 60 58
					58 58 58 58 58 58 59 60 62 64
					76 154>;

				battery,batcap = <0xD0 0x20 0x34 0x08>; /* [0x0E] [0x0F] [0x10] [0x11] */
				battery,accum = <0x8 0x00>; /* [0x45] [0x44] */

				battery,soc_arr_val =
					<11205 10662 10119 9575 9032 8488 7945 7402 6858 6315
					5771 5228 4685 4141 3598 3054 2511 1968 1424 881
					337 (-206)>;
				battery,ocv_arr_val =
					<44747 44050 43353 42664 42077 41520 41006 40522 39872 39562
					39127 38645 38349 38135 37966 37828 37676 37485 37211 36970
					36454 32069>;
			};
		};
	};
};
