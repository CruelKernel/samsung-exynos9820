/*
 * SAMSUNG EXYNOS device tree source for reserved-memory
 *
 * Copyright (c) 2017 Samsung Electronics Co., Ltd.
 *		http://www.samsung.com
 *
 * This program is free software; you can redistribute it and/or modify
 * it under the terms of the GNU General Public License version 2 as
 * published by the Free Software Foundation.
 */

&reserved_memory {
	camera {
		compatible = "exynos9820-ion";
		ion,heapname = "camera_heap";
		size = <0x15E00000>;
		alloc-ranges = <0x0 0x40000000 0xC0000000>;
	};
};
