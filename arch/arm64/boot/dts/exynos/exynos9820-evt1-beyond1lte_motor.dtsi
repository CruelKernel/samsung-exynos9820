/*
 * SAMSUNG UNIVERSAL9810 board device tree source
 *
 * Copyright (c) 2017 Samsung Electronics Co., Ltd.
 *		http://www.samsung.com
 *
 * This program is free software; you can redistribute it and/or modify
 * it under the terms of the GNU General Public License version 2 as
 * published by the Free Software Foundation.
 */

/ {
	fragment@haptic {
		target-path = "/";
			__overlay__ {
			haptic {
				status = "okay";
				haptic,max_timeout = <10000>;
				/* for multi-frequency */
				haptic,multi_frequency = <7>;
				/* frequency     alert low   mid   high  0     press release */
				haptic,duty   = <36621 48828 39062 29296 32551 37108 37108>;
				haptic,period = <48828 65104 52083 39062 43402 39062 39062>;
				haptic,reg2 = <0x82>;
				haptic,pwm_id = <1>;
				haptic,regulator_name = "VDD_MOTOR_3P3";
				haptic,normal_ratio = <75>;
				haptic,overdrive_ratio = <95>;
				haptic,type = "LINEAR_1040";
			};
		};
	};
};