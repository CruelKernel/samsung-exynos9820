/*
 * SAMSUNG EXYNOS9820 board device tree source
 *
 * Copyright (c) 2018 Samsung Electronics Co., Ltd.
 *		http://www.samsung.com
 *
 * This program is free software; you can redistribute it and/or modify
 * it under the terms of the GNU General Public License version 2 as
 * published by the Free Software Foundation.
*/

&reserved_memory {
	#address-cells = <2>;
	#size-cells = <1>;

	cp_linear {
		compatible = "exynos,cp_linear";
		reg = <0x0 0xF0000000 0xD900000>;
	};
};

