/*
 * SAMSUNG EXYNOS9810 SoC device tree source
 *
 * Copyright (c) 2017 Samsung Electronics Co., Ltd.
 *		http://www.samsung.com
 *
 * SAMSUNG EXYNOS9810 SoC device nodes are listed in this file.
 * EXYNOS9810 based board files can include this file and provide
 * values for board specfic bindings.
 *
 * This program is free software; you can redistribute it and/or modify
 * it under the terms of the GNU General Public License version 2 as
 * published by the Free Software Foundation.
 */

/ {
	exynos-snapshot {
		compatible = "samsung,exynos-snapshot";
		#address-cells = <1>;
		#size-cells = <1>;

		use_multistage_wdt_irq = <497>;
		/* -----------<< Example >>-------------------
		dump-info@0x0 {
			sfr-dump-list = "sfr-dump-cmu-peris", "sfr-dump-cmu-abox";
			sfr-dump-cmu-peris {
				reg = <0x10010100 0x4000>;
				addr = <0x10010100 0x10010104 0x10010108 0xFFFFFFFF>;
			};

			sfr-dump-cmu-abox {
				reg = <0x103e0000 0x4000>;
				addr = <0x103e0100 0x103e0104 0x103e0108 0xFFFFFFFF>;
			};
		};
		*/
	};
};
