## drivers/sensorhub/brcm/bbdpl/Kconfig
```kconfig
choice
    depends on SENSORS_SSP_BBD
    prompt "Choose serial connection with chip"
    default BCM_GPS_SPI_DRIVER

config BCM_GPS_TTY_DRIVER
    bool  "TTY"
    depends on TTY
    help
        Support for BRCM GPS UART driver.

config BCM_GPS_I2C_DRIVER
    bool "I2C"
    depends on I2C
    help
        Support for BRCM GPS I2C driver.

config BCM_GPS_SPI_DRIVER
    bool "SPI"
    depends on SPI
    help
        Support for BRCM GPS SPI driver.

endchoice
```

## drivers/soc/samsung/Kconfig
```kconfig
#
# SAMSUNG SoC drivers
#
menuconfig SOC_SAMSUNG
	bool "Samsung SoC driver support" if COMPILE_TEST

if SOC_SAMSUNG
config EXYNOS_CHIPID
	bool "Exynos Chip ID Driver Support"
	depends on ARCH_EXYNOS
	select SOC_BUS

config EXYNOS_PMU
	bool "Exynos PMU controller driver" if COMPILE_TEST
	depends on ARCH_EXYNOS || ((ARM || ARM64) && COMPILE_TEST)
	select EXYNOS_PMU_ARM_DRIVERS if ARM && ARCH_EXYNOS

# There is no need to enable these drivers for ARMv8
config EXYNOS_PMU_ARM_DRIVERS
	bool "Exynos PMU ARMv7-specific driver extensions" if COMPILE_TEST
	depends on EXYNOS_PMU

config EXYNOS_PM_DOMAINS
	bool "Exynos PM domains" if COMPILE_TEST
	depends on PM_GENERIC_DOMAINS || COMPILE_TEST

config EXYNOS_PD
	bool "Exynos PM domain Support"
	depends on ARCH_EXYNOS
	depends on PM
	select PM_GENERIC_DOMAINS
config ECT
	bool "Enable Exynos Characteristic Table File"
	default n
	depends on ARCH_EXYNOS

config ECT_DUMP
	bool "Enable Exynos Characteristic Table File Dump sysfs"
	default n
	depends on ECT

config EXYNOS_RGT
	bool "Exynos Regulator Debug Support"
	depends on REGULATOR
	depends on DEBUG_FS
	depends on OF
	help
	  dummy device driver for debugging samsung PMIC

config EXYNOS_BCM_DBG
	bool "EXYNOS_BCM_DBG driver support"
	help
	  Enable exynos-bcm_dbg driver support

config EXYNOS_BCM_DBG_AUTO
	bool "EXYNOS_BCM_DBG_AUTO support"
	default y
	depends on EXYNOS_BCM_DBG
	help
	  Enable exynos-bcm_dbg_auto support

config EXYNOS_BCM_DBG_DUMP
	bool "EXYNOS_BCM_DBG dump support"
	depends on EXYNOS_BCM_DBG
	help
	  Enable exynos-bcm_dbg dump support

config EXYNOS_SCI
	bool "EXYNOS SCI interface driver support"
	help
	  Enable exynos sci interface driver support

config CAL_IF
	bool "Exynos Chip Abstraction Layer Interface"
	help
	Support CMU CAL for Exynos SoC.

config EXYNOS_REBOOT
	bool "Exynos Chip Reboot Driver Support"
	depends on ARCH_EXYNOS

config CMU_EWF
	bool "exynos early wakeup force enable"
	depends on CAL_IF
	default y
	help
	Support CMUEWF for Exynos SoC.

config EXYNOS_PM_DVS
       bool "Enable Exynos dynamic voltage setting"
       default n

config PMUCAL
	bool "Exynos PMU Chip Abstraction Layer"
	depends on CAL_IF
	default y
	help
	Support PMUCAL for Exynos SoC.

config PMUCAL_DBG
	bool "Exynos PMUCAL debugging interface"
	depends on PMUCAL
	default y
	help
	Support PMUCAL debugging for Exynos SoC.

config FLEXPMU
	bool "Exynos FLEXPMU"
	depends on PMUCAL
	default n
	help
	Support PMUCAL for Exynos SoC.

config EXYNOS_FLEXPMU_DBG
	bool "Exynos FLEXPMU DBG"
	depends on FLEXPMU
	default y
	help
	Support FLEXPMU for Exynos SoC.

config EXYNOS_FLEXPMU_DBG
	bool "Exynos FLEXPMU DBG"
	depends on FLEXPMU
	default y
	help
	 Support FLEXPMU for Exynos SoC.

config CMUCAL
	bool "Exynos CMU Chip Abstraction Layer"
	depends on CAL_IF
	default y
	help
	Support CMUCAL for Exynos SoC.

config CP_PMUCAL
	bool "Exynos PMU(for CP) Chip Abstraction Layer"
	depends on CAL_IF
	help
	Support CP_PMUCAL for Exynos SoC.

config CMUCAL_DEBUG
	bool "CMUCAL Debug Interface"
	depends on CMUCAL

config CMUCAL_QCH_IGNORE_SUPPORT
	bool "CMUCAL QCH IGNORE Support"
	depends on CMUCAL

config ACPM_DVFS
	bool "Exynos ACPM DVFS manager"
	depends on CAL_IF && CMUCAL
	default n
	help
	Support ACPM DVFS for Exynos SoC.

config EXYNOS_PM_DOMAINS
	bool "Exynos PM domains" if COMPILE_TEST
	depends on PM_GENERIC_DOMAINS || COMPILE_TEST

source "drivers/soc/samsung/acpm/Kconfig"

config USI_V2
	bool "Enable Universal Serial Interface version 2"
	default y

config EXYNOS_DVFS_MANAGER
	bool "Exynos DVFS Manager"
	default n
	depends on ARCH_EXYNOS
	help
	  Enable DVFS Manager for Exynos SoC.
	  This module controls constraint between each DVFS domains.

config EXYNOS_SDM
	bool "Exynos Security Dump Manager Support"
	depends on DEBUG_SNAPSHOT
	default y
	help
	  Exynos Security Dump Manager

config EXYNOS_OCP
	bool "Exynos OCP Handler"
	depends on CPU_FREQ
	default n
	help
	  Enable OCP handler for Exynos SoC.

config EXYNOS_MCINFO
	bool "Exynos memory controller information"
	default n

config MCINFO_SYSFS
	bool "Exynos memory controller information sysfs"
	depends on EXYNOS_MCINFO
	default	y if SYSFS

config EXYNOS_SECURE_LOG
	bool "Exynos Secure Log"
	default y
	help
	  Support Exynos Secure Log

config EXYNOS_KERNEL_PROTECTION
	bool "Exynos Kernel Code Protection"
	help
	  Support Exynos Kernel Code Protection

config EXYNOS_CONTENT_PATH_PROTECTION
	bool "Exynos Content Path Protection"
	default y
	help
	  Enable content path protection of EXYNOS.

config EXYNOS_SMC_LOG_THRESHOLD
	int "threshold of detection(microsecond)"
	range 0 1000000
	default 0

config DEBUG_SNAPSHOT_LOGGING_SMC
	bool "Exynos Logging SMC"
	depends on DEBUG_SNAPSHOT
	default y

config EXYNOS_CP_RESERVE
	bool "Exynos CP Reserve"

config EXYNOS_PPMPU_FAIL_DETECTOR
	bool "Exynos PPMPU Fail Detector"
	default y
	help
	  Support Exynos PPMPU Fail Detector

config EXYNOS_PPMPU_SUPPORT_SMC
	bool "PPMPU in SMC"
	depends on EXYNOS_PPMPU_FAIL_DETECTOR
	help
	  This SoC supports PPMPU in SMC

config EXYNOS_PPMPU_ILLEGAL_READ_LOGGING
	bool "Logging PPMPU Read Fail Information"
	depends on EXYNOS_PPMPU_FAIL_DETECTOR
	default n
	help
	  PPMPU fail information of illegal reads will be printed
	  by the Kernel logging system.

config EXYNOS_PPMPU_ILLEGAL_ACCESS_PANIC
	bool "Kernel Panic over PPMPU Illegal Access"
	depends on EXYNOS_PPMPU_FAIL_DETECTOR
	default n
	help
	  Kernel panic will occur in case that PPMPU illegal
	  access is detected.

source "drivers/soc/samsung/secure_boot/Kconfig"
source "drivers/soc/samsung/debug/Kconfig"
source "drivers/soc/samsung/exynos-hdcp/Kconfig"
source "drivers/soc/samsung/exynos_cpu_perf/Kconfig"

config SENSORS_FP_USI_NUMBER
	depends on SENSORS_FINGERPRINT
	int "Fingerprint usi gpio number"
	default 0

endif
```

## drivers/soc/samsung/acpm/Kconfig
```kconfig
#
# ACPM driver configuration
#

menuconfig EXYNOS_ACPM
	bool "ACPM driver support"
	default n
	help
	  Enable ACPM support

if EXYNOS_ACPM

config EXYNOS7570_ACPM
	bool "EXYNOS7570_ACPM support"
	default y
	depends on SOC_EXYNOS7570
	help
	  Enable ACPM support

config EXYNOS7270_ACPM
	bool "EXYNOS7270_ACPM support"
	default y
	depends on SOC_EXYNOS7270
	help
	  Enable ACPM support

config EXYNOS8895_ACPM
	bool "EXYNOS8895_ACPM support"
	default y
	depends on SOC_EXYNOS8895
	help
	  Enable ACPM support

config EXYNOS9810_ACPM
	bool "EXYNOS9810_ACPM support"
	default y
	depends on SOC_EXYNOS9810
	help
	  Enable ACPM support

config EXYNOS_ACPM_MFD
	bool "EXYNOS_ACPM_MFD support"
	default y
	help
	  Enable ACPM_MFD support

config EXYNOS_ACPM_S2D
	bool "EXYNOS_ACPM_S2D support"
	help
	  Enable ACPM_S2D support

endif
```

## drivers/soc/samsung/debug/Kconfig
```kconfig
menuconfig EXYNOS_DEBUG
	bool "Exynos Debug Features"
	default y
        depends on ARCH_EXYNOS

config EXYNOS_ITMON
        bool "Exynos IPs Traffic Monitor"
        default y
        depends on ARCH_EXYNOS && EXYNOS_DEBUG

menuconfig EXYNOS_CORESIGHT
        bool "Enable Coresight of exynos"
        depends on ARCH_EXYNOS && EXYNOS_DEBUG
        default n

config EXYNOS_CORESIGHT_PC_INFO
        bool "Show Porgram Counter information"
        depends on EXYNOS_CORESIGHT
        default y
        help
          Show Program Counter information When kernel panic.

config PC_ITERATION
        int "Number of Program Coutner information"
        depends on EXYNOS_CORESIGHT_PC_INFO
        range 1 10
        default 5
        help
          Print out Program Counter as iteration value.

config EXYNOS_CORESIGHT_MAINTAIN_DBG_REG
        bool "Save/Restore Debug Registers"
        depends on EXYNOS_CORESIGHT
        default n
        help
          When core power is down, debug registers are not mainained data
          and OS-lock is set. To maintain data, debug registers's data must
          save in /restore from memory. If OS-lock is set, debugging to use
          trace32 is impossible. So OS-lock must clear when core power is up.
          This config must enable only using iTSP program.

config EXYNOS_ADV_TRACER
        bool "Exynos Advanced Tracer"
        default n
        depends on EXYNOS_DEBUG

config EXYNOS_ADV_TRACER_S2D
        bool "Exynos Advanced Tracer: Plug-in - S2D"
	default n
	depends on EXYNOS_ADV_TRACER

config EXYNOS_ADV_TRACER_MISC
	bool "Exynos Advanced Tracer: Plug-in - MISC"
	default n
	depends on EXYNOS_ADV_TRACER

menuconfig EXYNOS_CORESIGHT_ETM
        bool "Enable ETM driver of exynos"
        depends on ARCH_EXYNOS && EXYNOS_DEBUG
        default n
        help
          ETM driver is a driver for debugging. Also this driver enable ETR of
          coresight feature.

config EXYNOS_CORESIGHT_ETB
        bool "This system has ETB feature"
        depends on EXYNOS_CORESIGHT_ETM && SOC_EXYNOS7580
        default n
        help
          ETB driver is the sink part of coresight components. Some coresights has
          ETR.

config EXYNOS_CORESIGHT_ETF
        bool "This system has ETF feature"
        depends on EXYNOS_CORESIGHT_ETM
        default n
        help
          ETF driver is the sink part of coresight components. Some coresights has
          ETR.

config EXYNOS_CORESIGHT_ETR
        bool "This system has ETR feature"
        depends on EXYNOS_CORESIGHT_ETF && DEBUG_SNAPSHOT
        default n
        help
          ETR driver is a driver for debugging. Also this driver is thr sink part of
          coresight feature. Coresight consists of source, link, sink part.
          This routes to DRAM or USB.

config EXYNOS_CORESIGHT_ETM_SYSFS
        bool "This system has ETM Sysfs feature"
        depends on EXYNOS_CORESIGHT_ETM
        default n
        help
          Show ETM, FUNNEL, ETB, ETF and ETR status through sysfs.

config EXYNOS_DEBUG_TEST
        bool "Exynos debug feature regression test"
        default y
        depends on ARCH_EXYNOS && EXYNOS_DEBUG

config EXYNOS_SAVELOGS
	bool "Exynos support savelogs"
	default n
	depends on ARCH_EXYNOS && EXYNOS_DEBUG
	help
	  For saving kernel and platform logs on storage, savelogs driver make debugfs
	  file to extract kernel and platform new log data.

config EXYNOS_EHLD
	bool "Exynos support Early Hardlockup Detector"
	default n
	depends on ARCH_EXYNOS && EXYNOS_DEBUG
```

## drivers/soc/samsung/exynos-hdcp/Kconfig
```kconfig
#
# HDCP driver configuration
#

menuconfig EXYNOS_HDCP2
	bool "HDCP2 driver support"
	default y
	help
	  Enable HDCP2 support

if EXYNOS_HDCP2

config HDCP2_EMULATION_MODE
	bool "HDCP2 emulation mode support"
	default n
	help
	  Enable HDCP2 emulation mode support

config HDCP2_DP_ENABLE
         bool "HDCP2 DP protocol support"
         default y
         help
           Enable HDCP2 DP protocol support

config HDCP2_IIA_ENABLE
         bool "HDCP2 HDCP protocol support"
         default n
         help
           Enable HDCP2 DP protocol support

config HDCP2_FUNC_TEST_MODE
         bool "HDCP2 DP Default Enabled"
         depends on SEC_FACTORY
         default n
         help
           Enable HDCP2 DP Function test mode.

endif
```

## drivers/soc/samsung/exynos_cpu_perf/Kconfig
```kconfig
#
# Exynos CPU Performance Profiling
#

menuconfig EXYNOS_CPU_PERF
	bool "Exynos CPU Performance Profiling"
	default y
	help
	  Enable Exynos CPU Performance Profiling
	depends on SOC_SAMSUNG
```

## drivers/soc/samsung/secure_boot/Kconfig
```kconfig
#
# Secure boot driver configuration
#

menuconfig EXYNOS_SIGNATURE_BIN
	bool "Add secure boot signature"
	help
	  This option is to enable signing of the Image for signature verification.

config SB_SIGN_TYPE
	int "set sign type"
	default 3 if EXYNOS_SIGNATURE_BIN
	depends on EXYNOS_SIGNATURE_BIN

config SB_KEY_TYPE
	int "set key type"
	default 1 if EXYNOS_SIGNATURE_BIN
	depends on EXYNOS_SIGNATURE_BIN

config SB_RB_COUNT
	int "set roll back prevention count"
	default 0 if EXYNOS_SIGNATURE_BIN
	depends on EXYNOS_SIGNATURE_BIN

config SB_KERNEL_SIZE
	int "set kernel image size"
	default 31457280 if EXYNOS_SIGNATURE_BIN
	depends on EXYNOS_SIGNATURE_BIN
```

## drivers/spu_verify/Kconfig
```kconfig
config SPU_VERIFY
	bool "SPU Sign Verify Driver"
	default n
	help
	  This option enables SPU sign verify driver.
	  When SPU fireware update, image signature verify.
	  Each firmware is checked by calling a function before updating.
	  If disable config, maybe Signature checking cause problems.
```

## drivers/staging/android/ion/Kconfig
```kconfig
menuconfig ION
	bool "Ion Memory Manager"
	depends on HAVE_MEMBLOCK && HAS_DMA && MMU
	select GENERIC_ALLOCATOR
	select DMA_SHARED_BUFFER
	---help---
	  Chose this option to enable the ION Memory Manager,
	  used by Android to efficiently allocate buffers
	  from userspace that can be shared between drivers.
	  If you're not using Android its probably safe to
	  say N here.

config ION_EXYNOS
	bool "Exynos Extension to ION"
	depends on ION
	help
	  Choose this option for Exynos SoCs. Initialization of cma heap is
	  changed.

config ION_TEST
	tristate "Ion Test Device"
	depends on ION
	help
	  Choose this option to create a device that can be used to test the
	  kernel and device side ION functions.

config ION_SYSTEM_HEAP
	bool "Ion system heap"
	depends on ION
	help
	  Choose this option to enable the Ion system heap. The system heap
	  is backed by pages from the buddy allocator. If in doubt, say Y.

config ION_CARVEOUT_HEAP
	bool "Ion carveout heap support"
	depends on ION
	help
	  Choose this option to enable carveout heaps with Ion. Carveout heaps
	  are backed by memory reserved from the system. Allocation times are
	  typically faster at the cost of memory not being used. Unless you
	  know your system has these regions, you should say N here.

config ION_CHUNK_HEAP
	bool "Ion chunk heap support"
	depends on ION
	help
          Choose this option to enable chunk heaps with Ion. This heap is
	  similar in function the carveout heap but memory is broken down
	  into smaller chunk sizes, typically corresponding to a TLB size.
	  Unless you know your system has these regions, you should say N here.

config ION_CMA_HEAP
	bool "Ion CMA heap support"
	depends on ION && DMA_CMA
	help
	  Choose this option to enable CMA heaps with Ion. This heap is backed
	  by the Contiguous Memory Allocator (CMA). If your system has these
	  regions, you should say Y here.

config ION_HPA_HEAP
	bool "Ion HPA heap support"
	depends on ION && HPA
	help
	  Choose this option to enable HPA heaps with Ion. This heap is backed
	  by the High-order Pages Allocator (HPA). If your system needs HPA for
	  some reason, you should say Y here.

config ION_DEBUG_EVENT_RECORD
	bool "Ion event debug support"
	default y
	depends on ION_EXYNOS

config ION_RBIN_HEAP
	bool "ION RBIN Heap"
	default y
	depends on ION && RBIN && ION_EXYNOS && CLEANCACHE
	help
	  Provides ION RBIN heap which utilizes RBIN memory.
	  While RBIN heap is similar with CMA heap, it assumes that an ION buffer
	  can be composed of multiple free chunks.
```
