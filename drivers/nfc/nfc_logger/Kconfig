## drivers/samsung/misc/Kconfig
```kconfig
menuconfig SEC_MISC
	bool "Enable SEC miscellaneous feature"
	depends on SEC_EXT
	default y

comment "Samsung Mobile Power Management Options"
menuconfig SEC_PM
	bool "Samsung Mobile Power Management"
	default y
	help
	  This option enables support for various drivers and features for
	  Samsung Mobile Power Management.

config SEC_PM_DEBUG
	bool "Enable Samsung Mobile Power management debug support"
	default y
	depends on SEC_PM
	help
	  This option enables Samsung Mobile Power management debug support.
	  Intended for test and debug only.

config SEC_PM_BIGDATA
	bool "Enable Samsung Mobile Power management big data support"
	default y
	depends on SEC_PM
	help
	  This option enables Samsung Mobile Power management big data support.

comment "Samsung TN Logging Options"
config SEC_DEBUG_TSP_LOG
	default n
	bool "Enable tsp log support" if EMBEDDED
	depends on SEC_EXT
	help
	  This option enables additional log buffer for tsp log.

comment "Samsung TN NAD Options"
config SEC_NAD
	bool "Samsung TN NAD Feature"
	default n
	help
	  Samsung TN NAD Feature, support AT CMD for NAD 2.0

config SEC_NAD_MANUAL_PARAM_READTIME
	int "Samsung TN NAD Feature"
	depends on SEC_NAD
	default "10"
	help
	  Samsung TN NAD Feature, set param reading time manually.

config SEC_SUPPORT_SECOND_NAD
	bool "Samsung TN 2nd NAD Feature"
	depends on SEC_NAD
	default n
	help
	  Samsung TN NAD Feature, support 2nd NAD feature.

config SEC_NAD_BALANCER
	bool "Samsung TN NAD Balancer Feature"
	depends on SEC_NAD
	default n
	help
	  This option enables Samsung TN NAD Balancer Feature.
	  This option also can generate thread to change dvfs frequency. It helps keep balancing
	  between user and factory binary.

config SEC_NAD_HPM
	bool "Samsung TN NAD HPM Feature"
	depends on SEC_NAD
	default n
	help
	  Samsung TN NAD Feature, Enable NAD HPM

config SEC_NAD_API
	bool "Samsung TN NAD API Feature"
	depends on SEC_NAD
	default n
	help
	  Samsung TN NAD Feature, Support NAD API to check gpio pull-up registance

config SEC_SUPPORT_VST
	bool "Samsung TN NAD 4.0 Feature"
	depends on SEC_NAD
	default n
	help
	  Samsung TN NAD Feature, support NAD 4.0 feature.

config SEC_NAD_LOG
	bool "Samsung TN NAD LOG Feature"
	depends on SEC_NAD
	default n
	help
	  Samsung TN NAD Feature, Enable NAD LOG

config SEC_NAD_X
	bool "Samsung TN NAD X Feature"
	depends on SEC_NAD
	default n
	help
	  Samsung TN NAD Feature, Enable NAD X

config SEC_NAD_C
	bool "Samsung TN NAD C Feature"
	depends on SEC_NAD && SEC_NAD_X
	default n
	help
	  Samsung TN NAD Feature, Enable NAD C

config SEC_NAD_BPS_CLASSIFIER
	bool " Samsung TN NAD BPS Classifier Feature"
	depends on SEC_NAD
	default n
	help
	  This option enables gathering bps classifier information during factory process.

config SEC_HQM_DEVICE
	bool "Samsung sec hqm device"
	default n
	help
	  Samsung hqm device feature

config ARGOS
	bool "Throughput monitoring Feature"
	default n
	help
	  This option enables monitoring the data throughput and doing several actions for
	  enhancing the performance such as adjusting the CPU freqency, allocating the tasks
	  to the appropriate CPU and so on

config SEC_SYSUP
	bool "Samsung System Update"
	default n
	help
	  Samsung system update Feature

comment "Logging Heavy Task Cpu Options"
config SEC_HEAVY_TASK_CPU
	bool "Enable heacy cpu core counting"
	default n
	help
	  This option enables heavy cpu core counting.

comment "NOTIFIER configs"
config VBUS_NOTIFIER
	bool "VBUS notifier support"
	default n
	help
	  If you say yes here you will get support for
	  the VBUS status change notification.
```

## drivers/scsi/ufs/Kconfig
```kconfig
#
# Kernel configuration file for the UFS Host Controller
#
# This code is based on drivers/scsi/ufs/Kconfig
# Copyright (C) 2011-2013 Samsung India Software Operations
#
# Authors:
#	Santosh Yaraganavi <santosh.sy@samsung.com>
#	Vinayak Holikatti <h.vinayak@samsung.com>
#
# This program is free software; you can redistribute it and/or
# modify it under the terms of the GNU General Public License
# as published by the Free Software Foundation; either version 2
# of the License, or (at your option) any later version.
# See the COPYING file in the top-level directory or visit
# <http://www.gnu.org/licenses/gpl-2.0.html>
#
# This program is distributed in the hope that it will be useful,
# but WITHOUT ANY WARRANTY; without even the implied warranty of
# MERCHANTABILITY or FITNESS FOR A PARTICULAR PURPOSE.  See the
# GNU General Public License for more details.
#
# This program is provided "AS IS" and "WITH ALL FAULTS" and
# without warranty of any kind. You are solely responsible for
# determining the appropriateness of using and distributing
# the program and assume all risks associated with your exercise
# of rights with respect to the program, including but not limited
# to infringement of third party rights, the risks and costs of
# program errors, damage to or loss of data, programs or equipment,
# and unavailability or interruption of operations. Under no
# circumstances will the contributor of this Program be liable for
# any damages of any kind arising from your use or distribution of
# this program.

config SCSI_UFSHCD
	tristate "Universal Flash Storage Controller Driver Core"
	depends on SCSI && SCSI_DMA
	select NLS
	---help---
	This selects the support for UFS devices in Linux, say Y and make
	  sure that you know the name of your UFS host adapter (the card
	  inside your computer that "speaks" the UFS protocol, also
	  called UFS Host Controller), because you will be asked for it.
	  The module will be called ufshcd.

	  To compile this driver as a module, choose M here and read
	  <file:Documentation/scsi/ufs.txt>.
	  However, do not compile this as a module if your root file system
	  (the one containing the directory /) is located on a UFS device.

config UFS_UN_18DIGITS
	bool "The digits of SEC unique number"
	depends on SCSI_UFSHCD

config SCSI_UFSHCD_PCI
	tristate "PCI bus based UFS Controller support"
	depends on SCSI_UFSHCD && PCI
	---help---
	This selects the PCI UFS Host Controller Interface. Select this if
	you have UFS Host Controller with PCI Interface.

	  If you have a controller with this interface, say Y or M here.

	  If unsure, say N.

config SCSI_UFS_DWC_TC_PCI
	tristate "DesignWare pci support using a G210 Test Chip"
	depends on SCSI_UFSHCD_PCI
	---help---
	  Synopsys Test Chip is a PHY for prototyping purposes.

	  If unsure, say N.

config SCSI_UFSHCD_PLATFORM
	tristate "Platform bus based UFS Controller support"
	depends on SCSI_UFSHCD
	---help---
	This selects the UFS host controller support. Select this if
	you have an UFS controller on Platform bus.

	If you have a controller with this interface, say Y or M here.

	  If unsure, say N.

config SCSI_UFS_DWC_TC_PLATFORM
	tristate "DesignWare platform support using a G210 Test Chip"
	depends on SCSI_UFSHCD_PLATFORM
	---help---
	  Synopsys Test Chip is a PHY for prototyping purposes.

	  If unsure, say N.

config SCSI_UFS_ASYNC_RELINK
	tristate "Asynchronous link establishment on UFS device resume"
	depends on SCSI_UFSHCD && SCSI_UFSHCD_PLATFORM
	---help---
	  This feature is to support concurrency of UFS resume and the others.
	  In UFS re-link, system wake-up may task a long time when UFS resume
	  time is increased for device latency or etc.

	  If you want to enable this feature, say Y or M here.

	  If unsure, say N.

config SCSI_UFS_CMD_LOGGING
	tristate "UFS cmd loggging support"
	depends on SCSI_UFSHCD && SCSI_UFSHCD_PLATFORM
	---help---
	  This feature is to support UFS cmd logging.
	  When UFS cmd transferred to UFS HCI
	  various data logs for debugging purpose.

	  If you want to enable this feature, say Y or M here.

	  If unsure, say N.

config SCSI_UFS_TEST_MODE
       bool "Samsung UFS TEST feature"
       depends on SCSI_UFSHCD && SCSI_UFSHCD_PLATFORM
       ---help---
         This selects support for test mode for debugging.
         Select this option if this feature is needed on working.

config UFS_DATA_LOG
	bool "Samsung UFS DATA logging"
	depends on SCSI_UFSHCD && SCSI_UFSHCD_PLATFORM
	---help---
	  This feature support for UFS Data logging.
	  Select this option if this feature is needed on working.

config UFS_DATA_LOG_MAGIC_CODE
	bool "Samsung UFS DATA logging"
	depends on SCSI_UFSHCD && SCSI_UFSHCD_PLATFORM && UFS_DATA_LOG
	---help---
	  This feature support for UFS Data logging include magic code.
	  Select this option if this feature is needed on working.

config SCSI_UFS_QCOM
	tristate "QCOM specific hooks to UFS controller platform driver"
	depends on SCSI_UFSHCD_PLATFORM && ARCH_QCOM
	select PHY_QCOM_UFS
	help
	  This selects the QCOM specific additions to UFSHCD platform driver.
	  UFS host on QCOM needs some vendor specific configuration before
	  accessing the hardware which includes PHY configuration and vendor
	  specific registers.

	  Select this if you have UFS controller on QCOM chipset.
	  If unsure, say N.

config SCSI_UFS_EXYNOS
	tristate "EXYNOS UFS Host Controller Driver"
	depends on SCSI_UFSHCD && SCSI_UFSHCD_PLATFORM
	---help---
	  This selects the EXYNOS UFS host controller driver.

	  If you have a controller with this interface, say Y or M here.

	  If unsure, say N.

config SCSI_UFS_FMP_DUMP
	tristate "EXYNOS Flash Memory Protector Dump for UFS Host"
	depends on SCSI_UFSHCD && SCSI_UFSHCD_PLATFORM
	---help---
	  This selects the EXYNOS UFS FMP DUMP.

	  If you have a controller with this interface, say Y or M here.

	  If unsure, say N.

config SCSI_UFS_EXYNOS_FMP
	tristate "EXYNOS Flash Memory Protector for UFS Host"
	depends on SCSI_UFS_EXYNOS && EXYNOS_FMP
	select SCSI_UFS_EXYNOS_SMU
	---help---
	  This selects the EXYNOS UFS FMP Driver.

	  If you have a controller with this interface, say Y or M here.

	  If unsure, say N.

config SCSI_UFS_EXYNOS_SMU
	tristate "EXYNOS Secure Management Unit for UFS Host"
	depends on SCSI_UFS_EXYNOS && EXYNOS_SMU
	---help---
	  This selects the EXYNOS UFS SMU Driver.

	  If you have a controller with this interface, say Y or M here.

	  If unsure, say N.
```

## drivers/security/samsung/five_tee_driver/Kconfig
```kconfig
#
# TEE Driver configuration
#

config FIVE_TEE_DRIVER
    tristate "Integrity TEE Driver"
    depends on FIVE && !PROCA_S_OS
    default y
    ---help---
      Enable Integrity Trusted Execution Environment support

choice
    prompt "FIVE Secure OS"
    depends on FIVE_TEE_DRIVER
    default FIVE_USE_TZDEV if TZDEV
    default FIVE_USE_QSEE if QSEECOM
    default FIVE_USE_TRUSTONIC if TRUSTONIC_TEE || TRUSTONIC_TEE_SUPPORT
    default FIVE_USE_EMULATOR
    ---help---
      Select Secure OS for FIVE TEE Driver

    config FIVE_USE_EMULATOR
        bool "Integrity TEE Driver for TA emualtor"
        ---help---
          Use Integrity TEE Driver which interacts with TA emulator over network

    config FIVE_USE_TRUSTONIC
        bool "Integrity TEE Driver based on Trustonic Secure OS"
        depends on TRUSTONIC_TEE || TRUSTONIC_TEE_SUPPORT
        ---help---
          Use Trustonic as base Trusted Execution Environment

    config FIVE_USE_TZDEV
        bool "Integrity TEE Driver based on TEEgris Secure OS"
        depends on TZDEV
        ---help---
          Use TEEgris as base Trusted Execution Environment

    config FIVE_USE_QSEE
        bool "Integrity TEE Driver based on QSEE Secure OS"
        depends on QSEECOM
        ---help---
          Use QSEE as base Trusted Execution Environment

endchoice

config TEE_DRIVER_DEBUG
    bool "Integrity TEE Driver Debug mode"
    depends on FIVE_TEE_DRIVER
    default n
    ---help---
      Enable Debug mode in TEE Driver

config FIVE_EMULATOR_IP
    string "IP address of FIVE TA Emulator"
    depends on FIVE_TEE_DRIVER && FIVE_USE_EMULATOR
    default "10.0.2.2" if FIVE_USE_EMULATOR
    ---help---
      The driver will connect to FIVE TA at this address

config FIVE_TRUSTLET_PATH
    string "FIVE trustlet"
    depends on FIVE_TEE_DRIVER && FIVE_USE_TRUSTONIC && FIRMWARE_IN_KERNEL
    default "five/ffffffff000000000000000000000072.tlbin"
    ---help---
      This option defines FIVE trustlet path which will be built-in kernel

config FIVE_EARLY_LOAD_TRUSTED_APP
    bool "Load trusted application in early boot"
    depends on FIVE_TEE_DRIVER
    default n
    help
      Enable the load of trusted application on during initialization of driver

config FIVE_SIGN_TA
    bool "Sign FIVE TA during build"
    depends on FIVE_TEE_DRIVER && FIVE_USE_QSEE
    default n
    help
      FIVE TA will be signed during build. Otherwise pre-signed TA will be used.

config FIVE_SIGNCLIENT_PATH
    string "Path to signclient.jar"
    depends on FIVE_SIGN_TA
    help
      Path to signclient.jar for signing FIVE TA

config FIVE_PILSPLITTER_PATH
    string "Path to pil_splitter.py"
    depends on FIVE_SIGN_TA
    help
      Path to pil_splitter.py for preparaing TA to signing
```

## drivers/security/samsung/icdrv/Kconfig
```kconfig
#
# Integrity Check Driver configuration
#

config ICD
    bool "IC Driver"
    depends on FIVE && !PROCA_S_OS
    default y
    ---help---
      Enable Integrity Check Driver support.
      It's used to set FUSE for tampered processes.

choice
    prompt "IC Secure OS"
    depends on ICD
    default ICD_USE_QSEECOM if QSEECOM
    default ICD_USE_TZDEV if TZDEV
    default ICD_USE_TRUSTONIC
    ---help---
      Select Secure OS for ICD

    config ICD_USE_TRUSTONIC
        bool "Integrity TEE Driver based on Trustonic Secure OS"
        depends on TRUSTONIC_TEE
        ---help---
          Use Trustonic as base Trusted Execution Environment

    config ICD_USE_TZDEV
        bool "Integrity TEE Driver based on TEEgris Secure OS"
        depends on TZDEV
        ---help---
          Use TEEgris as base Trusted Execution Environment

    config ICD_USE_QSEECOM
        bool "Integrity TEE Driver based on Qualcomm Secure OS"
        depends on QSEECOM
        ---help---
          Use Qualcomm as base Trusted Execution Environment
endchoice
```

## drivers/security/samsung/tzic/Kconfig
```kconfig
#
# TZIC configuration
#

config TZIC
    tristate "TZIC Driver"
    default y
    ---help---
      Enable TZIC Driver support.

choice
    prompt "IC Secure OS"
    depends on TZIC
    default TZIC_USE_QSEECOM if QSEECOM
    default TZIC_USE_TZDEV if TZDEV
    default TZIC_USE_TRUSTONIC if TRUSTONIC_TEE || TRUSTONIC_TEE_SUPPORT
    default TZIC_DEFAULT
    ---help---
      Select Secure OS for TZIC

    config TZIC_USE_TRUSTONIC
        bool "TZIC based on Trustonic Secure OS"
        depends on TRUSTONIC_TEE || TRUSTONIC_TEE_SUPPORT
        ---help---
          Use Trustonic as base Trusted Execution Environment

    config TZIC_USE_TZDEV
        bool "TZIC based on TEEgris Secure OS"
        depends on TZDEV
        ---help---
          Use TEEgris as base Trusted Execution Environment

    config TZIC_USE_QSEECOM
        bool "TZIC based on Qualcomm Secure OS"
        depends on QSEECOM
        ---help---
          Use Qualcomm as base Trusted Execution Environment
    config TZIC_DEFAULT
        bool "TZIC Disabled"
        ---help---
          TZIC disabled
endchoice
```
