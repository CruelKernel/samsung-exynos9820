## drivers/nfc/nfc_logger/Kconfig
```kconfig
config SEC_NFC_LOGGER
	bool "NFC logger"
	default n
	---help---
	  Enable DISPLAYPORT logger.
```

## drivers/optics/Kconfig
```kconfig
#
# optics drivers configuration
#

config SENSORS_HRMSENSOR
	tristate "HRM Sensor Driver Common"
	default n
	depends on I2C
	help
	  If you say yes here you get support for the HRM sensor.
	  This feature is common feature for supporting HRM sensor.
	  This driver can also be built as a module.  If so, the module
	  will be called hrmsensor.

config SENSORS_HRM_MAX86915
	tristate "HRM Sensor Driver MAX86915"
	default n
	depends on SENSORS_HRMSENSOR
	help
	  If you say yes here you get support for the HRM sensor.
	  This driver should be set with SENSORS_HRMSENSOR.
	  This driver can also be built as a module.  If so, the module
	  will be called max86915.

config SENSORS_MAX86915
	tristate "HRM Sensor Driver MAX86915"
	default n
	depends on I2C
	help
	  If you say yes here you get support for the HRM sensor.
	  This driver can also be built as a module.  If so, the module
	  will be called max86915.

config SENSORS_TCS3407
	tristate "AMS TCS3407 MoBeam, RemCon, ALS, Proximity, Color, Flicker sensor"
	depends on I2C && SYSFS
	help
	  If you say yes here you get support for the AMS TCS3407
	  mobeam, ambient light, proximity, color, and flicker sensors.

	  This driver can also be built as a module.  If so, the module
	  will be called TCS3407.

config SENSORS_VD6281
	tristate "STM VD6281 ALS, Color, Flicker sensor"
	depends on I2C && SYSFS
	help
	  If you say yes here you get support for the STM VD6281
	  ambient light, color, and flicker sensors.

	  This driver can also be built as a module.  If so, the module
	  will be called VD6281.
```

## drivers/phy/samsung/Kconfig
```kconfig
#
# Phy drivers for Samsung platforms
#
config PHY_EXYNOS_DP_VIDEO
	tristate "EXYNOS SoC series Display Port PHY driver"
	depends on OF
	depends on ARCH_EXYNOS || COMPILE_TEST
	default ARCH_EXYNOS
	select GENERIC_PHY
	help
	  Support for Display Port PHY found on Samsung EXYNOS SoCs.

config PHY_EXYNOS_MIPI_VIDEO
	tristate "S5P/EXYNOS SoC series MIPI CSI-2/DSI PHY driver"
	depends on HAS_IOMEM
	depends on ARCH_S5PV210 || ARCH_EXYNOS || COMPILE_TEST
	select GENERIC_PHY
	default y if ARCH_S5PV210 || ARCH_EXYNOS
	help
	  Support for MIPI CSI-2 and MIPI DSI DPHY found on Samsung S5P
	  and EXYNOS SoCs.

config PHY_EXYNOS_PCIE
	bool "Exynos PCIe PHY driver"
	depends on OF && (ARCH_EXYNOS || COMPILE_TEST)
	select GENERIC_PHY
	help
	  Enable PCIe PHY support for Exynos SoC series.
	  This driver provides PHY interface for Exynos PCIe controller.

config PHY_SAMSUNG_USB2
	tristate "Samsung USB 2.0 PHY driver"
	depends on HAS_IOMEM
	depends on USB_EHCI_EXYNOS || USB_OHCI_EXYNOS || USB_DWC2
	select GENERIC_PHY
	select MFD_SYSCON
	default ARCH_EXYNOS
	help
	  Enable this to support the Samsung USB 2.0 PHY driver for Samsung
	  SoCs. This driver provides the interface for USB 2.0 PHY. Support
	  for particular PHYs will be enabled based on the SoC type in addition
	  to this driver.

config PHY_EXYNOS4210_USB2
	bool
	depends on PHY_SAMSUNG_USB2
	default CPU_EXYNOS4210

config PHY_EXYNOS4X12_USB2
	bool
	depends on PHY_SAMSUNG_USB2
	default SOC_EXYNOS3250 || SOC_EXYNOS4212 || SOC_EXYNOS4412

config PHY_EXYNOS5250_USB2
	bool
	depends on PHY_SAMSUNG_USB2
	default SOC_EXYNOS5250 || SOC_EXYNOS5420

config PHY_S5PV210_USB2
	bool "Support for S5PV210"
	depends on PHY_SAMSUNG_USB2
	depends on ARCH_S5PV210
	help
	  Enable USB PHY support for S5PV210. This option requires that Samsung
	  USB 2.0 PHY driver is enabled and means that support for this
	  particular SoC is compiled in the driver. In case of S5PV210 two phys
	  are available - device and host.

config PHY_EXYNOS5_USBDRD
	tristate "Exynos5 SoC series USB DRD PHY driver"
	depends on ARCH_EXYNOS && OF
	depends on HAS_IOMEM
	depends on USB_DWC3_EXYNOS
	select GENERIC_PHY
	select MFD_SYSCON
	default y
	help
	  Enable USB DRD PHY support for Exynos 5 SoC series.
	  This driver provides PHY interface for USB 3.0 DRD controller
	  present on Exynos5 SoC series.

config PHY_EXYNOS_USBDRD
	tristate "Exynos SoC series USB DRD PHY driver"
	depends on ARCH_EXYNOS && OF
	depends on HAS_IOMEM
	depends on USB_DWC3_EXYNOS
	select GENERIC_PHY
	select MFD_SYSCON
	default y
	help
	  Enable USB DRD PHY support for Exynos SoC series.
	  This driver provides PHY interface for USB 3.0 DRD controller
	  present on Exynos SoC series.

config PHY_EXYNOS_DEBUGFS
	tristate "Exynos SoC series USB DRD PHY DebugFS"
	depends on DEBUG_FS
	depends on PHY_EXYNOS_USBDRD
	select GENERIC_PHY
	default y
	help
	  Enable USB DRD PHY DEBUGFS support for Exynos SoC series.
	  This driver provides PHY debugging interface for USBDRD PHY controller
	  present on Exynos SoC series.

config PHY_EXYNOS_DP_DEBUGFS
	tristate "Exynos SoC series USB DRD DP PHY DebugFS"
	depends on DEBUG_FS
	depends on PHY_EXYNOS_DEBUGFS
	select GENERIC_PHY
	default y
	help
	  Enable USB DRD DP PHY DEBUGFS support for Exynos SoC series.
	  This driver provides PHY debugging interface for USBDRD DP PHY controller
	  present on Exynos SoC series.

config PHY_SAMSUNG_USB_CAL
	bool "Samsung USB PHY CAL"
	depends on PHY_EXYNOS_USBDRD
	default y
	help
	  Enable this to support CAL (Chip Abstraction Layer)
	  for Samsung USB PHY controller.

config PHY_SAMSUNG_USB_GEN2
	tristate "Exynos SoC series USB DRD PHY DebugFS"
	depends on PHY_SAMSUNG_USB_CAL
	depends on PHY_EXYNOS_USBDRD
	default y
	help
	  Support SAMSUNG USB3.1 GEN2 PHY.

config PHY_EXYNOS5250_SATA
	tristate "Exynos5250 Sata SerDes/PHY driver"
	depends on SOC_EXYNOS5250
	depends on HAS_IOMEM
	depends on OF
	select GENERIC_PHY
	select I2C
	select I2C_S3C2410
	select MFD_SYSCON
	help
	  Enable this to support SATA SerDes/Phy found on Samsung's
	  Exynos5250 based SoCs.This SerDes/Phy supports SATA 1.5 Gb/s,
	  SATA 3.0 Gb/s, SATA 6.0 Gb/s speeds. It supports one SATA host
	  port to accept one SATA device.

config PHY_EXYNOS_MIPI
	tristate "Samsung EXYNOS SoC MIPI CSI/DSI D/C-PHY driver"
	depends on HAS_IOMEM
	depends on ARCH_EXYNOS && OF || COMPILE_TEST
	select GENERIC_PHY
	help
	  Support for MIPI CSI and MIPI DSI DPHY found on Samsung
	  and EXYNOS SoCs.

config PHY_EXYNOS_DISPLAYPORT
	tristate "Samsung EXYNOS SoC DISPLAYPORT PHY driver"
	depends on HAS_IOMEM
	depends on ARCH_EXYNOS && OF || COMPILE_TEST
	select GENERIC_PHY
	help
	  Support for DISPLAYPORT PHY found on Samsung
	  and EXYNOS SoCs.
```

## drivers/pinctrl/cirrus/Kconfig
```kconfig
config PINCTRL_MADERA
	bool
	select PINMUX
	select GENERIC_PINCONF
	default y if MFD_MADERA=y

config PINCTRL_CS47L15
	bool

config PINCTRL_CS47L35
	bool

config PINCTRL_CS47L85
	bool

config PINCTRL_CS47L90
	bool

config PINCTRL_CS47L92
	bool
```

## drivers/redriver/Kconfig
```kconfig
#
# Combo redriver  devices
#

comment "Combo driver configs"

config COMBO_REDRIVER_PTN36502
	bool "ptn36503 support"
	depends on I2C
	default n
	help
	  If you say yes here you will get support for
	  the CCIC attached device status change notification.
```

## drivers/samsung/Kconfig
```kconfig
# drivers/samsung/Kconfig
#
# Copyright (c) 2010-2011 Samsung Electronics Co., Ltd.
#		http://www.samsung.com/
#
# Licensed under GPLv2

config SEC_EXT
	bool "Samsung TN extension Feature"
	default y

config SEC_REBOOT
	bool "Enable TN reboot features"
	depends on SEC_EXT
	default y
	help
	  Samsung TN reboot extension Feature. Do additional work when reboot.

comment "Samsung sysfs Feature"
config DRV_SAMSUNG
	bool "Samsung sec class/sysfs Feature"
	default y
	depends on SEC_EXT
	help
	  Samsung sysfs name 'sec' directory create.

config SEC_PARAM
	bool "Enable Param modification"
	depends on SEC_DEBUG
	default y
	help
	  Samsung TN Param Feature.

config CM_OFFSET
	int "Charging Mode Offset"
	default 0
	depends on SEC_PARAM
	help
	  set Charging Mode Offset when you enable SEC_PARAM.

config WC_OFFSET
	int "Wireless Charging IC Offset"
	default 0
	depends on SEC_PARAM
	help
	  set Wireless Charging IC Info Offset.

config FMM_LOCK_OFFSET
	int "FMM lock Offset"
	default 0
	depends on SEC_PARAM
	help
	  set FMM lock Offset when you enable SEC_PARAM.

config SEC_KEY_NOTIFIER
	bool "Enable Samsung key event notifier"
	depends on SEC_EXT
	default y
	help
	  Samsung Key input event notifier

comment "Samsung TN Build Options"
config SEC_FACTORY
	bool "SAMSUNG Factory build option"
	depends on SEC_EXT && SEC_DEBUG
	default n
	select SEC_PANIC_PCIE_ERR
	help
	  Include some codes for Factory binary.
	  This option is enabled by Factory build option.
	  In samsung build script, '-F' enables this option.

comment "Samsung TN BSP Options"
config SAMSUNG_PRODUCT_SHIP
	bool "set up for product shipping"
	depends on SEC_EXT
	default n

comment "Samsung TN option for VTS test"
config SEC_VTS_TEST
	bool "VTS TEST"
	default n
	help
	  This option notices this binary for VTS test.

config SEC_DUMP_SINK
	bool "Enable to dump_sink"
	default y
	help
	  This option enables dump_sink.

source "drivers/samsung/debug/Kconfig"
source "drivers/samsung/misc/Kconfig"
```

## drivers/samsung/debug/Kconfig
```kconfig
# drivers/samsung/debug/Kconfig
#
# Copyright (c) 2010-2011 Samsung Electronics Co., Ltd.
#		http://www.samsung.com/
#
# Licensed under GPLv2

menuconfig SEC_DEBUG
	bool "Enable TN debugging features"
	depends on DEBUG_SNAPSHOT && SEC_REBOOT
	default y

config SEC_DEBUG_RESET_REASON
	bool "Enable TN reset reason"
	depends on SEC_DEBUG
	default y
	help
	  This option enables storing reset reason history file
	  This option enables reading the reset reason history using proc/reset_reason file

config SEC_DEBUG_EXTRA_INFO
	bool "Enable TN reset reason extra info"
	depends on SEC_DEBUG && SEC_DEBUG_RESET_REASON
	default y
	help
	  This option enables storing reset reason extra info
	  This option enables ap reset info bigdata based on reset reason extra info

config SEC_DEBUG_HW_PARAM
	bool "Enable TN HW PARAM bigdata info"
	depends on SEC_DEBUG && SEC_DEBUG_RESET_REASON
	default y
	help
	  This option enables storing hw param bigdata info

config SEC_DEBUG_AUTO_COMMENT
	bool "Enable TN kernel fault auto comment"
	depends on SEC_DEBUG
	default y
	help
	  This option enables kernel fault auto comment feature
	  This option also requires bootloader change that enables auto comment extraction along with ramdump

config SEC_DEBUG_DUMP_SUMMARY
	bool "Enable TN kernel fault dump summary"
	depends on SEC_DEBUG
	default y
	help
	  This option enables kernel fault dump summary feature
	  This option also requires bootloader change that enables dump summary extraction along with ramdump

config SEC_DEBUG_LAST_KMSG
	bool "Write last_kmsg at /proc/last_kmsg"
	depends on SEC_DEBUG
	default y
	help
	  This option enables /proc/last_kmsg support. This stores the previous
	  kernel log into separate buffer. /proc/last_kmsg shows the stored log.

config SEC_DEBUG_PPMPU
	bool "Print ppmpu inforamtion by smc call"
	depends on SEC_DEBUG
	default n
	help
	  This option enables the kernel to print out ppmpu information when
	  kernel oops. El3 monitor supports smc calls for this option.

config SEC_DEBUG_INIT_LOG
	bool "support hooking of init task log"
	depends on SEC_DEBUG
	default y
	help
	  This option enables hooking of init task log. 
	  It can be used for debugging purpose in case of booting failure or something else.

config SEC_DEBUG_HIST_LOG
	bool "support storing debug history log"
	depends on SEC_DEBUG
	default y
	help
	  This option enables to store debug history log.

config SEC_DEBUG_LIMIT_BACKTRACE
	bool "Forcely break infinity backtrace"
	depends on SEC_DEBUG
	default y
	help
	  This option kick watchdog reset timer forcely in case of infinity backtrace.
	  It can be used for debugging purpose to find why infinicy bactrace occurs.

config SEC_DEBUG_AVOID_UNNECESSARY_TRAP
	bool "support avoiding unnecessary trap"
	depends on SEC_DEBUG
	default y
	help
	 This option helps to obtain normal log by avoiding unnessary trap again 
	 after exception handling

config SEC_DEBUG_FIRST_KMSG
	bool "support storing initial 2M kernel log"
	depends on SEC_DEBUG
	default y
	help
	  This option enables hooking of initial 2M kernel log.
 	  It can be used for debugging purpose in case of booting failure or something else.

config SEC_DEBUG_DTASK
	bool "support uninterruptible sleep task debugging"
	depends on SEC_DEBUG
	default y
	help
	  This option enables getting information of task with TASK_UNINTERRUPTIBLE.

config SEC_DEBUG_SYSRQ_KMSG
	bool "support storing last n lines of kmsg before Sysrq trigger"
	depends on SEC_DEBUG
	default y
	help
	  This option enables storing last n lines of kmsg before Sysrq triggered.
 	  It can be used for debugging purpose in case of Sysrq triggered.

comment "Samsung ubsan debug feature"
config SEC_DEBUG_UBSAN
	bool "Enable ubsan debug feature"
	default n
	help
	  This option enables ubsan debug feature.

comment "Samsung kasan debug feature"
config SEC_DEBUG_KASAN
	bool "Enable kasan debug feature"
	default n
	help
	  This option enables kasan debug feature.

config SEC_BOOTSTAT
	bool "Enable TN Bootstat logging"
	depends on SEC_EXT
	default y

config SEC_DEBUG_PWDT
	bool "Platform Watchdog"
	default n
	help
	  Samsung Platform lockup detection

config SEC_DEBUG_HIDING
	bool "hide some from kernel command line"
	default y
	help
	  Hide some string in kernel command line

config SEC_DEBUG_SPINBUG_PANIC
	bool "Panic on spin bug"
	depends on DEBUG_SPINLOCK
	default y
	help
	  This option enables the kernel to panic on "spin bug"
	  
config SEC_DEBUG_WORKQUEUE_LOCKUP_PANIC
	bool "Bug on workqueue lockup"
	depends on SEC_DEBUG && WQ_WATCHDOG
	default y
	help
	  This option enables the kernel to panic on workqueue lockup

config SEC_DEBUG_SOFTDOG_PWDT
	bool "Enable Soft Watchdog for Platform"
	default y
	depends on WATCHDOG
	select SOFT_WATCHDOG
	help
	  This option enables soft watchdog device and soft_panic.
```
