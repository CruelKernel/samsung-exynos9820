## drivers/video/fbdev/exynos/panel/Kconfig
```kconfig
config EXYNOS_DECON_LCD
	depends on EXYNOS_DECON_8895 || EXYNOS_DECON_9810 || CONFIG_EXYNOS_DPU20
	bool "Select LCD panel driver"

config EXYNOS_DECON_MDNIE_LITE
	depends on EXYNOS_DECON_LCD
	tristate "Support MDNIE LITE"
	default n

config SUPPORT_AFC
	depends on EXYNOS_DECON_LCD && EXYNOS_DECON_MDNIE_LITE
	tristate "Support AFC"
	default n

config SUPPORT_ISC_TUNE_TEST
	depends on EXYNOS_DECON_LCD
	tristate "Support ISC TUNE TEST"
	default n

config EXYNOS_DECON_LCD_SYSFS
	depends on EXYNOS_DECON_LCD
	tristate "Support LCD SYSFS"
	default y

config EXYNOS_DECON_LCD_SPI
	depends on EXYNOS_DECON_LCD
	tristate "Support LCD SPI"
	default n

config EXYNOS_DECON_LCD_COPR
	depends on EXYNOS_DECON_LCD
	tristate "Support COPR"
	default n

config EXYNOS_DECON_LCD_TUNING
	depends on EXYNOS_DECON_LCD
	tristate "Support LCD TUNING"
	default n

config EXYNOS_LCD_ENG
	depends on EXYNOS_DECON_LCD
	tristate "Support LCD featue on ENG binary"
	default n

config PANEL_AID_DIMMING
	depends on EXYNOS_DECON_LCD
	tristate "Support AID Dimming"
	default y

config PANEL_AID_DIMMING_DEBUG
	depends on PANEL_AID_DIMMING
	depends on !SAMSUNG_PRODUCT_SHIP
	tristate "Support AID Dimming Debug"
	default y

config SUPPORT_DSU
	tristate "Support DSU(Multi Resolution)"
	depends on EXYNOS_DECON_LCD
	default n

config SUPPORT_HMD
	tristate "Support HMD(Head Mount Display - VR)"
	depends on EXYNOS_DECON_LCD
	default n

config EXTEND_LIVE_CLOCK
	tristate "Support Extend Live Clock Functions(For Always On Display)"
	depends on EXYNOS_DECON_LCD
	default n

config SUPPORT_AOD_BL
	depends on EXYNOS_DECON_LCD && SUPPORT_DOZE
	tristate "Support AOD(Active On Display) BL(BackLight) Driver"
	default n

config SUPPORT_DISPLAY_PROFILER
    	depends on EXYNOS_DECON_LCD
    	tristate "Support Display Profiler"
    	default n

config EXYNOS_DECON_LCD_S6E3HF3
	depends on EXYNOS_DECON_LCD && EXYNOS_MIPI_DSIM
	tristate "S6E3HF3 AMOLED LCD DRIVER"

config EXYNOS_DECON_LCD_S6E3HF4
	depends on EXYNOS_DECON_LCD && EXYNOS_MIPI_DSIM
	tristate "S6E3HF4 AMOLED WQHD LCD driver(1440 x 2560)"

config EXYNOS_DECON_LCD_S6E3HA6
	depends on EXYNOS_DECON_LCD && EXYNOS_MIPI_DSIM
	tristate "S6E3HA6 AMOLED LCD DRIVER"

config EXYNOS_DECON_LCD_S6E3HA8
	depends on EXYNOS_DECON_LCD && EXYNOS_MIPI_DSIM
	tristate "S6E3HA8 AMOLED LCD DRIVER"

config EXYNOS_DECON_LCD_S6E3HA9
	depends on EXYNOS_DECON_LCD && EXYNOS_MIPI_DSIM
	tristate "S6E3HA9 AMOLED LCD DRIVER"

config EXYNOS_DECON_LCD_S6E3FA7
	depends on EXYNOS_DECON_LCD && EXYNOS_MIPI_DSIM
	tristate "S6E3FA7 AMOLED LCD DRIVER"

config ACTIVE_CLOCK
	depends on EXYNOS_DECON_LCD && SUPPORT_DOZE
	tristate "Support DDI Active Clock Feature"
	default n

config SUPPORT_DDI_FLASH
	depends on EXYNOS_DECON_LCD
	tristate "Support display ddi flash"
	default n

config SUPPORT_POC_FLASH
	depends on EXYNOS_DECON_LCD && SUPPORT_DDI_FLASH
	tristate "Support display poc flash"
	default n

config SUPPORT_DIM_FLASH
	depends on EXYNOS_DECON_LCD && SUPPORT_DDI_FLASH
	tristate "Support display dimming flash"
	default n

config SUPPORT_GRAM_CHECKSUM
	depends on EXYNOS_DECON_LCD
	tristate "Support GRAM Checksum"
	default n

config SUPPORT_CCD_TEST
	depends on EXYNOS_DECON_LCD
	tristate "Support CCD TEST"
	default n

config SUPPORT_DYNAMIC_HLPM
	depends on EXYNOS_DECON_LCD && SUPPORT_DOZE
	tristate "Support Dynamic HLPM TEST"
	default n

config SUPPORT_TDMB_TUNE
	depends on EXYNOS_DECON_LCD && TDMB_NOTIFIER
	tristate "Support TDMB Tuning"
	default y

config PANEL_BACKLIGHT_PAC_3_0
	depends on EXYNOS_DECON_LCD
	tristate "Support baclight PAC 3.0"
	default n

config DISPLAY_USE_INFO
	depends on EXYNOS_DECON_LCD
	tristate "Support display use info logging"
	default n

config PANEL_NOTIFY
	depends on EXYNOS_DECON_LCD
	tristate "Support panel notifier"
	default y

config SUPPORT_POC_SPI
	depends on EXYNOS_DECON_LCD
	tristate "Support poc SPI connection"
	default n
	
config DYNAMIC_FREQ
    	depends on EXYNOS_DECON_LCD
    	tristate "Support Dynamic Freq"
    	default n
```

## drivers/vision/Kconfig
```kconfig
menuconfig VISION_SUPPORT
	bool "Vision Support"
	select VISION_CORE
	select VIDEOBUF2_DMA_SG
	help
	  If you want to use hardware acceleration for vision
	  enable this option and other options below.

if VISION_SUPPORT

source "drivers/vision/vision-core/Kconfig"

source "drivers/vision/npu/Kconfig"

source "drivers/vision/score/Kconfig"

source "drivers/vision/iva/Kconfig"

endif # VISION_SUPPORT
```

## drivers/vision/iva/Kconfig
```kconfig
config EXYNOS_IVA
	bool "samsung IVA driver support"
	default n
	help
		Enable samsung iva driver

config IVA_VER
	int "version information of IVA vision IP"
	default 30
	help
	  user only for IVA FPGA
```

## drivers/vision/npu/Kconfig
```kconfig
menuconfig EXYNOS_NPU
	bool "Exynos NPU driver (TEST)"
	depends on VISION_CORE
	help
		Exynos NPU Test device driver

menuconfig EXYNOS_NPU_DRAM_FW_LOG_BUF
	bool "DRAM buffer for firmware test and debugging"
	depends on EXYNOS_NPU
	default y
	help
		When this option is enabled, 1MB buffer will be reserved at the start of
		device virtual address space to support firmware test and debugging.

menuconfig EXYNOS_NPU_PUBLISH_NPU_BUILD_VER
	bool "Print out update log on initialization."
	depends on EXYNOS_NPU
	default n
	help
		When this option is enabled, last git log messages and stash information
		is printed on NPU initialization, to track source code update.

menuconfig EXYNOS_NPU_DEBUG_SRAM_DUMP
	bool "SRAM dump interface"
	depends on EXYNOS_NPU
	default n
	help
		When this option is enabled, SRAM dump file is created on debugfs
		and the SRAM can be dumpted.

if EXYNOS_NPU

#config NPU_KANGCHEN
#bool "NPU_KANGCHEN"

#config NPU_MAKALU
#bool "NPU_MAKALU"

#if NPU_MAKALU
if (SOC_EMULATOR9820 || SOC_EXYNOS9820)

config NPU_ZEBU_EMULATION 
bool
default n

config NPU_GOLDEN_MATCH
bool
default y

config NPU_ZEBU_SYSMMU
bool
default y

config FIRMWARE_SRAM_DUMP_DEBUGFS
bool
default y

endif

source "drivers/vision/npu/interface/Kconfig"

endif
```

## drivers/vision/npu/interface/Kconfig
```kconfig
config NPU_INTERFACE
	bool "Select Interface"
	help
	  This is NPU interface

config NPU_LOOPBACK
	bool "Use Loopback"
	depends on NPU_INTERFACE
	help
	  This is loopback device

config NPU_HARDWARE
	bool "Use Hardware"
	depends on NPU_INTERFACE
	help
	  This is hardware device
```

## drivers/vision/score/Kconfig
```kconfig
config EXYNOS_SCORE
	bool "Samsung EXYNOS SCore common driver"
	depends on ARCH_EXYNOS

config EXYNOS_SCORE_V2
	bool "Samsung EXYNOS9810 SCore driver"
	depends on SOC_EXYNOS9810
	depends on EXYNOS_SCORE

config EXYNOS_SCORE_V3
	bool "Samsung EXYNOS9820 SCore driver"
	depends on SOC_EXYNOS9820
	depends on EXYNOS_SCORE
```

## drivers/vision/vision-core/Kconfig
```kconfig
config VISION_CORE
        bool "Vision Core"
        help
          This is a vision core

menuconfig VISION_UNITTEST
        bool "Build unittest for Vision"
        depends on VISION_CORE
        help
                Include unittest code into the vision-core
```

## fs/crypto/Kconfig
```kconfig
config FS_ENCRYPTION
	tristate "FS Encryption (Per-file encryption)"
	select CRYPTO
	select CRYPTO_AES
	select CRYPTO_CBC
	select CRYPTO_ECB
	select CRYPTO_XTS
	select CRYPTO_CTS
	select CRYPTO_CTR
	select CRYPTO_SHA256
	select KEYS
	help
	  Enable encryption of files and directories.  This
	  feature is similar to ecryptfs, but it is more memory
	  efficient since it avoids caching the encrypted and
	  decrypted pages in the page cache.

config FS_CRYPTO_SEC_EXTENSION
	bool "FS crypto extension for Samsung Mobile"
	default n
	depends on FS_ENCRYPTION
	help
	  This option enable the cc certification logic for file based encryption.

config FS_INLINE_ENCRYPTION
	bool "Enable inline encryption"
	depends on FS_ENCRYPTION
	depends on BLK_DEV_CRYPT
	default y
	help
	  This option enables inline encryption to support inline crypto H/W.

config FSCRYPT_SDP
	bool "Sensitive Data Protection for Per-file-encryption"
	depends on FS_ENCRYPTION
	depends on SDP
	help
	  Enable SDP functional to fscrypto module.
	  This feature is supporting "Data-At-Rest" for file systems using
	  Per-file-encryption being controlled by SDP user status.
```

## fs/sdcardfs/Kconfig
```kconfig
config SDCARD_FS
	tristate "sdcard file system"
	depends on CONFIGFS_FS
	default y
	help
	  Sdcardfs is based on Wrapfs file system.

config SDCARD_FS_FADV_NOACTIVE
	bool "sdcardfs fadvise noactive support"
	depends on FADV_NOACTIVE
	default y
	help
	  Sdcardfs supports fadvise noactive mode.

config SDCARD_FS_SUPPORT_KNOX
	bool "sdcardfs support for Knox"
	depends on SDCARD_FS
	default y if ANDROID_VERSION < "110000"
	help
	  Sdcardfs supports Knox until the platform version 10.
```

## kernel/Kconfig.intelligence
```kconfig
menu "Intelligence"

config INTELLIGENCE
	bool "Intelligent Resource Management"
	default y
	---help---
	  Enable support for the Intelligence platform

endmenu
```

## net/ncm/Kconfig
```kconfig
#
# Network Context Module Configuration
#

config KNOX_NCM
  tristate "Network Context Module Support"
  depends on NET
  default y
```

## security/mstdrv/Kconfig
```kconfig
# @file Kconfig
# @brief Kconfig for MST drivers
# Copyright (c) 2015, Samsung Electronics Corporation. All rights reserved.
#
# This program is free software; you can redistribute it and/or modify
# it under the terms of the GNU General Public License version 2 and
# only version 2 as published by the Free Software Foundation.
#
# This program is distributed in the hope that it will be useful,
# but WITHOUT ANY WARRANTY; without even the implied warranty of
# MERCHANTABILITY or FITNESS FOR A PARTICULAR PURPOSE.  See the
# GNU General Public License for more details.

config MST_LDO
	bool "MST LDO kernel driver"
	default n
	help
	This enables the MST LDO kernel driver

config MST_SUPPORT_GPIO
	bool "MST uses support gpio"
	default n
	help
	This enables support gpio check code

config MST_NONSECURE
	bool "MST before TrustZone bringup"
	default n
	help
	This enables the MST operation in Normal kernel

config MST_IF_PMIC
	bool "MST is used in IF PMIC"
	default n
	help
	This enables the MST IF PMIC function

config MFC_CHARGER
	bool "MFC IC using model"
	default n
	help
	This enables the MFC IC sysfs node

config MFC_LDO_COMMAND
	bool "I2C patch for LDO on MFC IC IDT chip"
	default n
	help
	This enables the IDT patch for LDO on MFC IC IDT chip

config MST_TEEGRIS
	bool "MST running on TEEGRIS"
	default n
	help
	This enables the MST TEEGRIS function

config MST_LPM_CONTROL
	bool "MST control LPM mode for performace"
	default n
	help
	This enables the MST LPM control code
```

## security/proca/Kconfig
```kconfig
#
# PROCA feature configuration
#

config PROCA
	bool "Process Authenticator"
	depends on FIVE
	default n
	help
	   Enable Process Authenticator

config PROCA_DEBUG
	bool "PROCA Debug mode"
	depends on PROCA && !SAMSUNG_PRODUCT_SHIP
	default y
	help
	   Enable the debug mode in the PROCA. When this option is enabled
	   PROCA driver creates file /proc/<pid>/integrity/proca_certificate
	   which contains hex representation of binary proca certificate. It
	   might be used to check existence of task descriptor for some task
	   in proca table.
```

## security/samsung/defex_lsm/Kconfig
```kconfig
config SECURITY_DEFEX
	bool "Defex Support"
	depends on SECURITY && (!KCOV || SAMSUNG_PRODUCT_SHIP)
	select CRYPTO
	select CRYPTO_RSA
	select CRYPTO_SHA1
	select CRYPTO_SHA256
	select CRYPTO_HASH_INFO
	select INTEGRITY_SIGNATURE
	select INTEGRITY_ASYMMETRIC_KEYS
	default n
	help
	  This selects the Defex support.
	  If you are unsure how to answer this question, answer N.

config DEFEX_KERNEL_ONLY
	bool "Defex Kernel Only"
	depends on SECURITY_DEFEX
	default y
	help
	  This lets defex know whether kernel-only build or not.
	  Default value will be set to "y" if the build is kernel-only.
	  And it will be changed to "n" by build.py at platform-build.
```
