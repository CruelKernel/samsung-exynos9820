## drivers/staging/sti/abc/Kconfig
```kconfig
comment "Samsung ABC Options"
config SEC_ABC
	bool "Samsung ABC Feature"
	depends on SEC_STI
	default n
	help
	  Samsung ABC(Abnormal Behavior Catcher) Driver Feature
	  This driver is to catch abnormal behavior in each device drivers
	  It depends on SEC_STI Feature

comment "Samsung ABC Hub Options"
config SEC_ABC_HUB
	bool "Samsung ABC Hub Feature"
	depends on SEC_ABC
	default n
	help
	  Samsung ABC(Abnormal Behavior Catcher) Hub Driver Feature
	  This driver controls sub modules for supporting ABC Driver
	  It depends on SEC_ABC Feature

comment "Samsung ABC Hub Connect Detect Options"
config SEC_ABC_HUB_COND
	bool "Samsung ABC Hub Connect Detect Feature"
	depends on SEC_ABC_HUB
	depends on !SEC_FACTORY
	default n
	help
	  Samsung COND(Connect Detect) Feature
	  This function is to detect connect h/w problem
	  It is sub module of ABC Hub Driver
	  It depends on SEC_ABC_HUB Feature

comment "Samsung ABC Hub Booting Time Check Options"
config SEC_ABC_HUB_BOOTC
	bool "Samsung ABC Hub Booting Time Check Feature"
	depends on SEC_ABC_HUB
	default n
	help
	  Samsung BOOTC(Booting Time Check) Feature
	  This function is to check booting time
	  It is sub module of ABC Hub Driver
	  It depends on SEC_ABC_HUB Feature

comment "Samsung ABC Hub Booting Time Check eng mode Options"
config SEC_ABC_HUB_BOOTC_ENG
	bool "Samsung ABC Hub Booting Time Check eng mode Feature"
	depends on SEC_ABC_HUB_BOOTC
	default n
	help
	  Samsung BOOTC(Booting Time Check) eng mode Feature
	  This function is to apply eng binary booting time spec
	  It depends on SEC_ABC_HUB_BOOTC Feature
```

## drivers/thermal/samsung/Kconfig
```kconfig
config EXYNOS_THERMAL
	tristate "Exynos thermal management unit driver"
	depends on THERMAL_OF
	depends on HAS_IOMEM
	help
	  If you say yes here you get support for the TMU (Thermal Management
	  Unit) driver for SAMSUNG EXYNOS series of SoCs. This driver initialises
	  the TMU, reports temperature and handles cooling action if defined.
	  This driver uses the Exynos core thermal APIs and TMU configuration
	  data from the supported SoCs.

config EXYNOS_ACPM_THERMAL
	bool
	prompt "Exynos ACPM TMU plug-in support"
	depends on EXYNOS_THERMAL
	help
	  This feature supports ACPM TMU plug-in for Exynos thermal driver.
```

## drivers/usb/manager/Kconfig
```kconfig
#
# USB TypeC Manager driver
#

comment "USB TypeC Manager configs"

config USB_TYPEC_MANAGER_NOTIFIER
    bool "USB TypeC Manager driver"
    help
    If you say yes here you will get support for
      USB TypeC Manager function
```

## drivers/usb/notify/Kconfig
```kconfig
#
# USB notify configuration
#

comment "USB Notify features"
config USB_HOST_NOTIFY
	boolean "USB Host notify Driver"
	depends on USB_NOTIFY_LAYER
	help
	  Android framework needs uevents for usb host operation.
	  Host notify Driver serves uevent format
	  that is used by usb host or otg.

config USB_NOTIFY_LAYER
	boolean "USB notify layer"
	depends on USB
	help
	  Added usb notify layer on gadget,host,otg drivers.
          The usb notify layer controls otg mode and vbus draw
          and vbus detect irq.

config USB_NOTIFIER
	boolean "USB notifier"
	depends on USB_NOTIFY_LAYER
	help
	  Added platform driver to call usb notify.
	  The usb_notifier.c can be fixed for each models.

config USB_DEBUG_DETAILED_LOG
	boolean "USB detailed log for debugging"
	depends on USB
	help
	  Add detailed log for debugging.

config USB_STORAGE_DETECT
	boolean "USB storage detect function"
	depends on USB && SCSI
	depends on USB_STORAGE
	help
	  This feature enables to detect inserting or removing
          sd card in sd reader device.
          This must to be defined in /usb/storage/Kconfig 
          directory originally. But this feature is defined
          in this Kconfig to gather samsung feature about usb host.

config USB_HMT_SAMSUNG_INPUT
	boolean "USB HMT inputs for samsung hmt devices"
	depends on HID
	help
	  Some samsung smart phones support gear vr.
          The samsung gear vr need some special hid input codes.
          This feature enables special hid input codes.

config USB_EXTERNAL_NOTIFY
	boolean "USB external notify"
	depends on USB_NOTIFY_LAYER
	help
	  Added usb external notify.
	  The usb external notify broadcast special situation
	  to muic and charger.

config USB_NOTIFY_PROC_LOG
	boolean "USB proc log"
	depends on USB_NOTIFY_LAYER
	depends on USB_HOST_NOTIFY
	help
	  Added proc usblog.
	  The USB STATE, The USB MODE, Cable event 
	  are saved in usblog heap.

config USB_HOST_SAMSUNG_FEATURE
	boolean "USB Host Samsung Feature"
	depends on USB
	help
	  USB Host Samsung Feature.
	  It is different from LSI BSP code.

config USB_HW_PARAM
    	boolean "USB H/W Parameter"
    	depends on USB_NOTIFY_LAYER
    	help
      	  Added USB H/W Parameter for DQA Agent.
          You need more works for USB PDIC driver.

config USB_PORT_POWER_OPTIMIZATION
	default n
	bool "USB3.0 Link port power optimization"

config USB_INTERFACE_LPM_LIST
        boolean "USB interface class lpm Feature"
        depends on USB
        help
          The device needs to support L1 for audio class devices
          But L1 mode has some issues. 
	  So we will apply L1 mode to the device that has specific interface classes

config USB_AUDIO_ENHANCED_DETECT_TIME
	bool "USB audio enhanced detect time"
	depends on USB_NOTIFY_LAYER
	help
	  Added uevent for usb audio device(bundle)
	  uevent includes path, card number, vid, pid
	  The usb framework gets this uevent.
	  It is made by samsung.
```

## drivers/video/fbdev/exynos/Kconfig
```kconfig
if SOC_EXYNOS9820 || SOC_EXYNOS9810

source "drivers/video/fbdev/exynos/dpu20/Kconfig"
source "drivers/video/fbdev/exynos/panel/Kconfig"

endif # SOC_EXYNOS9820
```

## drivers/video/fbdev/exynos/dpu20/Kconfig
```kconfig
config EXYNOS_DPU20
	bool "Samsung Exynos Display Sub-system (DPP, DECON, MIPI, DISPLAYPORT)"
	default n
	depends on FB

if EXYNOS_DPU20
config EXYNOS_DPP
	bool "Samsung Exynos Display Post Processor driver"
	depends on EXYNOS_DPU20
	default y

config EXYNOS_MIPI_DSIM
	bool "Samsung Exynos MIPI-DSI driver"
	depends on EXYNOS_DPU20
	default y
	help
	  Enable MIPI-DSI driver.

config EXYNOS_DISPLAYPORT
	bool "Samsung Exynos DISPLAYPORT driver"
	depends on EXYNOS_DPU20
	default n
	help
	  Enable DISPLAYPORT driver.

config DISPLAYPORT_DEX_FORCE_WQHD
	bool "Force WQHD in DEX"
	depends on EXYNOS_DISPLAYPORT
	default n
	help
	  Force WQHD mode in dex_adapter_type.

config EXYNOS_WINDOW_UPDATE
        bool "Support Window Update Mode"
        depends on EXYNOS_DPU20
        default n

config EXYNOS_BLOCK_MODE
	bool "Support Blocking Mode"
        depends on EXYNOS_DPU20
        default y

config EXYNOS_HIBERNATION
	bool "Support Display Hibernation Mode"
        depends on EXYNOS_DPU20
        default n

config EXYNOS_CHANGE_HIBER_CNT
	bool "Change Hibernation Entry Count at Runtime"
        depends on EXYNOS_DPU20 && EXYNOS_HIBERNATION
        default n

config EXYNOS_HIBERNATION_THREAD
	bool "DECON hiber mode using single thread"
        depends on EXYNOS_HIBERNATION
        default n

config LOGGING_BIGDATA_BUG
	bool "Logging extra information when decon bug"
	depends on EXYNOS_DPU20
	default y

config EXYNOS_DOZE
	bool "Support DOZE mode"
        depends on EXYNOS_DPU20
        default n

config EXYNOS_AFBC_DEBUG
	bool "Support AFBC Decoder Debug"
        depends on EXYNOS_DPU20
        default n

config EXYNOS_MEMMAP_DEBUG
	bool "Support Memory Map Debug"
        depends on EXYNOS_DPU20
        default n

config EXYNOS_MULTIRESOLUTION
	bool "Support Multi Resolution LCD"
	depends on EXYNOS_DPU20 && EXYNOS_WINDOW_UPDATE
	default n

config EXYNOS_VIRTUAL_DISPLAY
	bool "Support Virtual Display Mode"
	depends on EXYNOS_DPU20
	default n
	help
	  If this menu is enabled, you can boot up board without LCD.

config EXYNOS_LOW_PERSISTENCE
	bool "Support Low Persistence Mode"
        depends on EXYNOS_DPU20
	default n

config SUPPORT_DOZE
	bool "Suppot Doze mode to aod service"
	depends on EXYNOS_DPU20
	default n

config EXYNOS_CURSOR
	bool "Support Cursor Async Mode"
        depends on EXYNOS_DPU20
	default n

config EXYNOS_DSIM_DITHER
	bool "DSIM SSCG feature"
        depends on EXYNOS_MIPI_DSIM
        default y

config EXYNOS_ADAPTIVE_FREQ
    bool "Feature for Dsim Adaptive Frequence"
        depends on EXYNOS_MIPI_DSIM
        default n

config DECON_BTS_LEGACY
	bool "Legacy BTS scheme of display"
        depends on EXYNOS_DPU20
        default n

config FB_TEST
	bool "Framebuffer test only"
        depends on EXYNOS_DPU20
        default n

config DSIM_CMD_TEST
	bool "DSIM command test only"
        depends on EXYNOS_DPU20
        default n

config SUPPORT_LEGACY_ION
	bool "Support legacy ION API"
        depends on EXYNOS_DPU20
        default n

config SUPPORT_LEGACY_FENCE
	bool "Support legacy fence API"
        depends on EXYNOS_DPU20
        default n

config SUPPORT_KERNEL_4_9
	bool "Support kernel version 4.9"
        depends on EXYNOS_DPU20
        default n

config EXYNOS_FREQ_HOP
	bool "Support DPHY PLL Frequency Hopping"
        depends on EXYNOS_DPU20
        default n

config SUPPORT_RDX_DUMP
        bool "Support RDX Dump"
        depends on EXYNOS_DPU20
        default n

config EXYNOS_PLL_SLEEP
	bool "Support DPHY PLL Sleep"
        depends on EXYNOS_DPU20
        default n

config AVOID_TSP_NOISE
    bool "Tune disp clock to avoid tsp noise"
        depends on EXYNOS_DPU20
        default n
endif

source "drivers/video/fbdev/exynos/dpu20/panels/Kconfig"
source "drivers/video/fbdev/exynos/dpu20/dp_logger/Kconfig"
source "drivers/video/fbdev/exynos/dpu20/mcd_hdr/Kconfig"
```

## drivers/video/fbdev/exynos/dpu20/dp_logger/Kconfig
```kconfig
config SEC_DISPLAYPORT_LOGGER
	bool "DISPLAYPORT logger"
	default n
	---help---
	  Enable DISPLAYPORT logger.

config SEC_DISPLAYPORT_BIGDATA
	bool "DISPLAYPORT bigdata"
	depends on !SEC_FACTORY
	default n
	---help---
	  Enable DISPLAYPORT bigdata.
```

## drivers/video/fbdev/exynos/dpu20/mcd_hdr/Kconfig
```kconfig
config EXYNOS_MCD_HDR
    bool "Support MCD HDR10+"
    default n
    depends on EXYNOS_DPU20
```

## drivers/video/fbdev/exynos/dpu20/panels/Kconfig
```kconfig
config EXYNOS_DECON_LCD
	depends on EXYNOS_DPU20
	bool "Select LCD panel driver"

config EXYNOS_COMMON_PANEL
	depends on EXYNOS_DECON_LCD && EXYNOS_MIPI_DSIM
	tristate "Paenl driver for TN(1440 x 2560)"
	default y

config EXYNOS_DECON_LCD_S6E3HA2K
	depends on EXYNOS_DECON_LCD && EXYNOS_MIPI_DSIM
	tristate "S6E3HA2K AMOLED WQHD LCD driver(1440 x 2560)"

config EXYNOS_DECON_LCD_S6E3HF4
	depends on EXYNOS_DECON_LCD && EXYNOS_MIPI_DSIM
	tristate "S6E3HF4 AMOLED WQHD LCD driver(1440 x 2560)"
	default n

config EXYNOS_DECON_LCD_S6E3HA6
	depends on EXYNOS_DECON_LCD && EXYNOS_MIPI_DSIM
	tristate "S6E3HA6 AMOLED WQHD+ LCD driver(1440 x 2960)"
	default n

config EXYNOS_DECON_LCD_S6E3HA8
	depends on EXYNOS_DECON_LCD && EXYNOS_MIPI_DSIM
	tristate "S6E3HA8 AMOLED WQHD+ LCD driver(1440 x 2960)"
	default n

config EXYNOS_DECON_LCD_S6E3HA9
	depends on EXYNOS_DECON_LCD && EXYNOS_MIPI_DSIM
	tristate "S6E3HA9 AMOLED WQHD+ LCD driver(1440 x 3040)"
	default n

config EXYNOS_DECON_LCD_S6E3AA2
	depends on EXYNOS_DECON_LCD && EXYNOS_MIPI_DSIM
	tristate "S6E3AA2 AMOLED HD LCD driver(720 x 1280)"
	default n

config EXYNOS_DECON_LCD_EMUL_DISP
	depends on EXYNOS_DECON_LCD && EXYNOS_MIPI_DSIM
	tristate "Virtual LCD driver for emulator(800 x 1280)"
```

## drivers/video/fbdev/exynos/dpu_9810/Kconfig
```kconfig
config EXYNOS_DECON_9810
	bool "Samsung Exynos9810 Display system (DPP, DECON, MIPI, HDMI)"
	default y
	depends on FB

if EXYNOS_DECON_9810
config EXYNOS_DECON_FB
	bool "Samsung DECON Framebuffer driver"
	depends on EXYNOS_DECON_9810
	default y
	help
	  Say Y here if you want support for the DECON in Samsung S5P SoCs.
	  This device produce image data to one of output interfaces.

config EXYNOS_DPP
	bool "Samsung Exynos Display Post Processor driver"
	depends on EXYNOS_DECON_9810
	default y

config EXYNOS_MIPI_DSIM
	bool "Samsung Exynos MIPI-DSI driver"
	depends on EXYNOS_DECON_9810
	default y
	help
	  Enable MIPI-DSI driver.

config EXYNOS_DISPLAYPORT
	bool "Samsung Exynos DISPLAYPORT driver"
	depends on EXYNOS_DECON_9810
	default y
	help
	  Enable DISPLAYPORT driver.

config EXYNOS_ZEBU_EMUL_DISP
	bool "Zebu Emulator Display driver"
	depends on EXYNOS_DECON_9810
	default n

config FB_WINDOW_UPDATE
        bool "DECON window update mode"
        depends on EXYNOS_DECON_9810
        default n

config DECON_BLOCKING_MODE
	bool "DECON blocking mode"
        depends on EXYNOS_DECON_9810
        default y

config DECON_EVENT_LOG
	bool "Display sub-system event logger (DECON/DSIM/DPP)"
        depends on DEBUG_INFO && EXYNOS_DECON_9810
        default y

config DECON_HIBER
	bool "DECON hiber mode"
        depends on EXYNOS_DECON_9810
        default n

config EXYNOS_AFBC
	bool "Display sub-system AFBC stream"
        depends on EXYNOS_DECON_9810
        default n

config EXYNOS_DSIM_DITHER
	bool "DSIM SSCG feature"
        depends on EXYNOS_MIPI_DSIM
        default y

config DECON_BTS_LEGACY
	bool "Legacy BTS scheme of display"
        depends on EXYNOS_DECON_9810
        default n

config DPU_2_0_FENCE
	bool "fence is signaled at the beginning of a frame"
        depends on EXYNOS_DECON_9810
        default n

config FB_TEST
	bool "FB test only"
        depends on EXYNOS_DECON_9810
        default n

config DSIM_CMD_TEST
	bool "DSIM command test only"
        depends on EXYNOS_DECON_9810
        default n

config DPU_2_0_RELEASE_FENCES
	bool "Release fence FD is created per each enable window"
        depends on EXYNOS_DECON_9810
        default n
endif

source "drivers/video/fbdev/exynos/dpu_9810/panels/Kconfig"
```

## drivers/video/fbdev/exynos/dpu_9810/panels/Kconfig
```kconfig
config EXYNOS_DECON_LCD
	depends on EXYNOS_DECON_9810
	bool "Select LCD panel driver"

config EXYNOS_DECON_LCD_S6E3HA2K
	depends on EXYNOS_DECON_LCD && EXYNOS_MIPI_DSIM
	tristate "S6E3HA2K AMOLED WQHD LCD driver(1440 x 2560)"

config EXYNOS_DECON_LCD_S6E3HF4
	depends on EXYNOS_DECON_LCD && EXYNOS_MIPI_DSIM
	tristate "S6E3HF4 AMOLED WQHD LCD driver(1440 x 2560)"
	default n

config EXYNOS_DECON_LCD_S6E3HA6
	depends on EXYNOS_DECON_LCD && EXYNOS_MIPI_DSIM
	tristate "S6E3HA6 AMOLED WQHD+ LCD driver(1440 x 2960)"
	default n

config EXYNOS_DECON_LCD_S6E3HA8
	depends on EXYNOS_DECON_LCD && EXYNOS_MIPI_DSIM
	tristate "S6E3HA8 AMOLED WQHD+ LCD driver(1440 x 2960)"
	default n

config EXYNOS_DECON_LCD_EMUL_DISP
	depends on EXYNOS_DECON_LCD && EXYNOS_MIPI_DSIM
	depends on EXYNOS_ZEBU_EMUL_DISP
	tristate "EMUL_DISP COMMAND/VIDEO MODE AMOLED FHD LCD driver(800 x 1280)"
```
