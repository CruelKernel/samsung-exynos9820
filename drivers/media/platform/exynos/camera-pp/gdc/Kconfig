## drivers/media/platform/exynos/fimc-is2/sensor/module_framework/cis/Kconfig
```kconfig
menuconfig CAMERA_CIS_SELECT
	bool "Sensor cis select"
	depends on USE_DIRECT_IS_CONTROL
	help
	  Say Y here to enable support for platform-specific V4L drivers.

config CAMERA_CIS_6B2_OBJ
        bool "Use 6B2 camera cis"
	depends on USE_DIRECT_IS_CONTROL
	depends on CAMERA_CIS_SELECT
        default n
        help
          Use to build 6B2 camera sensor.

config CAMERA_CIS_5E2_OBJ
        bool "Use 5E2 camera cis"
	depends on USE_DIRECT_IS_CONTROL
	depends on CAMERA_CIS_SELECT
        default n
        help
          Use to build 5E2 camera sensor.

config CAMERA_CIS_5E3_OBJ
        bool "Use 5E3 camera cis"
	depends on USE_DIRECT_IS_CONTROL
	depends on CAMERA_CIS_SELECT
        default n
        help
          Use to build 5E3 camera sensor.

config CAMERA_CIS_4H5YC_OBJ
        bool "Use 4H5YC camera cis"
	depends on USE_DIRECT_IS_CONTROL
	depends on CAMERA_CIS_SELECT
        default n
        help
          Use to build 4H5YC camera sensor.

config CAMERA_CIS_4H5_OBJ
        bool "Use 4H5 camera cis"
	depends on USE_DIRECT_IS_CONTROL
	depends on CAMERA_CIS_SELECT
        default n
        help
          Use to build 4H5 camera sensor.

config CAMERA_CIS_2P2_OBJ
		bool "Use 2P2 camera cis"
	depends on USE_DIRECT_IS_CONTROL
	depends on CAMERA_CIS_SELECT
		default n
		help
		  Use to build 2P2 camera sensor.
config CAMERA_CIS_2P8_OBJ
		bool "Use 2P8 camera cis"
	depends on USE_DIRECT_IS_CONTROL
	depends on CAMERA_CIS_SELECT
		default n
		help
		  Use to build 2P8 camera sensor.

config CAMERA_CIS_3P3_OBJ
		bool "Use 3P3 camera cis"
	depends on USE_DIRECT_IS_CONTROL
	depends on CAMERA_CIS_SELECT
		default n
		help
		  Use to build 3P3 camera sensor.

config CAMERA_CIS_3L2_OBJ
		bool "Use 3L2 camera cis"
	depends on USE_DIRECT_IS_CONTROL
	depends on CAMERA_CIS_SELECT
		default n
		help
		  Use to build 3L2 camera sensor.

config CAMERA_CIS_3H1_OBJ
		bool "Use 3H1 camera cis"
	depends on USE_DIRECT_IS_CONTROL
	depends on CAMERA_CIS_SELECT
		default n
		help
		  Use to build 3H1 camera sensor.

config CAMERA_CIS_3H1_C3_OBJ
		bool "Use 3H1 camera cis for companion"
	depends on USE_DIRECT_IS_CONTROL
	depends on CAMERA_CIS_SELECT
		default n
		help
		  Use to build 3H1 camera sensor.

config CAMERA_CIS_3J1_OBJ
		bool "Use 3J1 camera cis"
	depends on USE_DIRECT_IS_CONTROL
	depends on CAMERA_CIS_SELECT
		default n
		help
		  Use to build 3J1 camera sensor.

config CAMERA_CIS_4E6_OBJ
		bool "Use 4E6 camera cis"
	depends on USE_DIRECT_IS_CONTROL
	depends on CAMERA_CIS_SELECT
		default n
		help
		  Use to build 4E6 camera sensor.

config CAMERA_CIS_5E6_OBJ
		bool "Use 5E6 camera cis"
	depends on USE_DIRECT_IS_CONTROL
	depends on CAMERA_CIS_SELECT
		default n
		help
		  Use to build 5E6 camera sensor.

config CAMERA_CIS_5F1_OBJ
		bool "Use 5F1 camera cis"
	depends on USE_DIRECT_IS_CONTROL
	depends on CAMERA_CIS_SELECT
		default n
		help
		  Use to build 5F1 camera sensor.

config CAMERA_CIS_3M2_OBJ
		bool "Use 3M2 camera cis"
	depends on USE_DIRECT_IS_CONTROL
	depends on CAMERA_CIS_SELECT
		default n
		help
		  Use to build 3M2 camera sensor.

config CAMERA_CIS_3M3_OBJ
		bool "Use 3M3 camera cis"
	depends on USE_DIRECT_IS_CONTROL
	depends on CAMERA_CIS_SELECT
		default n
		help
		  Use to build 3M3 camera sensor.

config CAMERA_CIS_3M5_OBJ
		bool "Use 3M5 camera cis"
	depends on USE_DIRECT_IS_CONTROL
	depends on CAMERA_CIS_SELECT
		default n
		help
		  Use to build 3M5 camera sensor.

config CAMERA_CIS_2L1_OBJ
		bool "Use 2L1 camera cis"
	depends on USE_DIRECT_IS_CONTROL
	depends on CAMERA_CIS_SELECT
		default n
		help
		  Use to build 2L1 camera sensor.

config CAMERA_CIS_3P8_OBJ
		bool "Use 3P8 camera cis"
	depends on USE_DIRECT_IS_CONTROL
	depends on CAMERA_CIS_SELECT
		default n
		help
		  Use to build 3P8 camera sensor.

config CAMERA_CIS_3P9_OBJ
		bool "Use 3P9 camera cis"
	depends on USE_DIRECT_IS_CONTROL
	depends on CAMERA_CIS_SELECT
		default n
		help
		  Use to build 3P9 camera sensor.

config CAMERA_CIS_3P8SP_OBJ
		bool "Use 3P8SP camera cis"
	depends on USE_DIRECT_IS_CONTROL
	depends on CAMERA_CIS_SELECT
		default n
		help
		  Use to build 3P8SP camera sensor.

config CAMERA_CIS_2P7SX_OBJ
		bool "Use 2P7SX camera cis"
	depends on USE_DIRECT_IS_CONTROL
	depends on CAMERA_CIS_SELECT
		default n
		help
		  Use to build 2P7SX camera sensor.

config CAMERA_CIS_RPB_OBJ
		bool "Use RPB camera cis"
	depends on USE_DIRECT_IS_CONTROL
	depends on CAMERA_CIS_SELECT
		default n
		help
		  Use to build RPB camera sensor.

config CAMERA_CIS_2P7SQ_OBJ
		bool "Use 2P7SQ camera cis"
	depends on USE_DIRECT_IS_CONTROL
	depends on CAMERA_CIS_SELECT
		default n
		help
		  Use to build 2P7SQ camera sensor.

config CAMERA_CIS_2T7SX_OBJ
		bool "Use 2T7SX camera cis"
	depends on USE_DIRECT_IS_CONTROL
	depends on CAMERA_CIS_SELECT
		default n
		help
		  Use to build 2T7SX camera sensor.

config CAMERA_CIS_2L2_OBJ
		bool "Use 2L2 camera cis"
	depends on USE_DIRECT_IS_CONTROL
	depends on CAMERA_CIS_SELECT
		default n
		help
		  Use to build 2L2 camera sensor.

config CAMERA_CIS_2L3_OBJ
		bool "Use 2L3 camera cis"
	depends on USE_DIRECT_IS_CONTROL
	depends on CAMERA_CIS_SELECT
		default n
		help
		  Use to build 2L3 camera sensor.

config CAMERA_CIS_2L4_OBJ
		bool "Use 2L4 camera cis"
	depends on USE_DIRECT_IS_CONTROL
	depends on CAMERA_CIS_SELECT
		default n
		help
		  Use to build 2L4 camera sensor.

config CAMERA_CIS_IMX260_OBJ
		bool "Use IMX260 camera cis"
	depends on USE_DIRECT_IS_CONTROL
	depends on CAMERA_CIS_SELECT
		default n
		help
		  Use to build IMX260 camera sensor.

config CAMERA_CIS_IMX333_OBJ
		bool "Use IMX333 camera cis"
	depends on USE_DIRECT_IS_CONTROL
	depends on CAMERA_CIS_SELECT
		default n
		help
		  Use to build IMX333 camera sensor.

config CAMERA_CIS_2L7_OBJ
		bool "Use 2L7 camera cis"
	depends on USE_DIRECT_IS_CONTROL
	depends on CAMERA_CIS_SELECT
		default n
		help
		  Use to build 2L7 camera sensor.

config CAMERA_CIS_IMX320_OBJ
		bool "Use IMX320 camera cis"
	depends on USE_DIRECT_IS_CONTROL
	depends on CAMERA_CIS_SELECT
		default n
		help
		  Use to build IMX320 camera sensor.

config CAMERA_CIS_IMX320_C3_OBJ
		bool "Use IMX320_C3 camera cis"
	depends on USE_DIRECT_IS_CONTROL
	depends on CAMERA_CIS_SELECT
		default n
		help
		  Use to build IMX320_C3 camera sensor.

config CAMERA_CIS_IMX219_OBJ
		bool "Use IMX219 camera cis"
	depends on USE_DIRECT_IS_CONTROL
	depends on CAMERA_CIS_SELECT
		default n
		help
		  Use to build IMX219 camera sensor.

config CAMERA_CIS_IMX258_OBJ
		bool "Use IMX258 camera cis"
	depends on USE_DIRECT_IS_CONTROL
	depends on CAMERA_CIS_SELECT
		default n
		help
		  Use to build IMX258 camera sensor.

config CAMERA_CIS_IMX241_OBJ
		bool "Use IMX241 camera cis"
	depends on USE_DIRECT_IS_CONTROL
	depends on CAMERA_CIS_SELECT
		default n
		help
		  Use to build IMX241 camera sensor.

config CAMERA_CIS_SR259_OBJ
		bool "Use SR259 camera cis"
	depends on USE_DIRECT_IS_CONTROL
	depends on CAMERA_CIS_SELECT
		default n
		help
		  Use to build SR259 camera sensor.

config CAMERA_CIS_4HA_OBJ
		bool "Use 4HA camera cis"
	depends on USE_DIRECT_IS_CONTROL
	depends on CAMERA_CIS_SELECT
		default n
		help
		  Use to build 4HA camera sensor.

config CAMERA_CIS_IMX316_OBJ
		bool "Use IMX316 camera cis"
	depends on USE_DIRECT_IS_CONTROL
	depends on CAMERA_CIS_SELECT
		default n
		help
		  Use to build IMX316 camera sensor.

config CAMERA_CIS_IMX516_OBJ
		bool "Use IMX516 camera cis"
	depends on USE_DIRECT_IS_CONTROL
	depends on CAMERA_CIS_SELECT
		default n
		help
		  Use to build IMX516 camera sensor.

config CAMERA_CIS_VIRTUAL_OBJ
		bool "Use VIRTUAL camera cis"
	depends on USE_DIRECT_IS_CONTROL
	depends on CAMERA_CIS_SELECT
		default n
		help
		  Use to build VIRTUAL camera sensor.
```

## drivers/media/platform/exynos/fimc-is2/sensor/module_framework/dphy/Kconfig
```kconfig
config CAMERA_FPGA_DPHY
        bool "Use FPGA D-PHY"
	depends on USE_DIRECT_IS_CONTROL
        default n
        help
          Use to build FPGA D-PHY.
```
