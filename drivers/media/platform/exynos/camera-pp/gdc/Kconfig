## drivers/media/platform/exynos/camera-pp/gdc/Kconfig
```kconfig
menuconfig VIDEO_EXYNOS_CAMERA_POSTPROCESS_GDC
	bool "EXYNOS CAMERA POSTPROCESS GDC Driver"
	depends on VIDEO_EXYNOS_CAMERA_POSTPROCESS
	default y
	help
		This is a representative exynos CAMERA-PP GDC device.

config CAMERA_PP_GDC_V1_0_0_OBJ
	bool "use GDC v1.0"
	depends on VIDEO_EXYNOS_CAMERA_POSTPROCESS_GDC
	default n
	help
		Use to build GDC v1.0 driver

config CAMERA_PP_GDC_V2_0_0_OBJ
	bool "use GDC v2.0"
	depends on VIDEO_EXYNOS_CAMERA_POSTPROCESS_GDC
	default n
	help
		Use to build GDC v2.0 driver

config CAMERA_PP_GDC_V2_1_0_OBJ
	bool "use GDC v2.1"
	depends on VIDEO_EXYNOS_CAMERA_POSTPROCESS_GDC
	default n
	help
		Use to build GDC v2.1 driver
```

## drivers/media/platform/exynos/camera-pp/str/Kconfig
```kconfig
menuconfig VIDEO_EXYNOS_CAMERA_POSTPROCESS_STR
	bool "EXYNOS CAMERA POSTPROCESS STR Driver"
	depends on VIDEO_EXYNOS_CAMERA_POSTPROCESS
	default n
	help
		This is a representative exynos CAMERA-PP STR device.

config CAMERA_PP_STR_V1_0_0_OBJ
	bool "Use camera post-processing STR V1.0.0"
	depends on VIDEO_EXYNOS_CAMERA_POSTPROCESS_STR
	default n
	help
		Use to build STR v1.0 driver

		When this config is enabled,
		STR device driver will use the API defined for STR v1.0.0.
		The user interface to control STR driver must be matched with this API version.
```

## drivers/media/platform/exynos/fimc-is2/Kconfig
```kconfig
config VIDEO_EXYNOS_FIMC_IS2
	bool "Exynos FIMC-IS2 (Image Subsystem) driver"
	depends on VIDEO_EXYNOS
	select MEDIA_EXYNOS
	select EXYNOS_FIMC_IS
	select VIDEOBUF2_DMA_SG
	default n
	help
	  This is a v4l2 driver for exynos FIMC-IS device.

source "drivers/media/platform/exynos/fimc-is2/ischain/Kconfig"
source "drivers/media/platform/exynos/fimc-is2/sensor/Kconfig"

#menu depth1
menu "Base Feature Setting"
	depends on EXYNOS_FIMC_IS

source "drivers/media/platform/exynos/fimc-is2/hardware/Kconfig"
endmenu

source "drivers/media/platform/exynos/fimc-is2/vendor/Kconfig"
```

## drivers/media/platform/exynos/fimc-is2/hardware/Kconfig
```kconfig
#menu depth2
menu "Direct FIMC-IS Control Setting"

config USE_DIRECT_IS_CONTROL
	bool "Use IS hardware directly"
	default n
	help
	  Enable HW direct control.

config CAMERA_FIMC_SCALER_USE
        bool "Use FIMC-SCALER"
        depends on USE_DIRECT_IS_CONTROL
        default n
        help
          use fimc-scaler

config CAMERA_MC_SCALER_VER1_USE
        bool "Use MC-SCALER S/W VERSION 1"
        depends on USE_DIRECT_IS_CONTROL
        default n
        help
          use mc-scaler version 1(scp param)

config CAMERA_MC_SCALER_VER2_USE
        bool "Use MC-SCALER S/W VERSION 2"
        depends on USE_DIRECT_IS_CONTROL
        default n
        help
          use mc-scaler version 2(mcs param)

config CAMERA_TDNR_VER1_USE
        bool "Use TDNR in MC-SCALER S/W VERSION 1"
        depends on CAMERA_MC_SCALER_VER2_USE
        default n
        help
          use tdnr version 1

config CAMERA_TDNR_VER2_USE
        bool "Use TDNR in MC-SCALER S/W VERSION 2"
        depends on CAMERA_MC_SCALER_VER2_USE
        default n
        help
          use tdnr version 2(has compressor)

source "drivers/media/platform/exynos/fimc-is2/hardware/api/Kconfig"
endmenu

config USE_HW_API_COMMON
	bool "Use HW API Common library"
	default y
	help
	  Enalbe HW API Common library.

config USE_SENSOR_GROUP
	bool "Use sensor group feature"
	default n
	help
	  Enalbe sensor group feature.

config DCP_V1_0
        bool "Use DCP H/W v1.0"
        default n
        help
          use dcp v1.0
```

## drivers/media/platform/exynos/fimc-is2/hardware/api/Kconfig
```kconfig
config MC_SCALER_V1_20
        bool "Use MC-SCALER H/W v1.20"
	depends on CAMERA_MC_SCALER_VER1_USE
        default n
        help
          use mc-scaler v1.20

config MC_SCALER_V1_22_V1_23
        bool "Use MC-SCALER H/W v1.22 / v1.23"
	depends on CAMERA_MC_SCALER_VER2_USE
        default n
        help
          use mc-scaler v1.22/v1.23

config MC_SCALER_V2_0
        bool "Use MC-SCALER H/W v2.0"
	depends on CAMERA_MC_SCALER_VER2_USE
        default n
        help
          use mc-scaler v2.0

config MC_SCALER_V2_10
        bool "Use MC-SCALER H/W v2.10"
	depends on CAMERA_MC_SCALER_VER2_USE
        default n
        help
          use mc-scaler v2.10

config MC_SCALER_V3_0
        bool "Use MC-SCALER H/W v3.0"
	depends on CAMERA_MC_SCALER_VER2_USE
        default n
        help
          use mc-scaler v3.0

config MC_SCALER_V3_20
        bool "Use MC-SCALER H/W v3.20"
	depends on CAMERA_MC_SCALER_VER2_USE
        default n
        help
          use mc-scaler v3.20

config MC_SCALER_V4_0
        bool "Use MC-SCALER H/W v4.0"
	depends on CAMERA_MC_SCALER_VER2_USE
        default n
        help
          use mc-scaler v4.0

config MC_SCALER_V4_10
        bool "Use MC-SCALER H/W v4.10"
	depends on CAMERA_MC_SCALER_VER2_USE
        default n
        help
          use mc-scaler v4.10

config MC_SCALER_V5_0
        bool "Use MC-SCALER H/W v5.0"
	depends on CAMERA_MC_SCALER_VER2_USE
        default n
        help
          use mc-scaler v5.0

config VRA_V2_0
        bool "Use VRA H/W v2.0"
        default n
        help
          use vra v2.0
```

## drivers/media/platform/exynos/fimc-is2/ischain/Kconfig
```kconfig
config EXYNOS_FIMC_IS
        bool "Use FIMC-IS"
        depends on VIDEO_EXYNOS_FIMC_IS2
        default y
        help
          This config abstracts driver source folder.

choice
	prompt "Select FIMC-IS Version"
	depends on EXYNOS_FIMC_IS
	help
	  Select FIMC-IS Version.

source "drivers/media/platform/exynos/fimc-is2/ischain/fimc-is-v5_2_0/Kconfig"
source "drivers/media/platform/exynos/fimc-is2/ischain/fimc-is-v4_3_0/Kconfig"
source "drivers/media/platform/exynos/fimc-is2/ischain/fimc-is-v4_0_0/Kconfig"
source "drivers/media/platform/exynos/fimc-is2/ischain/fimc-is-v3_1_1/Kconfig"
source "drivers/media/platform/exynos/fimc-is2/ischain/fimc-is-v3_11_0/Kconfig"
source "drivers/media/platform/exynos/fimc-is2/ischain/fimc-is-v3_20_0/Kconfig"
source "drivers/media/platform/exynos/fimc-is2/ischain/fimc-is-v5_10_0/Kconfig"
source "drivers/media/platform/exynos/fimc-is2/ischain/fimc-is-v5_15_0/Kconfig"
source "drivers/media/platform/exynos/fimc-is2/ischain/fimc-is-v6_0_0/Kconfig"
source "drivers/media/platform/exynos/fimc-is2/ischain/fimc-is-v6_10_0/Kconfig"
source "drivers/media/platform/exynos/fimc-is2/ischain/fimc-is-v7_0_0/Kconfig"

endchoice
```

## drivers/media/platform/exynos/fimc-is2/ischain/fimc-is-v3_11_0/Kconfig
```kconfig
config FIMC_IS_V3_11_0
	bool "Use fimc-is v3.11.0"
	depends on SOC_EXYNOS7870
	select EXYNOS_DEVICE_MIPI_CSIS_VER2
	select CSIS_V4_1
	select EXYNOS_FIMC_BNS
	select FIMC_BNS_V4_10_0
	select CAMERA_CIS_SELECT
	select CAMERA_ACT_SELECT
	select CAMERA_FLASH_SELECT
	select USE_DIRECT_IS_CONTROL
	select CAMERA_MC_SCALER_VER1_USE
	select MC_SCALER_V1_20
	select USE_HW_API_COMMON
	help
	  fimc-is version 3.11.0
```

## drivers/media/platform/exynos/fimc-is2/ischain/fimc-is-v3_1_1/Kconfig
```kconfig
config FIMC_IS_V3_1_1
	bool "Use fimc-is v3.1.1"
	depends on SOC_EXYNOS3475
	select EXYNOS_DEVICE_MIPI_CSIS_VER1
	select CSIS_V3_4
	select CAMERA_CIS_SELECT
	select CAMERA_ACT_SELECT
	select CAMERA_FLASH_SELECT
	select USE_DIRECT_IS_CONTROL
	select CAMERA_FIMC_SCALER_USE
	select USE_HW_API_COMMON
	help
	  fimc-is version 3.1.1
```

## drivers/media/platform/exynos/fimc-is2/ischain/fimc-is-v3_20_0/Kconfig
```kconfig
config FIMC_IS_V3_20_0
	bool "Use fimc-is v3.20.0"
	depends on SOC_EXYNOS7570
	select EXYNOS_DEVICE_MIPI_CSIS_VER2
	select CSIS_V4_1
	select EXYNOS_FIMC_BNS
	select FIMC_BSC_V1_20_0
	select CAMERA_CIS_SELECT
	select CAMERA_ACT_SELECT
	select CAMERA_FLASH_SELECT
	select USE_DIRECT_IS_CONTROL
	select CAMERA_MC_SCALER_VER2_USE
	select MC_SCALER_V1_22_V1_23
	select USE_HW_API_COMMON
	help
	  fimc-is version 3.20.0
```

## drivers/media/platform/exynos/fimc-is2/ischain/fimc-is-v4_0_0/Kconfig
```kconfig
config FIMC_IS_V4_0_0
	bool "Use fimc-is v4.0.0"
	depends on SOC_EXYNOS7420
	help
	  fimc-is version 4.0.0
```

## drivers/media/platform/exynos/fimc-is2/ischain/fimc-is-v4_3_0/Kconfig
```kconfig
config FIMC_IS_V4_3_0
	bool "Use fimc-is v4.3.0"
	depends on SOC_EXYNOS8890
	select EXYNOS_DEVICE_MIPI_CSIS_VER2 if !USE_SENSOR_GROUP
	select EXYNOS_DEVICE_MIPI_CSIS_VER3 if USE_SENSOR_GROUP
	select CSIS_V4_1
	select EXYNOS_FIMC_BNS
	select FIMC_BNS_V4_20_0
	select CAMERA_CIS_SELECT
	select CAMERA_ACT_SELECT
	select CAMERA_FLASH_SELECT
	select USE_DIRECT_IS_CONTROL
	select CAMERA_MC_SCALER_VER2_USE
	select MC_SCALER_V2_0
	select USE_HW_API_COMMON
	help
	  fimc-is version 4.3.0
```

## drivers/media/platform/exynos/fimc-is2/ischain/fimc-is-v5_10_0/Kconfig
```kconfig
config FIMC_IS_V5_10_0
	bool "Use fimc-is v5.10.0"
	depends on SOC_EXYNOS7880
	select EXYNOS_DEVICE_MIPI_CSIS_VER2
	select CSIS_V4_1
	select EXYNOS_FIMC_BNS
	select FIMC_BNS_V4_10_0
	select CAMERA_CIS_SELECT
	select CAMERA_ACT_SELECT
	select CAMERA_FLASH_SELECT
	select USE_DIRECT_IS_CONTROL
	select CAMERA_MC_SCALER_VER2_USE
	select MC_SCALER_V2_10
	select USE_HW_API_COMMON
	help
	  fimc-is version 5.10.0
```

## drivers/media/platform/exynos/fimc-is2/ischain/fimc-is-v5_15_0/Kconfig
```kconfig
config FIMC_IS_V5_15_0
	bool "Use fimc-is v5.15.0"
	depends on SOC_EXYNOS7872
	select EXYNOS_DEVICE_MIPI_CSIS_VER2 if !USE_SENSOR_GROUP
	select EXYNOS_DEVICE_MIPI_CSIS_VER3 if USE_SENSOR_GROUP
	select CSIS_V5_0
	select CAMERA_CIS_SELECT
	select CAMERA_ACT_SELECT
	select CAMERA_FLASH_SELECT
	select USE_DIRECT_IS_CONTROL
	select CAMERA_MC_SCALER_VER2_USE
	select MC_SCALER_V3_20
	select USE_HW_API_COMMON
	help
	  fimc-is version 5.15.0
```

## drivers/media/platform/exynos/fimc-is2/ischain/fimc-is-v5_2_0/Kconfig
```kconfig
config FIMC_IS_V5_2_0
	bool "Use fimc-is v5.2.0"
	depends on SOC_EXYNOS8895
	select EXYNOS_DEVICE_MIPI_CSIS_VER2 if !USE_SENSOR_GROUP
	select EXYNOS_DEVICE_MIPI_CSIS_VER3 if USE_SENSOR_GROUP
	select CSIS_V5_0
	select EXYNOS_FIMC_BNS
	select FIMC_BNS_V4_20_0
	select CAMERA_CIS_SELECT
	select CAMERA_ACT_SELECT
	select CAMERA_FLASH_SELECT
	select USE_DIRECT_IS_CONTROL
	select CAMERA_MC_SCALER_VER2_USE
	select MC_SCALER_V3_0
	select USE_HW_API_COMMON
	help
	  fimc-is version 5.2.0
```

## drivers/media/platform/exynos/fimc-is2/ischain/fimc-is-v6_0_0/Kconfig
```kconfig
config FIMC_IS_V6_0_0
	bool "Use fimc-is v6.0.0"
	depends on SOC_EXYNOS9810
	select EXYNOS_DEVICE_MIPI_CSIS_VER4
	select CSIS_V5_1
	select CAMERA_CIS_SELECT
	select CAMERA_ACT_SELECT
	select CAMERA_FLASH_SELECT
	select CAMERA_PDP
	select USE_DIRECT_IS_CONTROL
	select CAMERA_MC_SCALER_VER2_USE
	select CAMERA_TDNR_VER2_USE
	select MC_SCALER_V4_0
	select USE_HW_API_COMMON
	select DCP_V1_0
	help
	  fimc-is version 6.0.0
```

## drivers/media/platform/exynos/fimc-is2/ischain/fimc-is-v6_10_0/Kconfig
```kconfig
config FIMC_IS_V6_10_0
	bool "Use fimc-is v6.10.0"
	depends on SOC_EXYNOS9610
	select EXYNOS_DEVICE_MIPI_CSIS_VER4
	select CSIS_V5_1
	select CAMERA_CIS_SELECT
	select CAMERA_ACT_SELECT
	select CAMERA_FLASH_SELECT
	select CAMERA_PAFSTAT
	select USE_DIRECT_IS_CONTROL
	select CAMERA_MC_SCALER_VER2_USE
	select CAMERA_TDNR_VER2_USE
	select MC_SCALER_V4_10
	select USE_HW_API_COMMON
	help
	  fimc-is version 6.10.0
```

## drivers/media/platform/exynos/fimc-is2/sensor/Kconfig
```kconfig
#menu depth1
menu "Sensor/CAMIF Setting"
	depends on EXYNOS_FIMC_IS

config EXYNOS_CAMERA_MODULE
	bool "Use Modules(F/W)"
	depends on !USE_DIRECT_IS_CONTROL
	default n
	help
	  Use Modules(F/W)

source "drivers/media/platform/exynos/fimc-is2/sensor/module/Kconfig"

#menu depth2
menu "CSI Setting"
config EXYNOS_DEVICE_MIPI_CSIS_LEGACY
	bool "Use Device MIPI-CSIS S/W Legacy"
	depends on !USE_SENSOR_GROUP
	default n
	help
	  Enable Device MIPI-CSIS S/W Legacy

source "drivers/media/platform/exynos/fimc-is2/sensor/csi/Kconfig"

config EXYNOS_DEVICE_MIPI_CSIS_VER2
	bool "Use Device MIPI-CSIS S/W Version 2"
	depends on !USE_SENSOR_GROUP
	default n
	help
	  Enable Device MIPI-CSIS S/W Version 2(Including WDMA)

config EXYNOS_DEVICE_MIPI_CSIS_VER3
	bool "Use Device MIPI-CSIS S/W Version 3(Sensor Group)"
	depends on USE_SENSOR_GROUP
	default n
	help
	  Enable Device MIPI-CSIS S/W Version 3(Including WDMA and Sensor Group)

config EXYNOS_DEVICE_MIPI_CSIS_VER4
	bool "Use Device MIPI-CSIS S/W Version 4(Sensor Group)"
	depends on USE_SENSOR_GROUP
	default n
	help
	  Enable Device MIPI-CSIS S/W Version 4(Including WDMA and Sensor Group)

source "drivers/media/platform/exynos/fimc-is2/sensor/csi2/Kconfig"
endmenu

#menu depth2
menu "BNS Setting"
config EXYNOS_FIMC_BNS
        bool "Use FIMC_BNS(LITE)"
        default n
        help
	  Enable Device BNS(LITE) S/W

source "drivers/media/platform/exynos/fimc-is2/sensor/flite/Kconfig"
endmenu

source "drivers/media/platform/exynos/fimc-is2/sensor/module_framework/Kconfig"
source "drivers/media/platform/exynos/fimc-is2/sensor/module_framework/cis/Kconfig"
source "drivers/media/platform/exynos/fimc-is2/sensor/module_framework/actuator/Kconfig"
source "drivers/media/platform/exynos/fimc-is2/sensor/module_framework/flash/Kconfig"
source "drivers/media/platform/exynos/fimc-is2/sensor/module_framework/ois/Kconfig"
source "drivers/media/platform/exynos/fimc-is2/sensor/module_framework/dphy/Kconfig"
source "drivers/media/platform/exynos/fimc-is2/sensor/module_framework/pdp/Kconfig"
source "drivers/media/platform/exynos/fimc-is2/sensor/module_framework/pafstat/Kconfig"
source "drivers/media/platform/exynos/fimc-is2/sensor/module_framework/aperture/Kconfig"

endmenu
```

## drivers/media/platform/exynos/fimc-is2/sensor/csi/Kconfig
```kconfig
config CSIS_V3_2
        bool "Use CSI H/W v3.2"
        depends on EXYNOS_DEVICE_MIPI_CSIS
        default n
        help
          csi version 3.2

config CSIS_V3_4
        bool "Use CSI H/W v3.4"
        depends on EXYNOS_DEVICE_MIPI_CSIS
        default n
        help
          csi version 3.4
```

## drivers/media/platform/exynos/fimc-is2/sensor/csi2/Kconfig
```kconfig
config CSIS_V4_0
	bool "Use CSI H/W v4.0"
        depends on EXYNOS_DEVICE_MIPI_CSIS_VER2 || EXYNOS_DEVICE_MIPI_CSIS_VER3
	default n
	select USE_CSI_DMAOUT_FEATURE
	help
	  csi version 4.0

config CSIS_V4_1
	bool "Use CSI H/W v4.1"
        depends on EXYNOS_DEVICE_MIPI_CSIS_VER2 || EXYNOS_DEVICE_MIPI_CSIS_VER3
	default n
	select USE_CSI_DMAOUT_FEATURE
	help
	  csi version 4.1

config CSIS_V5_0
	bool "Use CSI H/W v5.0"
        depends on EXYNOS_DEVICE_MIPI_CSIS_VER2 || EXYNOS_DEVICE_MIPI_CSIS_VER3
	default n
	help
	  csi version 5.0

config CSIS_V5_1
	bool "Use CSI H/W v5.1"
	default n
	help
	  csi version 5.1

config CSIS_V5_2
	bool "Use CSI H/W v5.2"
	default n
	help
	  csi version 5.2

config USE_CSI_DMAOUT_FEATURE
	bool "Use csi dmaout feature"
        depends on CSIS_V4_0 || CSIS_V4_1 || CSIS_V5_0 || CSIS_V5_1 || CSIS_V5_2
	default n
	help
	  csi dmaout feature
```

## drivers/media/platform/exynos/fimc-is2/sensor/flite/Kconfig
```kconfig
config FIMC_BNS_V2_0
	bool "Use BNS H/W v2.0 (Exynos7420)"
	depends on EXYNOS_FIMC_BNS
	default n
	help
	  bns version 3.0

config FIMC_BNS_V4_0
	bool "Use BNS H/W v4.0 (Exynos8890)"
	depends on EXYNOS_FIMC_BNS
	default n
	help
	  bns version 4.0

config FIMC_BNS_V4_10_0
	bool "Use BNS H/W v4.10.0 (Exynos7870)"
	depends on EXYNOS_FIMC_BNS
	default n
	help
	  bns version 4.10.0

config FIMC_BNS_V4_20_0
	bool "Use BNS v4.20.0 (Exynos8890 EVT1)"
	depends on EXYNOS_FIMC_BNS
	default n
	help
	  bns version 4.20.0

config FIMC_BSC_V1_20_0
	bool "Use BSC v1.20.0 (Exynos7570)"
	depends on EXYNOS_FIMC_BNS
	default n
	help
	  bsc version 1.20.0
```
