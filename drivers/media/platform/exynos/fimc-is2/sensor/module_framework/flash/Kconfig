## drivers/media/platform/exynos/fimc-is2/sensor/module_framework/flash/Kconfig
```kconfig
menuconfig CAMERA_FLASH_SELECT
	bool "Sensor flash select"
	depends on USE_DIRECT_IS_CONTROL
	help
	  Say Y here to enable support for platform-specific V4L drivers.

config CAMERA_FLASH_LM3560_OBJ
        bool "Use LM3560"
	depends on USE_DIRECT_IS_CONTROL
	depends on CAMERA_FLASH_SELECT
        default n
        help
          Use to build LM3560 driver.

config CAMERA_FLASH_RT5033_OBJ
        bool "Use RT5033"
	depends on USE_DIRECT_IS_CONTROL
	depends on CAMERA_FLASH_SELECT
        default n
        help
          Use to build RT5033 driver.

config CAMERA_FLASH_S2MPB02_OBJ
        bool "Use S2MPB02"
	depends on USE_DIRECT_IS_CONTROL
	depends on CAMERA_FLASH_SELECT
        default n
        help
          Use to build S2MPB02 driver.

config CAMERA_FLASH_GPIO_OBJ
        bool "Use GPIO"
	depends on USE_DIRECT_IS_CONTROL
	depends on CAMERA_FLASH_SELECT
        default n
        help
          Use to build GPIO driver.

config CAMERA_FLASH_I2C_OBJ
        bool "Use I2C"
	depends on USE_DIRECT_IS_CONTROL
	depends on CAMERA_FLASH_SELECT
        default n
        help
          Use to build I2C driver.

config CAMERA_FLASH_KTD2692_OBJ
        bool "Use KTD2692"
	depends on USE_DIRECT_IS_CONTROL
	depends on CAMERA_FLASH_SELECT
        default n
        help
          Use to build KTD2692 driver.
```

## drivers/media/platform/exynos/fimc-is2/sensor/module_framework/ois/Kconfig
```kconfig
menuconfig CAMERA_OIS_SELECT
	bool "Sensor ois select"
	depends on USE_DIRECT_IS_CONTROL
	help
	  Say Y here to enable support for platform-specific V4L drivers.

config CAMERA_OIS_IDG2030_OBJ
        bool "Use IDG2030 ois"
	depends on USE_DIRECT_IS_CONTROL
	depends on CAMERA_OIS_SELECT
        default n
        help
          Use to build IDG2030 ois.
```

## drivers/media/platform/exynos/fimc-is2/sensor/module_framework/pafstat/Kconfig
```kconfig
config CAMERA_PAFSTAT
        bool "Use PAFSTAT"
	depends on USE_DIRECT_IS_CONTROL
        default n
        help
          Use to build PAF_STAT.
```

## drivers/media/platform/exynos/fimc-is2/sensor/module_framework/pdp/Kconfig
```kconfig
config CAMERA_PDP
        bool "Use PDP"
	depends on USE_DIRECT_IS_CONTROL
        default n
        help
          Use to build PDP.
```

## drivers/media/platform/exynos/fimc-is2/vendor/Kconfig
```kconfig
menu "Vendor Feature Setting"
	depends on EXYNOS_FIMC_IS

choice
	prompt "Use vender features"
	depends on EXYNOS_FIMC_IS
	default VENDER_DEFAULT
	help
	  Use the vender specific features.

config VENDER_DEFAULT
        bool "Default"
config VENDER_MCD
        bool "MCD"
config VENDER_PSV
        bool "PSV"
endchoice

source "drivers/media/platform/exynos/fimc-is2/vendor/default/Kconfig"
source "drivers/media/platform/exynos/fimc-is2/vendor/mcd/Kconfig"
endmenu
```

## drivers/media/platform/exynos/fimc-is2/vendor/default/Kconfig
```kconfig
#
# Generic vendor feature config states
#

# Enable the vendor features
config SECURE_CAMERA_USE
	bool "Use secure camera"
	depends on VENDER_DEFAULT
	default n
	---help---
	  Use secure camera.
```

## drivers/media/platform/exynos/fimc-is2/vendor/mcd/Kconfig
```kconfig
config CAMERA_EEPROM_SUPPORT_REAR
        bool "Enable eeprom for rear cam"
        depends on VENDER_MCD
        default n
        help
          Enable eeprom for rear cam.
config CAMERA_EEPROM_SUPPORT_FRONT
        bool "Enable eeprom for front cam"
        depends on VENDER_MCD
        default n
        help
          Enable eeprom for front cam.
config COMPANION_USE
        bool "Use companion"
        depends on VENDER_MCD
        default n
        help
          Use companion.
 config COMPANION_C1_USE
        bool "Use companion C1"
        depends on VENDER_MCD
        default n
        help
          Use companion C1.
 config COMPANION_C2_USE
        bool "Use companion C2"
        depends on VENDER_MCD
        default n
        help
          Use companion C2.
 config COMPANION_C3_USE
        bool "Use companion C3"
        depends on VENDER_MCD
        default n
        help
          Use companion C3.
 config COMPANION_DIRECT_USE
        bool "Use direct control for companion"
        depends on VENDER_MCD
        depends on COMPANION_USE
        depends on USE_DIRECT_IS_CONTROL
        default n
        help
          Use device companion direct control.
 config COMPANION_C2_DIRECT_USE
        bool "Use direct control for companion C2"
        depends on VENDER_MCD
        depends on COMPANION_C2_USE
        depends on COMPANION_DIRECT_USE
        default n
        help
          Use device companion C2.
 config COMPANION_C3_DIRECT_USE
        bool "Use direct control for companion C3"
        depends on VENDER_MCD
        depends on COMPANION_C3_USE
        depends on COMPANION_DIRECT_USE
        default n
        help
          Use device companion C3.
config COMPANION_DCDC_USE
        bool "Use companion DCDC regulator"
        depends on VENDER_MCD
        default n
        help
          Use companion DCDC regulator.
config PREPROCESSOR_STANDBY_USE
        bool "Use companion standby"
        depends on VENDER_MCD
        default n
        help
          Use companion standby.
config SENSOR_RETENTION_USE
	bool "Use sensor retention"
	depends on VENDER_MCD
	default n
	help
	  Use sensor retention.
config OIS_USE
        bool "Use ois"
        depends on VENDER_MCD
        default n
        help
          Use ois.
config OIS_FW_UPDATE_THREAD_USE
        bool "Enable ois fw update thread"
        depends on OIS_USE
        default n
        help
          Enable ois fw update thread.
config AF_HOST_CONTROL
        bool "Enable host af control"
        depends on VENDER_MCD
        default n
        help
          Enable host af control.
config TORCH_CURRENT_CHANGE_SUPPORT
        bool "Change torch current in recording mode"
        depends on VENDER_MCD
        default n
        help
          Change torch current in recording mode.
config FLASH_CURRENT_CHANGE_SUPPORT
        bool "Change flash current in capturing image"
        depends on VENDER_MCD
        default n
        help
           Change torch current in capturing image.
config OIS_USE_RUMBA_S4
        bool "Use RUMBA S4 ois driver IC"
        depends on OIS_USE
        default n
        help
          Use RUMBA S4 ois driver IC.
config CAMERA_BSS_V00
        bool "This camera is bss_v00"
        depends on VENDER_MCD
        default n
        help
          This camera is bss_v00.
config CAMERA_BSS_V01
        bool "This camera is bss_v01"
        depends on VENDER_MCD
        default n
        help
          This camera is bss_v01.
config CAMERA_BSS_V02
        bool "This camera is bss_v02"
        depends on VENDER_MCD
        default n
        help
          This camera is bss_v02.
config CAMERA_BSS_V00X
        bool "This camera is bss_v00x"
        depends on VENDER_MCD
        default n
        help
          This camera is bss_v00x.
config CAMERA_DNS_V01
        bool "This camera is dns_v01"
        depends on VENDER_MCD
        default n
        help
          This camera is dns_v01.
config CAMERA_DNS_V02
        bool "This camera is dns_v02"
        depends on VENDER_MCD
        default n
        help
          This camera is dns_v02.
config OIS_USE_RUMBA_S6
        bool "Use RUMBA S6 ois driver IC"
        depends on OIS_USE
        default n
        help
          Use RUMBA S6 ois driver IC.
config SECURE_CAMERA_USE
        bool "Use secure camera"
        depends on VENDER_MCD
        default n
        help
          Use secure camera.
config USE_SIGNED_BINARY
        bool "Enable signed binary processing."
        depends on VENDER_MCD
        default n
        help
          Enable signed binary processing.
config USE_CAMERA_LDU
        bool "Use Camera LDU"
        depends on VENDER_MCD
        default n
        help
          Use Camera LDU.
config CAMERA_CIS_IMX316_BUCK_USE
        bool "Use isl91128 for tof"
        depends on VENDER_MCD
        default n
        help
          Use isl91128.
config CAMERA_USE_MCU
	bool "Use Camera mcu"
	depends on VENDER_MCD
	default n
	help
          Use Camera MCU.
config SENSORCORE_MCU_CONTROL
	bool "Use sensor core mcu control"
	depends on VENDER_MCD
	default n
	help
          Use sensor control mcu.
```

## drivers/media/platform/exynos/jsqz/Kconfig
```kconfig
#
# Exynos multimedia device drivers
#
config VIDEO_EXYNOS_JPEG_SQZ
        bool "Exynos JPEG Squeeze driver"
        depends on VIDEO_EXYNOS
        default y
        help
          This is a representative exynos Jpeg squeezer device
```

## drivers/media/platform/exynos/mfc/Kconfig
```kconfig
config VIDEO_EXYNOS_MFC
	bool "Exynos MFC Driver"
	default n
	depends on VIDEO_EXYNOS
	select VIDEOBUF2_CORE
	select VIDEOBUF2_DMA_SG
	---help---
	  MFC driver for V4L2.
```

## drivers/media/platform/exynos/repeater/Kconfig
```kconfig
config VIDEO_EXYNOS_REPEATER
       bool "EXYNOS REPEATER Driver"
       depends on VIDEO_EXYNOS
       default n
       help
         This is a platform driver for EXYNOS REPEATER device.
	---help---
	  Repeater driver for WFD
```

## drivers/media/platform/exynos/tsmux/Kconfig
```kconfig
#
# Exynos tsmux device driver
#

config VIDEO_EXYNOS_TSMUX
	bool "EXYNOS TSMUX Driver"
	depends on VIDEO_EXYNOS
	default n
	---help---
	  Repeater driver for WFD
```

## drivers/media/radio/rtc6213n/Kconfig
```kconfig
config I2C_RTC6213N
	tristate "Richwave RTC6213N FM Radio Receiver support with I2C"
	depends on I2C && RADIO_RTC6213N
	---help---
	  This is a driver for I2C devices with the Richwave RTC6213N
	  chip.

	  Say Y here if you want to connect this type of radio to your
	  computer's I2C port.

	  To compile this driver as a module, choose M here: the
	  module will be called radio-i2c-RTC6213N.
```

## drivers/media/tdmb/Kconfig
```kconfig
#
# TDMB config states
#

#klaatu TDMB
config TDMB
	bool "T-DMB"
	help
	  This allows T-DMB support for Korea.
	  This module is designed for SPI or EBI2.
	  Select chipset and interface
	  Need to check I/F

	config TDMB_VENDOR_FCI
	depends on TDMB
	bool "FCI"

choice
	depends on TDMB && TDMB_VENDOR_FCI
	prompt "chip"
	default TDMB_FC8080

	config TDMB_FC8080
		bool "FC8080"
		help
		This tuner chip named FC8080
		Support TDMB
		check OSC
		check I/F
endchoice

config TDMB_VENDOR_RAONTECH
	depends on TDMB
	bool "Raontech"

choice
	depends on TDMB && TDMB_VENDOR_RAONTECH
	prompt "chip"
	default TDMB_MTV319
	config TDMB_MTV319
		bool "MTV319"
		help
		This tuner chip named MTV319
		Support TDMB
		check OSC
		check I/F
endchoice

choice
	depends on TDMB
	prompt "AP vendor"
	default TDMB_SLSI
	config TDMB_QUALCOMM
		bool "Qualcomm"
		help
		Use Qualcomm AP
		Support TDMB
		check OSC
		check I/F
	config TDMB_SLSI
		bool "S.LSI"
		help
		Use S.LSI AP
		Support TDMB
		check OSC
		check I/F
endchoice

config TDMB_SPI
	depends on TDMB
	bool "SPI"
	help
	Use SPI
	Support TDMB
	check clock speed
	check DMA support

config TDMB_EBI
	depends on TDMB
	bool "EBI"
	help
	Use EBI
	Support TDMB
	check speed
	check AP support

config TDMB_TSIF_SLSI
	depends on TDMB
	bool "SLSI TSIF"
	help
	Use TSIF
	Support TDMB
	check speed
	check AP support

config TDMB_TSIF_QC
	depends on TDMB
	bool "Qualcomm TSIF"
	help
	Use TSIF
	Support TDMB
	check speed
	check AP support

config TDMB_I2C
	depends on TDMB
	bool "I2C"
	help
	Use for command
	Support TDMB
	check speed
	check AP support

config TDMB_XTAL_FREQ
	depends on TDMB
	bool "use xtal freq"
	default 0
	help
	Use external OSC
	Support TDMB
	check freq
	check tuner support

config TDMB_DEBUG
	depends on TDMB
	bool "tdmb debugfs"
	help
	Use for debug
	Support TDMB
	check source code
	check AP support

config TDMB_ANT_DET
	depends on TDMB
	bool "tdmb antenna detector"
	help
	Use for ant detection
	Support TDMB
	check HW schematic
	check level

config TDMB_VREG_SUPPORT
	depends on TDMB
	bool "tdmb use regulator vdd"
	help
	Use for power
	Support TDMB
	check HW schematic
	check usage

config TDMB_NOTIFIER
	bool "tdmb notifier"
	default n
	help
	  Say Y to enable tdmb notifier
	  notify tdmb on or off
	  check tunner status
	  check usage
```

## drivers/misc/dev_ril_bridge/Kconfig
```kconfig
#
# DEV_RIL_BRIDGE Device Driver
#

config DEV_RIL_BRIDGE
	bool "Support a bridge between device and RIL"
	default n
```

## drivers/misc/mcu_ipc/Kconfig
```kconfig
#
# MCU_IPC Device Driver
#

config MCU_IPC
	bool "MCU IPC Support"
	default n
	help
	  This enables MCU_IPC driver to control the MCU_IPC Device.
	  MCU_IPC is the Mailbox which has 16 interrupts for TX/RX each
	  and 256 bytes memory for communicating messages.
	  AP and CP can share the messages through this device.

if MCU_IPC

config MCU_IPC_TEST
	bool "MCU_IPC driver test"
	depends on MCU_IPC
	help
	  This enables MCU_IPC_TEST for checking mailbox at probe time.

endif

config SHM_IPC
	bool "Shared Memory for IPC support"
	depends on LINK_DEVICE_SHMEM || LINK_DEVICE_PCIE
	default n
	help
	  This enables SHM_IPC driver to control the Shared memory
	  for AP-CP Interface.
```
