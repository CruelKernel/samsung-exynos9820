## drivers/net/wireless/broadcom/bcmdhd_100_15/Kconfig
```kconfig
config BROADCOM_WIFI
	bool "Broadcom WiFi Driver"
	depends on WLAN && WLAN_VENDOR_BROADCOM
	default y
	---help---
	  This is a configuration for Broadcom WLAN driver.

config BCM4330
	tristate "Broadcom 4330 wireless cards support"
	depends on BROADCOM_WIFI
	---help---
	  This module adds support for wireless adapters based on
	  Broadcom 4330 chipset.

config BCM4343
	tristate "Broadcom 4343 wireless cards support"
	depends on BROADCOM_WIFI
	---help---
	  This module adds support for wireless adapters based on
	  Broadcom 4343 chipset.

config BCM43436
	tristate "Broadcom 43436 wireless cards support"
	depends on BROADCOM_WIFI
	---help---
	  This module adds support for wireless adapters based on
	  Broadcom 43436 chipset.

config BCM4334
	tristate "Broadcom 4334 wireless cards support"
	depends on BROADCOM_WIFI
	---help---
	  This module adds support for wireless adapters based on
	  Broadcom 4334 chipset.

config BCM4335
	tristate "Broadcom 4335 wireless cards support"
	depends on BROADCOM_WIFI
	---help---
	  This module adds support for wireless adapters based on
	  Broadcom 4335 chipset.

config BCM4339
	tristate "Broadcom 4339 wireless cards support"
	depends on BROADCOM_WIFI
	---help---
	  This module adds support for wireless adapters based on
	  Broadcom 4339 chipset.

config BCM4354
	tristate "Broadcom 4354 wireless cards support"
	depends on BROADCOM_WIFI
	---help---
	  This module adds support for wireless adapters based on
	  Broadcom 4354 chipset.

config BCM43012
	tristate "Broadcom 43012 wireless cards support"
	depends on BROADCOM_WIFI
	---help---
	  This module adds support for wireless adapters based on
	  Broadcom 43012 chipset.

config BCM4358
	tristate "Broadcom 4358 wireless cards support"
	depends on BROADCOM_WIFI
	---help---
	  This module adds support for wireless adapters based on
	  Broadcom 4358 chipset.

config BCM4359
	tristate "Broadcom 4359 wireless cards support"
	depends on BROADCOM_WIFI
	---help---
	  This module adds support for wireless adapters based on
	  Broadcom 4359 chipset.

config BCM4361
	tristate "Broadcom 4361 wireless cards support"
	depends on BROADCOM_WIFI
	---help---
	  This module adds support for wireless adapters based on
	  Broadcom 4361 chipset.

config BCM4375
	tristate "Broadcom 4375 wireless cards support"
	depends on BROADCOM_WIFI
	---help---
	  This module adds support for wireless adapters based on
	  Broadcom 4375 chipset.

config BCM43241
	tristate "Broadcom 43241 wireless cards support"
	depends on BROADCOM_WIFI
	---help---
	  This module adds support for wireless adapters based on
	  Broadcom 43241 chipset.

config BCM43455
        tristate "Broadcom 43455 wireless cards support"
        depends on BROADCOM_WIFI
        ---help---
          This module adds support for wireless adapters based on
          Broadcom 43455 chipset.

config BCM43456
	tristate "Broadcom 43456 wireless cards support"
	depends on BROADCOM_WIFI
	---help---
	  This module adds support for wireless adapters based on
	  Broadcom 43456 chipset.

config BCM4334W
	tristate "Broadcom 4334W wireless cards support"
	depends on BROADCOM_WIFI
	---help---
	  This module adds support for wireless adapters based on
	  Broadcom 4334W chipset.

config BCM43454
        tristate "Broadcom 43454 wireless cards support"
        depends on BROADCOM_WIFI
        ---help---
          This module adds support for wireless adapters based on
          Broadcom 43454 chipset.

config BCMDHD_FW_PATH
	depends on BROADCOM_WIFI
	string "Firmware path"
	default "/etc/wifi/bcmdhd_sta.bin"
	---help---
	  Path to the firmware file.

config BCMDHD_NVRAM_PATH
	depends on BROADCOM_WIFI
	string "NVRAM path"
	default "/etc/wifi/nvram_net.txt"
	---help---
	  Path to the nvram file.

config BROADCOM_WIFI_RESERVED_MEM
	bool "BROADCOM Reserved memory for wifi device"
	depends on BROADCOM_WIFI
	default y
	---help---
	  This is a configuration for Broadcom WLAN driver.

config WIFI_BROADCOM_COB
        bool "BROADCOM WIFI COB"
        depends on (BCM43456 || BCM43455 || BCM4343 || BCM43436 || BCM43454 || BCM43012)
        ---help---
          This is a configuration for Broadcom WIFI COB Type.

config BCM4335BT
	bool "BROADCOM BTLOCK Enable"
	depends on BCM4335
	default y
	---help---
	  This is a configuration for bt lock enable.

config WLAN_REGION_CODE
	int "---Region codes for Broadcom WiFi Driver"
	depends on BROADCOM_WIFI
	default 100
	---help---
		This is a region code for Broadcom Wi-Fi featured functions.
		- 100 : EUR OPEN
		- 101 : EUR ORG
		- 200 : KOR OPEN
		- 201 : KOR SKT
		- 202 : KOR KTT
		- 203 : KOR LGT
		- 300 : CHN OPEN

config WLAIBSS
	bool "Advanced IBSS mode"
	depends on (BCM4335 || BCM4339 || BCM4354 || BCM4358 || BCM4359 || BCM4361 || BCM4375)
	default y
	---help---
	  This is a configuration for Oxygen Network.

config WL_RELMCAST
	bool "Reliable Multicast Support"
	depends on (BCM4335 || BCM4339 || BCM4354 || BCM4358 || BCM4359 || BCM4361 || BCM4375)
	default y
	---help---
	  This is a configuration for RMC.

config WL_NAN
	bool "NAN Feature"
	depends on BROADCOM_WIFI
	default n
	---help---
	  This is a configuration for NAN Feature.

config BCMDHD_PCIE
	bool "Enable PCIe I/F Support"
	depends on (BCM4354 || BCM4358 || BCM4359 || BCM4361 || BCM4375) && PCI
	default y
	---help---
	  Enable PCI Express I/F Support

config BCMDHD_PREALLOC_PKTIDMAP
	bool "BROADCOM PCIE specific memory reserved for PKTIDMAP"
	depends on BROADCOM_WIFI_RESERVED_MEM && BCMDHD_PCIE
	---help---
	  Preallocated memory support for PCIE interface in Broadcom
	  WLAN driver.

config BCMDHD_PREALLOC_MEMDUMP
	bool "BROADCOM PCIE specific memory reserved for MEMDUMP"
	depends on BROADCOM_WIFI_RESERVED_MEM
	default y
	---help---
	  Preallocated memory support for dongle memory dump

config BCMDHD_OOB_HOST_WAKE
	bool "Use the external WLAN_HOST_WAKE pin"
	depends on BROADCOM_WIFI
	default y
	---help---
	  Use the external GPIO pin to wake up host

config SPLIT_ARGOS_SET
	bool "Support argos table"
	depends on BROADCOM_WIFI
	---help---
	To support SPLIT_ARGOS_SET

config WLAN_VHTDISABLE
	bool "WLAN Disable 11ac"
	depends on BCM43456
	default n
	---help---
	This is a configuration to disable 11ac.

config WLAN_TSQ_MULTIPLIER
	bool "Enable TCP TSQ_MULTIPLIER"
	depends on BROADCOM_WIFI
	default n
	---help---
	This is configuration for TCP TSQ_MULTIPLIER

config WLAN_VENDOR_DUMP_ENABLE
	bool "Enable dump policy as Android Global DE Policy"
	depends on BROADCOM_WIFI
	default n
	---help---
	Change WLAN Debug dump policy as Global DE policy

config BCMDHD_GET_OOB_STATE
        bool "Support WLAN_HOST_WAKE pin level information"
        depends on BCMDHD_OOB_HOST_WAKE
        default y
        ---help---
          Support WLAN_HOST_WAKE pin level information
```

## drivers/net/wireless/broadcom/bcmdhd_101_16/Kconfig
```kconfig
#
# Copyright (C) 2022, Broadcom.
#
#      Unless you and Broadcom execute a separate written software license
# agreement governing use of this software, this software is licensed to you
# under the terms of the GNU General Public License version 2 (the "GPL"),
# available at http://www.broadcom.com/licenses/GPLv2.php, with the
# following added to such license:
#
#      As a special exception, the copyright holders of this software give you
# permission to link this software with independent modules, and to copy and
# distribute the resulting executable under terms of your choice, provided that
# you also meet, for each linked independent module, the terms and conditions of
# the license of that module.  An independent module is a module which is not
# derived from this software.  The special exception does not apply to any
# modifications of the software.
#
#
# <<Broadcom-WL-IPTag/Open:>>
#
config BROADCOM_WIFI
	bool "Broadcom WiFi Driver"
	depends on WLAN && BCM_DHD_WLAN
	default y
	---help---
	  This is a configuration for Broadcom WLAN driver.

config BCM4330
	tristate "Broadcom 4330 wireless cards support"
	depends on BROADCOM_WIFI
	---help---
	  This module adds support for wireless adapters based on
	  Broadcom 4330 chipset.

config BCM4343
	tristate "Broadcom 4343 wireless cards support"
	depends on BROADCOM_WIFI
	---help---
	  This module adds support for wireless adapters based on
	  Broadcom 4343 chipset.

config BCM4334
	tristate "Broadcom 4334 wireless cards support"
	depends on BROADCOM_WIFI
	---help---
	  This module adds support for wireless adapters based on
	  Broadcom 4334 chipset.

config BCM4335
	tristate "Broadcom 4335 wireless cards support"
	depends on BROADCOM_WIFI
	---help---
	  This module adds support for wireless adapters based on
	  Broadcom 4335 chipset.

config BCM4339
	tristate "Broadcom 4339 wireless cards support"
	depends on BROADCOM_WIFI
	---help---
	  This module adds support for wireless adapters based on
	  Broadcom 4339 chipset.

config BCM4354
	tristate "Broadcom 4354 wireless cards support"
	depends on BROADCOM_WIFI
	---help---
	  This module adds support for wireless adapters based on
	  Broadcom 4354 chipset.

config BCM43012
	tristate "Broadcom 43012 wireless cards support"
	depends on BROADCOM_WIFI
	---help---
	  This module adds support for wireless adapters based on
	  Broadcom 43012 chipset.

config BCM43013
	tristate "Broadcom 43013 wireless cards support"
	depends on BROADCOM_WIFI
	---help---
	  This module adds support for wireless adapters based on
	  Broadcom 43013 chipset.

config BCM4358
	tristate "Broadcom 4358 wireless cards support"
	depends on BROADCOM_WIFI
	---help---
	  This module adds support for wireless adapters based on
	  Broadcom 4358 chipset.

config BCM4359
	tristate "Broadcom 4359 wireless cards support"
	depends on BROADCOM_WIFI
	---help---
	  This module adds support for wireless adapters based on
	  Broadcom 4359 chipset.

config BCM4361
	tristate "Broadcom 4361 wireless cards support"
	depends on BROADCOM_WIFI
	---help---
	  This module adds support for wireless adapters based on
	  Broadcom 4361 chipset.

config BCM4375
	tristate "Broadcom 4375 wireless cards support"
	depends on BROADCOM_WIFI
	---help---
	  This module adds support for wireless adapters based on
	  Broadcom 4375 chipset.

config BCM4389
	tristate "Broadcom 4389 wireless cards support"
	depends on BROADCOM_WIFI
	---help---
	  This module adds support for wireless adapters based on
	  Broadcom 4389 chipset.

config BCM43241
	tristate "Broadcom 43241 wireless cards support"
	depends on BROADCOM_WIFI
	---help---
	  This module adds support for wireless adapters based on
	  Broadcom 43241 chipset.

config BCM43455
        tristate "Broadcom 43455 wireless cards support"
        depends on BROADCOM_WIFI
        ---help---
          This module adds support for wireless adapters based on
          Broadcom 43455 chipset.

config BCM4334W
	tristate "Broadcom 4334W wireless cards support"
	depends on BROADCOM_WIFI
	---help---
	  This module adds support for wireless adapters based on
	  Broadcom 4334W chipset.

config BCM43454
        tristate "Broadcom 43454 wireless cards support"
        depends on BROADCOM_WIFI
        ---help---
          This module adds support for wireless adapters based on
          Broadcom 43454 chipset.

config BCMDHD_FW_PATH
	depends on BROADCOM_WIFI
	string "Firmware path"
	default "/etc/wifi/bcmdhd_sta.bin"
	---help---
	  Path to the firmware file.

config BCMDHD_NVRAM_PATH
	depends on BROADCOM_WIFI
	string "NVRAM path"
	default "/etc/wifi/nvram_net.txt"
	---help---
	  Path to the nvram file.

config BROADCOM_WIFI_RESERVED_MEM
	bool "BROADCOM Reserved memory for wifi device"
	depends on BROADCOM_WIFI
	default y
	---help---
	  This is a configuration for Broadcom WLAN driver.

config WIFI_BROADCOM_COB
        bool "BROADCOM WIFI COB"
        depends on (BCM43455 || BCM4343 || BCM43454 || BCM43012 || BCM43013)
        ---help---
          This is a configuration for Broadcom WIFI COB Type.

config BCM4335BT
	bool "BROADCOM BTLOCK Enable"
	depends on BCM4335
	default y
	---help---
	  This is a configuration for bt lock enable.

config WLAN_REGION_CODE
	int "---Region codes for Broadcom WiFi Driver"
	depends on BROADCOM_WIFI
	default 100
	---help---
		This is a region code for Broadcom Wi-Fi featured functions.
		- 100 : EUR OPEN
		- 101 : EUR ORG
		- 200 : KOR OPEN
		- 201 : KOR SKT
		- 202 : KOR KTT
		- 203 : KOR LGT
		- 300 : CHN OPEN

config WLAIBSS
	bool "Advanced IBSS mode"
	depends on (BCM4335 || BCM4339 || BCM4354 || BCM4358 || BCM4359 || BCM4361 || BCM4375 || BCM4389)
	default y
	---help---
	  This is a configuration for Oxygen Network.

config WL_RELMCAST
	bool "Reliable Multicast Support"
	depends on (BCM4335 || BCM4339 || BCM4354 || BCM4358 || BCM4359 || BCM4361 || BCM4375 || BCM4389)
	default y
	---help---
	  This is a configuration for RMC.

config WL_NAN
	bool "NAN Feature"
	depends on BROADCOM_WIFI
	default n
	---help---
	  This is a configuration for NAN Feature.

config BCMDHD_PCIE
	bool "Enable PCIe I/F Support"
	depends on (BCM4354 || BCM4358 || BCM4359 || BCM4361 || BCM4375 || BCM4389) && PCI
	default y
	---help---
	  Enable PCI Express I/F Support

config BCMDHD_PREALLOC_PKTIDMAP
	bool "BROADCOM PCIE specific memory reserved for PKTIDMAP"
	depends on BROADCOM_WIFI_RESERVED_MEM && BCMDHD_PCIE
	---help---
	  Preallocated memory support for PCIE interface in Broadcom
	  WLAN driver.

config BCMDHD_PREALLOC_MEMDUMP
	bool "BROADCOM PCIE specific memory reserved for MEMDUMP"
	depends on BROADCOM_WIFI_RESERVED_MEM
	default y
	---help---
	  Preallocated memory support for dongle memory dump

config BCMDHD_OOB_HOST_WAKE
	bool "Use the external WLAN_HOST_WAKE pin"
	depends on BROADCOM_WIFI
	default y
	---help---
	  Use the external GPIO pin to wake up host

config SPLIT_ARGOS_SET
	bool "Support argos table"
	depends on BROADCOM_WIFI
	---help---
	To support SPLIT_ARGOS_SET

config WLAN_TSQ_MULTIPLIER
	bool "Enable TCP TSQ_MULTIPLIER"
	depends on BROADCOM_WIFI
	default n
	---help---
	This is configuration for TCP TSQ_MULTIPLIER

config WLAN_VENDOR_DUMP_ENABLE
	bool "Enable dump policy as Android Global DE Policy"
	depends on BROADCOM_WIFI
	default n
	---help---
	Change WLAN Debug dump policy as Global DE policy

config BCMDHD_GET_OOB_STATE
	bool "Support WLAN_HOST_WAKE pin level information"
	depends on BCMDHD_OOB_HOST_WAKE
	default y
	---help---
	Support WLAN_HOST_WAKE pin level information

config WLAN_BCM4375_ADVANCED_FEATURES
	bool "Support BCM4375 Advanced Feature"
	depends on BCM4375
	default n
	---help---
	Support BCM4375 Advanced Feature

config WLAN_SOFTAP_HE_ENABLE
	bool "Support BCM4375 SoftAP HE enable"
	depends on BCM4375
	default n
	---help---
	Support BCM4375 SoftAP HE Feature

config WLAN_ANQP_RMAC_BACKPORTED
	bool "Support backported kernel ANQP Random MAC Feature"
	depends on BROADCOM_WIFI
	default n
	---help---
	Support backported kernel ANQP Random MAC Feature

config WLAN_MERLOT
	bool "Merlot"
	depends on BCM43013
	default n
	---help---
	Support Merlot
```
