## drivers/misc/modem_v1_dual/Kconfig
```kconfig
menuconfig SEC_SIPC_DUAL_MODEM_IF
	bool "Samsung Mobile SIPC Dual Modem Interface"
	default n
	---help---
	  Samsung Dual Modem Interface Driver

if SEC_SIPC_DUAL_MODEM_IF

config SEC_MODEM_S5000AP
	bool "Exynos ModAP S5xxxAP"
	select UMTS_MODEM_S5000AP
	select LINK_DEVICE_SHMEM
	select CP_SECURE_BOOT
	select CP_RAM_LOGGING
	select LINK_DEVICE_NAPI
	select CP_ZEROCOPY
	select MODEM_IF_NET_GRO
	select CP_LINEAR_WA
	select CP_ETDAC_OTP_WA
	default n

config SEC_MODEM_S5100
	bool "Exynos S51xx"
	select UMTS_MODEM_S5100
	select BOOT_DEVICE_SPI
	select LINK_DEVICE_PCIE
	default n

config SEC_MODEM_SS310AP
	bool "Exynos ModAP S3xxAP"
	select UMTS_MODEM_SS310AP
	select LINK_DEVICE_SHMEM
	select CP_SECURE_BOOT
	select CP_RAM_LOGGING
	select LINK_DEVICE_NAPI
	select CP_ZEROCOPY
	default n

menu "Configuration Description"
config BOOT_DEVICE_SPI
	bool "boot device: SPI"
	default n

config LINK_DEVICE_MEMORY
	bool "Memory-type (i.e. shared memory) interface medium"
	default n

config LINK_POWER_MANAGEMENT
	bool "Power management (PM) for a link device"
	default n

config LINK_POWER_MANAGEMENT_WITH_FSM
	bool "FSM-based Power management (PM) for a link device"
	depends on LINK_POWER_MANAGEMENT
	default n

config LINK_DEVICE_WITH_SBD_ARCH
	bool "Link device with the SBD architecture from MIPI-LLI"
	default n

config LINK_DEVICE_NAPI
	bool "Use Rx polling (NAPI)"
	default n
	help
	NAPI is a new driver API designed to reduce CPU and interrupt load
	when the driver is receiving lots of packets.

config CP_ZEROCOPY
	bool "Support zero memory copy"
	default n

config CP_DIT
	bool "Support DIT"
	default n
	help
	DIT (Direct Internet packet Transfer engine)

config CP_LINEAR_WA
	bool "CP linear mode work-around for Exynos9820"
	default n

config CP_PKTPROC
	bool "Support packet processor"
	default n
	help
	Packet processor

config CP_PKTPROC_V2
	bool "Support packet processor V2"
	depends on LINK_DEVICE_NAPI
	default n
	help
	Packet processor V2

config LINK_DEVICE_C2C
	bool "Pseudo shared-memory with chip-to-chip (C2C) interface"
	select LINK_DEVICE_MEMORY
	select LINK_POWER_MANAGEMENT
	default n

config LINK_DEVICE_LLI
	bool "link device: MIPI-LLI"
	select MIPI_LLI
	select LINK_DEVICE_MEMORY
	select LINK_POWER_MANAGEMENT
	select LINK_DEVICE_WITH_SBD_ARCH
	default n

config LINK_DEVICE_SHMEM
	bool "Real system-level shared-memory on a system bus"
	default n

config LINK_DEVICE_HSIC
	bool "link device: HSIC"
	default n

config LINK_DEVICE_PCIE
	bool "modem driver link device PCIe"
	default n

config LTE_MODEM_XMM7260
	bool "modem chip : IMC XMM7260"
	default n

config UMTS_MODEM_SS310AP
	bool "modem chip : Exynos ModAP S3xxAP"
	default n

config UMTS_MODEM_S5000AP
	bool "modem chip : Exynos ModAP S5xxxAP"
	default n

config UMTS_MODEM_S5100
	bool "modem chip : Exynos S5100(2chip)"
	default n

config DEBUG_PKTLOG
	bool "IPC pcap logging feature"
	default n

config LINK_CONTROL_MSG_IOSM
	bool "Control Message Type: IPC Over Shared Memory (IOSM)"
	default n

config CP_SECURE_BOOT
	bool "Support CP Secure Boot"
	default n

config GPIO_DS_DETECT
	bool "Support GPIO DS Detect"
	default n

config CP_RAM_LOGGING
	bool "Support CP ram logging feature"
	default n

config HW_REV_DETECT
	bool "Support HW REV Detect"
	default n

config MODEM_IF_QOS
	bool "Implement QoS for sbd"
	depends on LINK_DEVICE_SHMEM
	default n
	---help---
	  This enables Qos for SBD model

config MODEM_IF_NET_GRO
	bool "enable GRO feature"
	depends on LINK_DEVICE_SHMEM
	default n
	---help---
	 This enables GRO(Generic Receive Offload) feature

config CP_ETDAC_OTP_WA
	bool "Support CP ET-DAC OTP"
	default n

config KLAT
	bool "kernel CLAT"
	default n

endmenu
endif
```

## drivers/misc/tui/Kconfig
```kconfig
config SAMSUNG_TUI
	bool "TUI HW Handler"
	default n
	help
		Provide methods for TUI such as acquisition of buffer
		to be used as secure frame buffer in Secure World and
		synchronization of display and touch device between
		Normal World and Secure World.

config SAMSUNG_TUI_TEST
	bool "Testing module for TUI HW handler"
	default n
	depends on SAMSUNG_TUI
	help
		support TUI Driver Test
```

## drivers/misc/tzdev/Kconfig
```kconfig
menuconfig TZDEV
	bool "Samsung TZ Based Secure OS Support"
	default n
	depends on ARM || ARM64
	help
	  Samsung TZ Based Secure OS interface driver.

if TZDEV
config TZDEV_SK_PFNS_64BIT
	bool "Secure kernel works with 64-bit PFNs"
	default n
	help
	  Enables passing of PFNs into secure kernel as 64-bit values. Should
	  correspond to similar config in SK.

config TZDEV_USE_ARM_CALLING_CONVENTION
	bool "Comply to ARM calling convention"
	default y
	help
	  Comply to ARM calling convention. New software architectures use
	  EL3 code comply to this convention compared to old architectures
	  when Secure kernel contains non-compatible commands handler.

config TZDEV_CMA
	bool "Allocate TrustZone environment CMA region"
	depends on (CMA || DMA_CMA) && !ARCH_MSM
	default n
	help
	  Use CMA region to allocate TrustZone environment memory.

config TZDEV_MEMRESSZ
	hex "TrustZone environment memory reservation size"
	depends on TZDEV_CMA
	default 0x01000000
	help
	  Provide reservation of memory for usage in secure world - allocation size.

config TZDEV_MEMRESSZPROT
	hex "TrustZone environment memory reservation size - protected"
	depends on TZDEV_CMA
	help
	  Provide reservation of memory for usage in secure world - bootloader-protected size.

config TZDEV_MEMRESADDR
	hex "TrustZone environment memory reservation address"
	depends on TZDEV_CMA
	help
	  Provide reservation of memory for usage in secure world - allocation address.

config TZDEV_IWI_EVENT
	int "IWI_EVENT interrupt number"
	default 280 if ARCH_MSM
	default 125 if ARCH_EXYNOS3
	default 113 if ARCH_EXYNOS4
	default 501 if ARCH_EXYNOS5
	default 446 if ARCH_EXYNOS7

config TZDEV_IWI_PANIC
	int "IWI_PANIC interrupt number"
	default 0 if ARCH_MSM
	default 126 if ARCH_EXYNOS3
	default 114 if ARCH_EXYNOS4
	default 502 if ARCH_EXYNOS5
	default 447 if ARCH_EXYNOS7

config TZDEV_SWD_PANIC_IS_CRITICAL
	bool "Panic NWd if secure world panics"
	default n
	help
	  Enable support of NWd panic generation in tzdev when secure world panics.

config TZDEV_NWD_PANIC_ON_CLOSE
	bool "Panic NWd if tzdev is closed"
	default n
	help
	  Panic system on crash/close of NWd components.

config TZLOG
	bool "TZDEV LOGGER support"
	default n
	help
	  Enable support for Samsung Secure OS Logger.

config TZLOG_POLLING
	bool "TZDEV LOGGER polling"
	depends on TZLOG
	default n
	help
	  Enable periodic logs polling by TZDEV.

config TZLOG_POLLING_PERIOD
	int "TZDEV LOGGER polling period (in ms)"
	depends on TZLOG_POLLING
	default 100
	help
	  Define logs polling period in milliseconds. The resolution is 1/Hz ms
	  rounded down (e.g. for Hz = 100, value 117 would mean 110 ms period).

config TZLOG_PG_CNT
	int "TZDEV LOGGER per-CPU buffer size (in pages)"
	depends on TZLOG
	default 1
	help
	  Select TZDEV logger buffer size in pages per CPU.

config TZDEV_SK_MULTICORE
	bool "TZDEV SK multicore"
	default n
	help
	  Define if secure kernel can work in multicore mode.

config ION_FD2PHYS
	tristate "ION FD to physical address converter"
	depends on ION && (ARCH_EXYNOS || ARCH_MSM || ARCH_WHALE || ARCH_MT6755 || ARCH_MT6735 || ARCH_RANCHU || MACH_MT6757)
	default y
	help
	  Provide a method for userspace to get physical address from ION buffer
	  descriptor.

config TZIRS
	bool "Integrity reporting system"
	default n
	help
	  Enable Integrity reporintg system for Samsung Secure OS.

config TZTUI
	bool "Trusted user interface"
	default n
	help
	  Enable Trusted user interface support for Samsung Secure OS.

config TZDEV_HOTPLUG
	bool "Core hotplug"
	depends on HOTPLUG_CPU
	default n
	help
	  Enable CPU Cores requested by Samsung Secure OS.

config TZDEV_BOOST
	bool "TZ booster"
	depends on ARCH_EXYNOS
	default n
	help
	  Switch high performance cluster to maximum frequency by NWd client
	  request.

config TZ_BOOT_LOG
	bool "TZ boot stage log"
	default n
	help
	  Provide ability to print TZ boot stage logs.

config TZ_BOOT_LOG_PG_CNT
	int "TZ boot stage log buffer size (in pages)"
	depends on TZ_BOOT_LOG
	default 1
	help
	  Select TZ boot stage logger buffer size in pages.

config TZDEV_QC_CRYPTO_CLOCKS_MANAGEMENT
	bool "TZDEV crypto clock management"
	default n
	help
	  Enable QC HW crypto clock management.

config TZDEV_QC_CRYPTO_CLOCKS_USR_MNG
	bool "User crypto clock management"
	depends on TZDEV_QC_CRYPTO_CLOCKS_MANAGEMENT
	default n
	help
	  Enable QC HW crypto clock management from User space. If disabled,
	  QC HW clock disable/enable is done in TZDEV.

config TZDEV_DEBUG
	bool "Debug extensions"
	default n
	help
	  Debug extensions for samsung TZ Based Secure OS interface driver.

config TZ_NWFS
	bool "Normal world file system interface driver"
	default n
	help
	  Normal world file system interface driver.

config TZDEV_DEPLOY_TZAR
	bool "tzdev deploy startup.tzar"
	default n
	help
	  Deploy startup.tzar when tzdev init.

choice
	prompt "Choose per-cpu kthread workers variant"
	default TZDEV_KTHREADS_NOTIFIER
	help
	  This option selects implementation to manage per-cpu kthreads.

	config TZDEV_KTHREADS_NOTIFIER
		bool "Use old-style cpu notifiers"
	config TZDEV_KTHREADS_SMPBOOT
		depends on TZDEV_SK_MULTICORE
		bool "Use smpboot hotplug subsystem"
endchoice

if TZDEV_DEBUG

config TZ_TELEMETRY
	bool "Telemetry module"
	select TZ_TRANSPORT
	default n
	help
	  Enable Telemetry module. It is used for collecting runtime information
	  about Secure OS state.

config TZPROFILER
	bool "TZDEV PROFILING support"
	default n
	help
	  Enable support for secure kernel and userspace profiling.

config TZPROFILER_BUF_PG_CNT
	int "TZDEV PROFILER buffer size (in pages)"
	depends on TZPROFILER
	default 1
	help
	  Select TZDEV profiler buffer size in pages. Profiler uses pool
	  of buffers. This is size of each buffer. Minimum size is a 1 page.
	  Select the sufficient size for profiling of the target.

config TZPROFILER_BUFS_CNT
	int "TZDEV PROFILER buffers quantity"
	depends on TZPROFILER
	default 20
	help
	  Select the sufficient pool size for profiling of the target.
	  Profiler uses two mechanisms for profiler data transferring.
	  1. Circular buffer.
	  2. Buffer replacing if according to the point 1 NWd had no time for
	     cleaning the previous buffer.
	  The profiler stops working if there are no free buffers in pool.

config TZ_PANIC_DUMP
	bool "TZ panic dump module"
	depends on TZDEV
	default n
	help
	  Enable panic dump module. This module allocates the buffer that will
	  receive SWd memory contents when secure kernel panic
	  occurs (if proper option is set in secure kernel config) and
	  provides interface for userspace to access said memory contents.

endif #TZDEV_DEBUG

endif #TZDEV
```

## drivers/motor/Kconfig
```kconfig
config ANDROID_TIMED_OUTPUT
	bool "Timed output class driver"
	default n

config MOTOR_CS40L2X
	tristate "motor"
	default n
	help
	  Say Y to enable MOTOR_CS40L2X.
	  
config MOTOR_DRV_MAX77705
	tristate "Maxim MAX77705 motor"
	default n
	depends on MFD_MAX77705
	help
	  If you say yes here you will get support for the
	  motor of Maxim MAX77705 PMIC.
	  To enable this driver, MFD_MAX77705 should be enabled and
	  MFD_MAX77705 calls this driver.

config SEC_HAPTIC
	tristate "sec haptic"
	default n
	depends on DRV_SAMSUNG
	help
	  If you say yes here you will get support for the
	  sec haptic driver.
	  To enable this driver, DRV_SAMSUNG should be enabled and
	  motor driver calls this driver.

config VIB_NOTIFIER
	bool "VIB notifier support"
	default n
	help
	  If you say yes here you will get support for
	  the VBUS status change notification.
```

## drivers/muic/Kconfig
```kconfig
#
# MUIC devices
#

comment "MUIC configs"

config USE_MUIC
	bool "Using MUIC device driver"
	depends on I2C
	default n
	help
	  If you say yes here you will get support for
	  the MUIC device driver.

config MUIC_NOTIFIER
	bool "MUIC notifier support"
	depends on USE_MUIC
	default n
	help
	  If you say yes here you will get support for
	  the MUIC attached device status change notification.

config MUIC_MAX77705
        bool "Using MAX77705 MUIC"
        depends on USE_MUIC
        default n
        help
          If you say yes here you will get support for
          the MAX77705 MUIC chip.
	  To enable this driver,
	  USE_MUIC should be enabled.

config HV_MUIC_MAX77705_AFC
        bool "Using MAX77705 AFC MUIC"
        depends on MUIC_MAX77705
        default n
        help
          If you say yes here you will get support for
	  the MAX77705 AFC MUIC.
	  To enable this driver,
	  MUIC_MAX77705 should be enabled.

config MUIC_MANAGER
	bool "MUIC Manager supports CCIC chip interface"
	depends on USE_MUIC && MFD_S2MU004
	default n
	help
	  If you say yes here you will get support manager for the CCIC chip.

config MUIC_HV
	bool "MUIC_HV"
	depends on MUIC_UNIVERSAL
	default n
	help
	  If you say yes here you will get support for the AFC.

config MUIC_HV_12V
	bool "MUIC_HV_12V"
	depends on MUIC_HV
	default n
	help
	  If you say yes here you will get support for the AFC.

config MUIC_SUPPORT_CCIC
	bool "MUIC supports CCIC chip interface"
	default n
	help
	  If you say yes here you will get support for the CCIC chip.

config MUIC_MAX77705_CCIC
        bool "Using MAX77705 MUIC supports CCIC chip interface"
        depends on MUIC_MAX77705 && MUIC_SUPPORT_CCIC
        default n
        help
          If you say yes here you will get support for
	  the CCIC chip with MAX77705 MUIC.
	  To enable this driver,
	  MUIC_MAX77705 and MUIC_SUPPORT_CCIC should be enabled.

config MUIC_TEST_FUNC
	bool "MUIC supports several function's in TEST"
	depends on SEC_DEBUG && !SAMSUNG_PRODUCT_SHIP
	default n
	help
	  If you say yes here you will get support for the TEST function's.

config HICCUP_CHARGER
	bool "Using HICCUP charger"
	depends on USE_MUIC
	default n
	help
		If you say yes here you will get support for
		for the hiccup charger feature.

config HV_MUIC_VOLTAGE_CTRL
	bool "Using AFC Voltage control functionality"
	depends on MUIC_HV_S2MU004_AFC
	default n
	help
	  If you say yes here you will get support for
	  the AFC voltage control functionality.

config USE_SECOND_MUIC
	bool "Using second MUIC"
	depends on USE_MUIC
	default n
	help
		If you say yes here you will get support for
		for the second MUIC chip feature.

config MUIC_SM5508
	bool "SM5508 MUIC"
	depends on USE_MUIC
	default n
	help
	  If you say yes here you will get support for the SM5508 MUIC chip.

config MUIC_UART_SWITCH
	bool "UART SWITCH"
	depends on USE_MUIC
	default n
	help
	  If you say yes here you will get support for the SEC UART SWITCH chip.
```

## drivers/net/wireless/broadcom/Kconfig
```kconfig
config BCM_DHD_WLAN
	bool "Broadcom devices"
	default y
	---help---
	  If you have a wireless card belonging to this class, say Y.

	  Note that the answer to this question doesn't directly affect the
	  kernel: saying N will just cause the configurator to skip all
	  the questions about  cards. If you say Y, you will be asked for
	  your specific card in the following questions.

if BCM_DHD_WLAN

source "drivers/net/wireless/broadcom/b43/Kconfig"
source "drivers/net/wireless/broadcom/b43legacy/Kconfig"
source "drivers/net/wireless/broadcom/brcm80211/Kconfig"
source "drivers/net/wireless/broadcom/bcmdhd_100_10/Kconfig"
source "drivers/net/wireless/broadcom/bcmdhd_100_15/Kconfig"
source "drivers/net/wireless/broadcom/bcmdhd_101_16/Kconfig"
source "drivers/net/wireless/broadcom/bcmdhd/Kconfig"

endif # WLAN_VENDOR_BROADCOM
```
