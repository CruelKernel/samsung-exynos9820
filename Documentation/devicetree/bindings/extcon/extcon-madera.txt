## drivers/bts/Kconfig
```kconfig
#
# BTS driver configuration
#

menuconfig EXYNOS_BTS
	bool "BTS driver support"
	default y
	help
	  Enable BTS (Bus traffic shaper) support

if EXYNOS_BTS

config EXYNOS8890_BTS
	bool "Bus traffic shaper support"
	default y
	depends on SOC_EXYNOS8890
	help
	  Enable BTS (Bus traffic shaper) support

config EXYNOS8890_BTS_OPTIMIZATION
	bool "Bus traffic shaper optimization mode"
	default n
	depends on EXYNOS8890_BTS
	help
	  Enable BTS (Bus traffic shaper) optimized set

config EXYNOS8895_BTS
	bool "Bus traffic shaper support"
	default y
	depends on SOC_EXYNOS8895
	help
	  Enable BTS (Bus traffic shaper) support

config EXYNOS9810_BTS
	bool "Bus traffic shaper support"
	default y
	depends on SOC_EXYNOS9810
	help
	  Enable BTS (Bus traffic shaper) support

config EXYNOS9820_BTS
	bool "Bus traffic shaper support"
	default y
	depends on SOC_EXYNOS9820
	help
	  With this configuration bts driver will be enabled which is for
	  setting BTS and DVFS to manage bus traffic. Default setting
	  is different to chipset because of the hardware change and DVFS
	  status.
endif
```

## drivers/ccic/Kconfig
```kconfig
#
# CCIC devices
#

comment "CCIC configs"

config USBPD_CORE
	bool "CCIC framrework core"
	depends on I2C
	default n
	help
	  If you say yes here you will get support for
	  ccic core device

config CCIC_NOTIFIER
	bool "CCIC notifier support"
	depends on I2C
	default n
	help
	  If you say yes here you will get support for
	  the CCIC attached device status change notification.

config CCIC_S2MM003 
	bool "CCIC S2MM003"
	depends on I2C 
	default n
	help
	  If you say yes here you will get support for
	  s2mm003 ccic full version chipset 

config CCIC_S2MM005 
	bool "CCIC S2MM005"
	depends on I2C 
	default n
	help
	  If you say yes here you will get support for
	  s2mm005 ccic full version chipset 

config USBPD_S2MM005
	bool "USBPD S2MM005"
	depends on USBPD_CORE
	default n
	help
	  If you say yes here you will get support for
	  s2mm005 ccic full version chipset

config CCIC_MAX77705
	bool "CCIC 77705"
	depends on I2C
	default n
	help
	  If you say yes here you will get support for
	  max77705 ccic full version chipset

config CCIC_MAX77705_DEBUG
	bool "CCIC 77705 DEBUG"
	depends on CCIC_MAX77705
	default n
	help
	  If you say yes here you will get support for
	  debugging feature with max77705 ccic chipset

config MAX77705_FW_PID03_SUPPORT
	bool "support MAX77705 FW PID 0x03"
	depends on CCIC_MAX77705
	default n
	help
	  If you say yes here you will get support for
	  specified firmware with max77705 ccic chipset

config MAX77705_GRL_ENABLE
	bool "support Eye Diagram"
	depends on CCIC_MAX77705
	depends on !MAX77705_FW_PID03_SUPPORT
	default y
	help
	  If you say yes here you will get support for Eye Diagram
	  This isn't needed for MAX77705C(MD15)

config CCIC_ALTERNATE_MODE 
	bool "support CCIC alternate mode"
	depends on I2C
	default n
	help
	  If you say yes here you will get support for
	  alternate mode

config USBPD_ALTERNATE_MODE
	bool "support CCIC alternate mode"
	depends on I2C
	default n
	help
	  If you say yes here you will get support for
	  alternate mode

config CCIC_LPM_ENABLE
	bool "Support LPM ENABLE"
	depends on I2C
	default n
	help
	  If you say yes here you will get support for
	  lpm enable

config CCIC_WATER_DETECT
	bool "support WATER DETECT"
	depends on CCIC_S2MM005
	default n
	help
	  If you say yes here you will get support for
	  water detect Enable

config PDIC_PD30
	bool "support PD30"
	depends on CCIC_MAX77705
	default n
	help
	  If you say yes here you will get support for PD30
```

## drivers/crypto/fmp/Kconfig
```kconfig
#
# SMU/FMP controller drivers
#

config EXYNOS_SMU
	tristate "Samsung EXYNOS SMU driver"
	help
	  Say yes here to build support for SMU (Secure Manangement Unit)
	  to control access permission to storage device.
	  If unsure, say N.

	  To compile this driver as a module, choose M here

config EXYNOS_FMP
	tristate "Samsung EXYNOS FMP driver"
	depends on CRYPTO_DISKCIPHER
	select EXYNOS_SMU
	help
	  Say yes here to build support for FMP (Flash Memory Protector)
	  to encrypt and decrypt userdata using inline H/W crypto module.
	  If unsure, say N.

	  To compile this driver as a module, choose M here

config EXYNOS_FMP_FIPS
	tristate "Samsung EXYNOS FMP Validation Driver for FIPS"
	depends on EXYNOS_FMP
	depends on !FUNCTION_TRACER
	help
	  Say yes here to build support for FMP (Flash Memory Protector)
	  FIPS validation driver for integrity checking, self and functional test.
	  If unsure, say N.

	  To compile this driver as a module, choose M here

choice
	prompt "Option for self-test failure"
	depends on EXYNOS_FMP_FIPS
	default NODE_FOR_SELFTEST_FAIL

config NODE_FOR_SELFTEST_FAIL
	bool "Set fips fmp node when self-test fails"
	depends on EXYNOS_FMP_FIPS
	help
	  Choose here to select that fips fmp node was set to zero
	  when FMP self-test fails.

config PANIC_FOR_SELFTEST_FAIL
	bool "Panic when self-test fails"
	depends on EXYNOS_FMP_FIPS
	help
	  Choose here to select that kernel panic occurs when FMP self-test fails.

endchoice
```

## drivers/dma-buf/Kconfig
```kconfig
menu "DMABUF options"

config SYNC_FILE
	bool "Explicit Synchronization Framework"
	default n
	select ANON_INODES
	select DMA_SHARED_BUFFER
	---help---
	  The Sync File Framework adds explicit syncronization via
	  userspace. It enables send/receive 'struct dma_fence' objects to/from
	  userspace via Sync File fds for synchronization between drivers via
	  userspace components. It has been ported from Android.

	  The first and main user for this is graphics in which a fence is
	  associated with a buffer. When a job is submitted to the GPU a fence
	  is attached to the buffer and is transferred via userspace, using Sync
	  Files fds, to the DRM driver for example. More details at
	  Documentation/sync_file.txt.

config SW_SYNC
	bool "Sync File Validation Framework"
	default n
	depends on SYNC_FILE
	depends on DEBUG_FS
	---help---
	  A sync object driver that uses a 32bit counter to coordinate
	  synchronization.  Useful when there is no hardware primitive backing
	  the synchronization.

	  WARNING: improper use of this can result in deadlocking kernel
	  drivers from userspace. Intended for test and debug only.

config DMA_BUF_CONTAINER
	bool "dma-buf container support"
	default y
	depends on DMA_SHARED_BUFFER
	---help---
	  dma-buf container is a dma-buf that can contain multiple different
	  dma-buf objects. It is useful when delivering a lot of dma-buf objects
	  between processes or user and kernel to reduce communication overhead.

config DMA_BUF_CONTAINER_TEST
	bool "test driver for dma-buf container"
	default n
	depends on DMA_BUF_CONTAINER
	---help---
	  Test driver for dma-buf container to verify the elements in the
	  dma-buf container are the same as the given list of dma-buf objects.

config DMABUF_TRACE
	bool "dma-buf trace support"
	default y
	depends on DMA_SHARED_BUFFER

endmenu
```

## drivers/fingerprint/Kconfig
```kconfig
#
# Sensor  drivers configuration
#
menuconfig SENSORS_FINGERPRINT
	bool "Finger Print Sensor devices"
	help
	  Say Y here, and a list of sensors drivers will be displayed.
	  Everything that didn't fit into the other categories is here. This option
	  doesn't affect the kernel.
	  If unsure, say Y.

config SENSORS_FPRINT_SECURE
	tristate "fingerprint sensor support"
	default n
	help
	  If you say yes here you get support for Trustzone.
	  In case of user binary, fingerprint sensor operates within trustzone.
	  If this feature enabled, spi communication is controlled by Trusted Application.
	  Then it should be enabled in the user binary.

config SENSORS_QBT2000
	tristate "QBT2000 fingerprint sensor support"
	default n
	help
	  If you say yes here you get support for Qualcomm's
	  fingerprint sensor QBT2000.

config SENSORS_ET5XX
	tristate "ET5XX fingerprint sensor supprot"
	default n
	help
	  Fingerprint sensor driver.
	  If you say yes here you get support for ET5XX sensor.
	  ET5XX is the touch type fingerprint sensor.
	  ET5XX module can support WOF mode.
```

## drivers/five/five_tee_driver/Kconfig
```kconfig
#
# TEE Driver configuration
#

config FIVE_TEE_DRIVER
    bool "Integrity TEE Driver"
    depends on FIVE
    default y
    ---help---
      Enable Integrity Trusted Execution Environment support

choice
    prompt "FIVE Secure OS"
    default FIVE_USE_TZDEV if TZDEV
    default FIVE_USE_TRUSTONIC
    ---help---
      Select Secure OS for FIVE TEE Driver

    config FIVE_USE_TRUSTONIC
        bool "Integrity TEE Driver based on Trustonic Secure OS"
        depends on TRUSTONIC_TEE
        ---help---
          Use Trustonic as base Trusted Execution Environment

    config FIVE_USE_TZDEV
        bool "Integrity TEE Driver based on TEEgris Secure OS"
        depends on TZDEV
        ---help---
          Use TEEgris as base Trusted Execution Environment
endchoice

config TEE_DRIVER_DEBUG
    bool "Integrity TEE Driver Debug mode"
    depends on FIVE_TEE_DRIVER
    default n
    ---help---
      Enable Debug mode in TEE Driver

config FIVE_TRUSTLET_PATH
    string "FIVE trustlet"
    depends on FIVE_USE_TRUSTONIC && FIRMWARE_IN_KERNEL
    default "five/ffffffff000000000000000000000072.tlbin"
    ---help---
      This option defines FIVE trustlet path which will be built-in kernel

config FIVE_EARLY_LOAD_TRUSTED_APP
    bool "Load trusted application in early boot"
    depends on FIVE_TEE_DRIVER
    default n
    help
      Enable the load of trusted application on during initialization of driver
```

## drivers/gpu/arm/Kconfig
```kconfig
#
# (C) COPYRIGHT 2012 ARM Limited. All rights reserved.
#
# This program is free software and is provided to you under the terms of the GNU General Public License version 2
# as published by the Free Software Foundation, and any use by you of this program is subject to the terms of such GNU licence.
#
# A copy of the licence is included with the program, and can also be obtained from Free Software
# Foundation, Inc., 51 Franklin Street, Fifth Floor, Boston, MA  02110-1301, USA.
#
#


menu "ARM GPU Configuration"

menuconfig MALI_DDK_VERSION
	tristate "Mali support"
	default y
	help
	  Enable this option to build support for the ARM Mali-T7xx GPU.

	  To compile this driver as a module, choose M here:
	  this will generate a single module, called mali_kbase.

choice
	prompt "version Configuration"
	depends on MALI_DDK_VERSION
	default MALI_BIFROST_R26P0 if ANDROID_VERSION >= "110000"
	default MALI_BIFROST_R19P0_Q if ANDROID_VERSION = "100000"
	default MALI_BIFROST_R16P0 if ANDROID_VERSION < "100000"
	help
	  Select the gpu support version.

config MALI_BIFROST_R10P0
	depends on MALI_DDK_VERSION
	bool "Bifrost r10p0 driver"

config MALI_BIFROST_R12P0
	depends on MALI_DDK_VERSION
	bool "Bifrost r12p0 driver"

config MALI_BIFROST_R14P0
	depends on MALI_DDK_VERSION
	bool "Bifrost r14p0 driver"

config MALI_BIFROST_R16P0
	depends on MALI_DDK_VERSION
	bool "Bifrost r16p0 driver"

config MALI_BIFROST_R19P0_Q
	depends on MALI_DDK_VERSION
	bool "Bifrost r19p0 driver for Android Q"

config MALI_BIFROST_R26P0
	depends on MALI_DDK_VERSION
	bool "Bifrost r26p0 driver for Android R"
endchoice

if MALI_BIFROST_R10P0
source "drivers/gpu/arm/b_r10p0/Kconfig"
endif

if MALI_BIFROST_R12P0
source "drivers/gpu/arm/b_r12p0/Kconfig"
endif

if MALI_BIFROST_R14P0
source "drivers/gpu/arm/b_r14p0/Kconfig"
endif

if MALI_BIFROST_R16P0
source "drivers/gpu/arm/b_r16p0/Kconfig"
endif

if MALI_BIFROST_R19P0_Q
source "drivers/gpu/arm/b_r19p0/Kconfig"
endif

if MALI_BIFROST_R26P0
source "drivers/gpu/arm/b_r26p0/Kconfig"
endif

endmenu
```

## drivers/gpu/arm/b_r10p0/platform/exynos/Kconfig
```kconfig
#
# (C) COPYRIGHT 2012 ARM Limited. All rights reserved.
#
# This program is free software and is provided to you under the terms of the
# GNU General Public License version 2 as published by the Free Software
# Foundation, and any use by you of this program is subject to the terms
# of such GNU licence.
#
# A copy of the licence is included with the program, and can also be obtained
# from Free Software Foundation, Inc., 51 Franklin Street, Fifth Floor,
# Boston, MA  02110-1301, USA.
#
#




# Add your platform specific Kconfig file here
#
# "drivers/gpu/arm/.../platform/Kconfig"
#
# Where xxx is the platform name is the name set in MALI_PLATFORM_THIRDPARTY_NAME
#
config EXYNOS_SOC_NAME
    depends on MALI_MIDGARD
    string "Third party soc name"
    help
      soc name.

# { SRUK-MALI_SYSTRACE_SUPPORT
config MALI_SYSTRACE_SUPPORT
    bool "Enable Exynos systrace Debug support"
    depends on MALI_MIDGARD
    default y
    help
      Enable systrace marker in kernel
# SRUK-MALI_SYSTRACE_SUPPORT }

config MALI_DVFS
    bool "Enable EXYNOS DVFS"
    depends on MALI_MIDGARD
    default y
    help
      Choose this option to enable DVFS in the Mali Midgard DDK.

config MALI_RT_PM
    bool "Enable EXYNOS Runtime power management"
    depends on MALI_MIDGARD
    depends on PM
    depends on EXYNOS_PD
    default y
    help
      Choose this option to enable runtime power management in the Mali Midgard DDK.

config MALI_EXYNOS_TRACE
    bool "Enable EXYNOS kbase tracing"
    depends on MALI_MIDGARD
    default y
    help
      Enables tracing in kbase.  Trace log available through
      the "mali_trace" debugfs file, when the CONFIG_DEBUG_FS is enabled

config MALI_DEBUG_SYS
    bool "Enable sysfs for the Mali Midgard DDK "
    depends on MALI_MIDGARD && SYSFS
    default y
    help
      Enables sysfs for the Mali Midgard DDK. Set/Monitor the Mali Midgard DDK

config MALI_SEC_CL_BOOST
    bool "Enable EXYNOS cl booster"
    depends on MALI_MIDGARD
    default n
    help
      Enables open cl dvfs booster.

config MALI_PM_QOS
    bool "Enable DVFS with QoS"
    depends on MALI_MIDGARD && MALI_DVFS && PM_DEVFREQ && CPU_FREQ
    default y
    help
      Choose this option to enable PM_QOS in the Mali tNOx DDK.

config MALI_BTS_OPTIMIZATION
    bool "Enable GPU BTS"
    depends on MALI_DVFS
    default n
    help
      Choose this option to enable BTS in the Mali tNOx DDK.

config MALI_DEBUG_KERNEL_SYSFS
       bool "Support Kernel Group Debug SysFS"
       depends on MALI_MIDGARD && MALI_DEBUG_SYS
       default y
       help
               Support Support Kernel Group Debug SysFS on /sys/kernel/gpu

config MALI_EXYNOS_SECURE_RENDERING
    bool "Enable EXYNOS Secure Rendering Support"
    depends on MALI_MIDGARD && ION_EXYNOS && EXYNOS_CONTENT_PATH_PROTECTION
    default n
    help
      Support Secure Rendering on Exynos SoC

config MALI_ASV_CALIBRATION_SUPPORT
	bool "Enable GPU ASV AUTO CALIBRATION"
	depends on MALI_MIDGARD && MALI_RT_PM && MALI_DVFS && VDD_AUTO_CAL
	default y
	help
	  Choose this option to enable AUTO_CALIBRATION_SUPPORT in the Mali tNOx DDK.

config MALI_VK_BOOST
	bool "Enable GPU VK JOB PMQOS BOOST"
	depends on MALI_MIDGARD && MALI_RT_PM && MALI_DVFS
	default y
	help
	  Choose this option to enable VK JOB PMQOS BOOST in the Mali tNOx DDK.

config MALI_SEC_JOB_STATUS_CHECK
	bool "Enable GPU JOB & FENCE STATUS DUMP"
	depends on MALI_MIDGARD && MALI_RT_PM && MALI_DVFS && (SYNC || SYNC_FILE)
	default n
	help
		Choose this option to enable job & fence status dump feature in the Mali tNOx DDK.
```
