## drivers/gpu/arm/b_r19p0/platform/exynos/Kconfig
```kconfig
#
# (C) COPYRIGHT 2012 ARM Limited. All rights reserved.
#
# This program is free software and is provided to you under the terms of the
# GNU General Public License version 2 as published by the Free Software
# Foundation, and any use by you of this program is subject to the terms
# of such GNU licence.
#
# A copy of the licence is included with the program, and can also be obtained
# from Free Software Foundation, Inc., 51 Franklin Street, Fifth Floor,
# Boston, MA  02110-1301, USA.
#
#




# Add your platform specific Kconfig file here
#
# "drivers/gpu/arm/.../platform/Kconfig"
#
# Where xxx is the platform name is the name set in MALI_PLATFORM_THIRDPARTY_NAME
#
config EXYNOS_SOC_NAME
    depends on MALI_MIDGARD
    string "Third party soc name"
    help
      soc name.

config MALI_DVFS
    bool "Enable EXYNOS DVFS"
    default y
    help
      Choose this option to enable DVFS in the Mali Midgard DDK.

config MALI_RT_PM
    bool "Enable EXYNOS Runtime power management"
    default y
    help
      Choose this option to enable runtime power management in the Mali Midgard DDK.

config MALI_EXYNOS_TRACE
    bool "Enable EXYNOS kbase tracing"
    depends on MALI_MIDGARD
    default y
    help
      Enables tracing in kbase.  Trace log available through
      the "mali_trace" debugfs file, when the CONFIG_DEBUG_FS is enabled

config MALI_DEBUG_SYS
    bool "Enable sysfs for the Mali Midgard DDK "
    depends on MALI_MIDGARD && SYSFS
    default y
    help
      Enables sysfs for the Mali Midgard DDK. Set/Monitor the Mali Midgard DDK

config MALI_SEC_CL_BOOST
    bool "Enable EXYNOS cl booster"
    default y
    help
      Enables open cl dvfs booster.

config MALI_PM_QOS
    bool "Enable DVFS with QoS"
    default y
    help
      Choose this option to enable PM_QOS in the Mali tTRx DDK.

config MALI_BTS_OPTIMIZATION
    bool "Enable GPU BTS"
    depends on MALI_DVFS
    default n
    help
      Choose this option to enable BTS in the Mali tTRx DDK.

config MALI_DEBUG_KERNEL_SYSFS
    bool "Support Kernel Group Debug SysFS"
    depends on MALI_MIDGARD && MALI_DEBUG_SYS
    default y
    help
		Support Support Kernel Group Debug SysFS on /sys/kernel/gpu

config MALI_EXYNOS_SECURE_RENDERING
    bool "Enable EXYNOS Secure Rendering Support"
    depends on MALI_MIDGARD && ION_EXYNOS && EXYNOS_CONTENT_PATH_PROTECTION
    default n
    help
      Support Secure Rendering on Exynos SoC

config MALI_ASV_CALIBRATION_SUPPORT
	bool "Enable GPU ASV AUTO CALIBRATION"
	depends on MALI_MIDGARD && MALI_RT_PM && MALI_DVFS && VDD_AUTO_CAL
	default n
	help
	  Choose this option to enable AUTO_CALIBRATION_SUPPORT in the Mali tTRx DDK.

config MALI_SEC_VK_BOOST
	bool "Enable GPU VK JOB PMQOS BOOST"
	default y
	help
	  Choose this option to enable VK JOB PMQOS BOOST in the Mali tTRx DDK.

config MALI_SEC_JOB_STATUS_CHECK
	bool "Enable GPU JOB & FENCE STATUS DUMP"
	depends on MALI_MIDGARD && MALI_RT_PM && MALI_DVFS && (SYNC || SYNC_FILE)
	default n
	help
		Choose this option to enable job & fence status dump feature in the Mali tTRx DDK.

config MALI_SUSTAINABLE_OPT
	bool "Enable Sustainable optimize"
	depends on MALI_MIDGARD && MALI_RT_PM && MALI_DVFS
	default n
	help
		Choose this option to enable sustainable optimization in the Mali tTRx DDK.
```

## drivers/gpu/arm/exynos/Kconfig
```kconfig
#
# (C) COPYRIGHT 2021 Samsung Electronics Inc. All rights reserved.
#
# This program is free software and is provided to you under the terms of the
# GNU General Public License version 2 as published by the Free Software
# Foundation, and any use by you of this program is subject to the terms
# of such GNU licence.
#
# This program is distributed in the hope that it will be useful,
# but WITHOUT ANY WARRANTY; without even the implied warranty of
# MERCHANTABILITY or FITNESS FOR A PARTICULAR PURPOSE. See the
# GNU General Public License for more details.
#
# You should have received a copy of the GNU General Public License
# along with this program; if not, you can access it online at
# http://www.gnu.org/licenses/gpl-2.0.html.
#
# SPDX-License-Identifier: GPL-2.0
#
# /* SPDX-License-Identifier: GPL-2.0 */

config MALI_EXYNOS_CLOCK
    bool "Enable EXYNOS CLOCK"
    depends on MALI_MIDGARD && CAL_IF
    default y if SOC_EXYNOS9830
    default y if SOC_EXYNOS2100
    default y
    help
      Choose this option to enable frequency setting Mali DDK.

config MALI_EXYNOS_DVFS
    bool "Enable EXYNOS DVFS"
    depends on MALI_MIDGARD && MALI_EXYNOS_CLOCK
    default y if SOC_EXYNOS9830
    default y if SOC_EXYNOS2100
    default y
    help
      Choose this option to enable DVFS in the Mali Midgard DDK.

config MALI_DVFS
    bool "Enable EXYNOS DVFS"
    depends on MALI_MIDGARD && MALI_EXYNOS_DVFS
    default y
    help
      Choose this option to enable DVFS in the Mali Midgard DDK.

config MALI_EXYNOS_PM
    bool "Enable EXYNOS Power Management"
    depends on MALI_MIDGARD
    depends on PM
    depends on EXYNOS_PD
    default y if SOC_EXYNOS9830
    default y if SOC_EXYNOS2100
    default y
    help
      Choose this option to enable runtime power management in the Mali Midgard DDK.

config MALI_EXYNOS_RTPM
    bool "Enable EXYNOS Power Management"
    depends on MALI_EXYNOS_PM
    default y if SOC_EXYNOS9830
    default y if SOC_EXYNOS2100
    default y
    help
      Choose this option to enable runtime power management in the Mali Midgard DDK.

config MALI_EXYNOS_IFPO
    bool "Enable IFPO(Inter-Frame Power Off)"
    depends on MALI_MIDGARD && MALI_EXYNOS_PM && REGULATOR
    default y if SOC_EXYNOS9830
    default n
    help
      choose this option to enable IFPO Option in the Mali tBEx DDK.

config MALI_DEBUG_SYS
    bool "Enable sysfs for the Mali Midgard DDK "
    depends on MALI_MIDGARD && SYSFS
    default y
    help
      Enables sysfs for the Mali Midgard DDK. Set/Monitor the Mali Midgard DDK

config MALI_DEBUG_KERNEL_SYSFS
    bool "Support Kernel Group Debug SysFS"
    depends on MALI_MIDGARD && MALI_DEBUG_SYS
    default y
    help
      Support Support Kernel Group Debug SysFS on /sys/kernel/gpu

config MALI_EXYNOS_QOS
    bool "Enable CPU & MIF PMQOS from Mali"
    depends on MALI_MIDGARD && PM_DEVFREQ && CPU_FREQ
    default y if SOC_EXYNOS9830
    default y if SOC_EXYNOS2100
    default y
    help
      Choose this option to enable PM_QOS in the Mali tTRx DDK.

config MALI_EXYNOS_THERMAL
    bool "Enable Mali thermal throttling"
    depends on MALI_MIDGARD && MALI_EXYNOS_CLOCK && GPU_THERMAL
    default y if SOC_EXYNOS9830
    default y if SOC_EXYNOS2100
    default y
    help
      Choose this option to enable Mali thermal throttling

config MALI_EXYNOS_BTS_MO
    bool "Enable GPU BTS MO Optimization through PMQOS"
    depends on MALI_EXYNOS_QOS
    default y if SOC_EXYNOS9830
    default y if SOC_EXYNOS2100
    default y
    help
      Choose this option to enable BTS in the Mali tTRx DDK.

config MALI_EXYNOS_SECURE_RENDERING_ARM
    bool "Enable Secure Rendering support"
    depends on MALI_MIDGARD && EXYNOS_CONTENT_PATH_PROTECTION
    default y if SOC_EXYNOS9830
    default y if SOC_EXYNOS2100
    default n
    help
      Support Secure Rendering on Exynos SoC (New ARM method)

config MALI_EXYNOS_SECURE_RENDERING_LEGACY
    bool "Enable Secure Rendering support (Legacy mode)"
    depends on MALI_MIDGARD && EXYNOS_CONTENT_PATH_PROTECTION
    default y if SOC_EXYNOS9830
    default n
    help
      Support Secure Rendering on Exynos SoC (Legacy)

config MALI_EXYNOS_DEBUG
    bool "Enable Mali Exynos integration debug features"
    depends on MALI_MIDGARD
    depends on !KUNIT && !SEC_KUNIT
    default y if SOC_EXYNOS9830
    default y if SOC_EXYNOS2100
    default y
    help
      Mali Exynos integration debug features

config MALI_EXYNOS_DEVICETREE
    bool "Read GPU information from OF device tree"
    depends on MALI_MIDGARD && OF
    default y
    help
      Read GPU info from device tree

config MALI_EXYNOS_LLC
    bool "Allocate Last Level Cache for Mali"
    depends on MALI_MIDGARD && MALI_EXYNOS_QOS
    default n

config MALI_EXYNOS_CL_BOOST
    bool "Frequency boost for compute only jobs"
    depends on MALI_MIDGARD
    default y if SOC_EXYNOS9830
    default y if SOC_EXYNOS2100
    default y

config MALI_NOTIFY_UTILISATION
    bool "Added frag utilisation notifier"
    depends on MALI_MIDGARD
    depends on !KUNIT && !SEC_KUNIT
    default y if SOC_EXYNOS2100
    default n
    help
      Get Fragment Utilisation.

config MALI_EXYNOS_GTS
    bool "Exynos GPU Task Scheduler support"
    depends on MALI_MIDGARD && MALI_NOTIFY_UTILISATION
    default y if SOC_EXYNOS2100
    default n
    help
      Enable Exynos GPU Task Scheduler support

config MALI_TSG
    bool "Enable Sustainable optimize"
    depends on MALI_MIDGARD && MALI_EXYNOS_RTPM && MALI_EXYNOS_DVFS
    default y if SOC_EXYNOS9830
    default y if SOC_EXYNOS2100
    default n
    help
      Choose this option to enable integrated samsung governor in the Mali tBEx DDK.

config MALI_EXYNOS_SECURE_SMC_NOTIFY_GPU
    bool "Enable SMC Notify calls when GPU is Power up and down"
    depends on MALI_MIDGARD && EXYNOS_CONTENT_PATH_PROTECTION
    default n
    help
      Support SMC Notify calls when GPU is power up and down

config MALI_EXYNOS_WAKEUP_CLOCK_WA
    bool "Enable wakeup clock wa"
    depends on MALI_MIDGARD && MALI_EXYNOS_CLOCK
    default y if SOC_EXYNOS9830
    default n
    help
      Set GPU to middle dvfs clock before power off, and keep current clock
      and then it used as restore clock when power on if its higher than
      middle dvfs clock. middle dvfs clock here is NOT middle cpu clock.

config MALI_EXYNOS_BLOCK_RPM_WHILE_SUSPEND_RESUME
    bool "Block calling Runtime PM while suspend/resume"
    depends on MALI_EXYNOS_PM
    default n
    help
      Exynos kernel 4.19 less version not allow calling Runtime PM while suspend/resume.

# This 9830 WA config is used outside the DDK by EMS, so don't change it
config MALI_SEC_G3D_PEAK_NOTI
    bool "Enable GPU SEC_G3D_PEAK_NOTI"
    default y if SOC_EXYNOS9830
    default n
    help
      Choose this option to enable SEC_G3D_PEAK_NOTI in the Mali tTRx DDK.

# This is a legacy config that's unfortunately used by the other drivers... Need to find a better
# place to put this.
config EXYNOS_SOC_NAME
    depends on MALI_MIDGARD
    string "Third party soc name"
    help
      soc name.

config MALI_EXYNOS_UNIT_TESTS
    bool "Build unit tests for Mali Unified Driver vendor code"
    default n
    help
      Choose this option to build unit tests for Mali LSI vendor code
```

## drivers/gpu/exynos/Kconfig
```kconfig
config EXYNOS_HDR_TUNABLE_TONEMAPPING
	bool "HDR Tuneable debugfs nodes for Tone mapping"
	---help---
	  Creates hdr/tm_x and hdr/tm_y nodes under debugfs for overriding the
	  tone mapping LUT coefficients configured in G2D and DPU with the
	  values stored in the nodes. Configuring 33 integer values to both
	  nodes immediately replaces the tone mapping LUT coefficients used by
	  G2D and DPU. Writing 0 to one of both nodes stops overriding.

	  This is just for display tunning purpose only for HDR videos.

menu "Exynos Graphic Devices"
source "drivers/gpu/exynos/g2d/Kconfig"
endmenu
```

## drivers/gpu/exynos/g2d/Kconfig
```kconfig
config EXYNOS_GRAPHICS_G2D
	bool "FIMG2D support"
	select SYNC_FILE
	help
	  This enables FIMG2D driver of Exynos SoCs.
```

## drivers/ifconn/Kconfig
```kconfig
#
# IF Conn Manager driver
#

config IFCONN_MANAGER
    bool "IF Conn Manager driver"
	depends on I2C
	default n
	help
	  If you say yes here you will get support for
	  IF Conn Manager function.

config IFCONN_NOTIFIER
    bool "IF Conn Notifier driver"
	depends on I2C
	default n
    help
      If you say yes here you will get support for
      IF Conn Notifier function.

config IFCONN_SUPPORT_THREAD
    bool "IF Conn driver supports thread"
	depends on I2C
	default n
    help
      If you say yes here you will get support for
      IF Conn thread function.
      This makes the module concurrent.
      Take a module test when take this option.
```
