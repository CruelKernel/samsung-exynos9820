## Documentation/devicetree/bindings/extcon/extcon-madera.txt
```
Cirrus Logic Madera class audio codecs extcon driver

The extcon configuration settings are a child node of the parent MFD driver
binding.
See Documentation/devicetree/bindings/mfd/madera.txt

This node contains one or more child nodes to describe the configuration for
each accessory detect.

Mandatory properties:
  - compatible : must be "cirrus,madera-extcon"
  - #address-cells : must be 1
  - #size-cells : must be 0

Optional properties:
  - cirrus,gpsw : Settings for the general purpose switches, set as per the
    SWn_MODE bits in the GP Switch 1 register. If given must be 2 cells.
    First cell is the value for the SW1_MODE
    Second cell is the value for the SW2_MODE (cs47l90, cs47l91, cs47l92,
    cs47l93)

  - cirrus,micd-pol-gpios : GPIO specifier for the GPIO controlling the headset
    polarity if one exists. One cell for each child node.

Child node mandatory properties:
  - reg : output number this configuration applies to, must be 1

Child node optional properties:
  - cirrus,micd-detect-debounce-ms : Additional software microphone detection
    debounce specified in milliseconds

  - cirrus,micd-manual-debounce : Additional software button detection
    debounce specified as a number

  - cirrus,micd-bias-start-time : Time allowed for MICBIAS to startup prior to
    performing microphone detection, specified as per the MICD_BIAS_STARTTIME
    bits in the register MIC_DETECT_1

  - cirrus,micd-rate : Delay between successive microphone detection
    measurements, specified as per the MICD_RATE bits in the register
    MIC_DETECT_1

  - cirrus,micd-dbtime : Microphone detection hardware debounce level, specified
    as per the MICD_DBTIME bits in the register MIC_DETECT_1

  - cirrus,micd-timeout-ms : Timeout for microphone detection, specified in
    milliseconds

  - cirrus,micd-force-micbias : Force MICBIAS continuously on during microphone
    detection and button detection

  - cirrus,micd-software-compare : Use a software comparison to determine mic
    presence

  - cirrus,jd-invert : Invert the polarity of the jack detection switch

  - cirrus,jd-use-jd2 : Use JD2 input with JD1 for dual jack detection.

  - cirrus,fixed-hpdet-imp : Do not perform any headphone detection, just use
    the fixed value specified here as the headphone impedance. Value is in
    hundredths-of-an-ohm (ohms * 100)

  - cirrus,hpdet-ext-res : Impedance of external series resistor on hpdet.
    Value is in hundredths-of-an-ohm (ohms * 100)

  - cirrus,hpdet-short-circuit-imp : Specifies the maximum impedance in ohms
    that will be considered as a short circuit

  - cirrus,hpdet-channel : Set which channel is used for headphone impedance
    measurement. 0 = left, 1 = right

  - cirrus,micd-clamp-mode : Specifies the logic of the micdetect clamp block

  - cirrus,hpd-pins : 4 cells specifying the clamp and sense pins to use.
	<clamp_left sense_left clamp_right sense_right>
    where clamp_x is the clamp pin for channel x and sense_x is the impedance
    sense pin for channel x, as per the HPD_OUT_SEL field of HEADPHONE_DETECT_0
    register. A value >0xFFFF means use the default.
    (cs47l90, cs47l91)

  - cirrus,micd-ranges : Microphone detection level and key configuration, this
    field can be of variable length but should always be a multiple of 2 cells
    long, each two cell group represents one button configuration
    The first cell is the maximum impedance for this button in ohms
    The second cell the key that should be reported to the input layer

  - cirrus,micd-configs : Headset polarity configurations, variable length but
    must be a multiple of 5 cells, each 5-cell group represents one
    polarity configuration
    first cell is the value of
       ACCDET_SRC register field (CS47L15, CS47L35, CS47L85, WM1840),
       MICD_SENSE_SEL register field (all other codecs)
    second cell is the accessory detection ground as per the MICD_GND_SEL
      register field
    the third cell is the MICBIAS to be used as per the MICD_BIAS_SRC register
      field
    fourth cell is the value of the micd-pol-gpio pin, a non-zero value
      indicates this should be on
    fifth cell is
      set to zero (cs47l15, cs47l35, cs47l85, wm1840)
      value of HPn_GND_SEL register field (all other codecs)

  - cirrus,init-delay-ms : Add a delay after jack detection (in milliseconds)

  - cirrus,hs-mic: Specify an input to mute during headset button presses:
    1 - IN1L, 2 - IN1R, ..., n - IN[n]R

  - cirrus,moisture-pin : The pin on which the moisture detection should be
    run. For (cs47l35, cs47l85, wm1840) this should be set to
    MADERA_ACCDET_MODE_HPx, for (cs47l90, cs47l91, cs47l92, cs47l93) this
    should be set to MADERA_HPD_SENSE_x.
  - cirrus,moisture-imp : The impedance threshold above which a detection will
    be considered moisture rather than a valid jack detection.
  - cirrus,moisture-debounce :  The number of debounce measurements to perform
    on the moisture detection.

Example:

codec: cs47l85@0 {
	compatible = "cirrus,cs47l85";

	accdet {
		compatible = "cirrus,madera-extcon";
		#address-cells = <1>;
		#size-cells = <0>;

		cirrus,gpsw = <3 0>;

		cirrus,micd-pol-gpios = <&gpio 0>

		acc@1 {
			reg = <1>;

			cirrus,micd-detect-debounce-ms = <10>;
			cirrus,micd-bias-start-time = <0x1>;
			cirrus,micd-rate = <0x1>;
			cirrus,micd-dbtime = <0x1>;
			cirrus,micd-timeout-ms = <10>;
			cirrus,micd-force-micbias;
			cirrus,micd-ranges = <
				11 0x100
				28 0x101
				54 0x102
				100 0x103
				186 0x104
				430 0x105
			>;
			cirrus,micd-configs = <
				0x1 0 1 0 2
				0x0 0 2 1 2
			>;
		};
	};
};
```

## Documentation/devicetree/bindings/misc/cs40l20.txt
```
CS40L20/CS40L25/CS40L25A/CS40L25B Boosted Haptics Driver

Required properties:

  - compatible : One of "cirrus,cs40l20", "cirrus,cs40l25", "cirrus,cs40l25a"
    or "cirrus,cs40l25b".

  - reg : The I2C slave address of the device.

  - VA-supply, VP-supply : Regulators for the device's VA and VP supplies,
    respectively. See the following:
    Documentation/devicetree/bindings/regulator/regulator.txt

  - cirrus,boost-ind-nanohenry : Boost inductor value, expressed in nH. Valid
    values include 1000, 1200, 1500 and 2200.

  - cirrus,boost-cap-microfarad : Total equivalent boost capacitance on the VBST
    and VAMP pins, derated at 11 volts DC. The value must be rounded to the
    nearest integer and expressed in uF.

  - cirrus,boost-ipk-milliamp : Boost inductor peak current, expressed in mA.
    Valid values range from 1600 to 4500 (inclusive) in steps of 50.

Optional properties:

  - reset-gpios : GPIO used for resetting the device.

  - interrupt-parent : Single phandle representing the interrupt controller to
    which the /ALERT pin is connected (silicon revision B1 only).

  - interrupts : interrupt specifiers for the device (silicon revision B1 only).
    See the following:
    Documentation/devicetree/bindings/interrupt-controller/interrupts.txt

  - cirrus,refclk-gpio2 : Boolean for configuring the device to expect its
    32.768-kHz reference clock on the REFCLK/GPIO2 pin. If this property is
    omitted, the device expects its 32.768-kHz reference clock on the
    ASP_BCLK/REFCLK pin. This property is ignored for silicon revision B1 as
    reference clock selection is configured automatically in that case.

  - cirrus,f0-default : Default LRA resonant frequency (f0), expressed as
    follows: cirrus,f0-default = f0 (Hz) * 2^14. This value represents the
    frequency used during playback of PWLE segments specified with frequency
    equal to f0; it also serves as the unit-specific f0 input to the click
    compensation algorithm. It can be overwritten at a later time by writing
    to the f0_stored sysfs control.

    If this value is omitted or specified as zero, the measurement recorded in
    the f0_measured sysfs control is used. If LRA diagnostics has not been
    administered and f0_measured is uninitialized, 2621440 (160 Hz) is used.

  - cirrus,f0-min : Minimum LRA resonant frequency (f0) that may be written to
    the f0_stored sysfs control, expressed using the same numerical format as
    cirrus,f0-default. If this value is omitted or specified as zero, no lower-
    bound validation is performed.

  - cirrus,f0-max : Maximum LRA resonant frequency (f0) that may be written to
    the f0_stored sysfs control, expressed using the same numerical format as
    cirrus,f0-default. If this value is omitted or specified as zero, no upper-
    bound validation is performed.

  - cirrus,redc-default : Default LRA series resistance (ReDC), expressed as
    follows: cirrus,redc-default = ReDC (ohms) / 5.857 * 2^17. This value
    represents the unit-specific ReDC input to the click compensation algorithm.
    It can be overwritten at a later time by writing to the redc_stored sysfs
    control.

    If this value is omitted or specified as zero, the measurement recorded in
    the redc_measured sysfs control is used. If LRA diagnostics has not been
    administered and redc_measured is uninitialized, 340787 (15.2 ohms) is used.

  - cirrus,redc-min : Minimum LRA series resistance (ReDC) that may be written
    to the redc_stored sysfs control, expressed using the same numerical format
    as cirrus,redc-default. If this value is omitted or specified as zero, no
    lower-bound validation is performed.

  - cirrus,redc-max : Maximum LRA series resistance (ReDC) that may be written
    to the redc_stored sysfs control, expressed using the same numerical format
    as cirrus,redc-default. If this value is omitted or specified as zero, no
    upper-bound validation is performed.

  - cirrus,gpio1-rise-index : Specifies the wavetable index mapped to GPIO1
    rising edges. If this value is omitted, specified as zero or exceeds the
    maximum available index in the wavetable, GPIO1 rising edges are mapped to
    index 1.

  - cirrus,gpio1-fall-index : Specifies the wavetable index mapped to GPIO1
    falling edges. If this value is omitted, specified as zero or exceeds the
    maximum available index in the wavetable, GPIO1 falling edges are mapped to
    index 2.

  - cirrus,gpio1-fall-timeout : Specifies the number of 48-kHz periods for
    which the device remains in the active state in search of a GPIO1 falling
    edge, following a GPIO1 rising edge (the latter of which renders the device
    active). If a GPIO1 falling edge does not arrive within this timeout, the
    device automatically returns to the standby state and the subsequent GPIO1
    falling edge is ignored. If this value is omitted or exceeds the maximum
    timeout (8388607) then a default of 240000 is assumed (corresponding to
    240000 / 48000 = 5 seconds). If this value is specified as zero, the timeout
    is effectively disabled.

  - cirrus,gpio1-mode : Specifies the operating mode of the GPIO1 pin, equal to
    one of the following.

    0 = enabled by default
    1 = disabled by default
    2 = disabled by default, but automatically enabled and disabled upon suspend
        and resume, respectively

    If this value is omitted or given an invalid value, mode 0 (enabled by
    default) is assumed. Regardless of mode, the GPIO1 pin can be enabled or
    disabled at will from user space using the gpio1_enable sysfs control.

  - cirrus,hiber-enable : Boolean for instructing the device to enter and exit
    hibernation mode upon suspend and resume, respectively. Hibernation mode is
    supported by silicon revision B1 only. If this property is omitted, the
    device remains in standby and automatic entry into hibernation mode is
    effectively disabled.

Examples:

  cs40l20: cs40l20@43 {
    compatible = "cirrus,cs40l20";
    reg = <0x43>;
    reset-gpios = <&gpio0 54 0>;
    VA-supply = <&dummy_vreg>;
    VP-supply = <&dummy_vreg>;
    cirrus,boost-ind-nanohenry = <1000>;
    cirrus,boost-cap-microfarad = <4>;
    cirrus,boost-ipk-milliamp = <4500>;
    cirrus,refclk-gpio2;
  };

  cs40l25a: cs40l25a@43 {
    compatible = "cirrus,cs40l25a";
    reg = <0x43>;
    reset-gpios = <&gpio0 54 0>;
    interrupt-parent = <&gpio0>;
    interrupts = <55 8>;
    VA-supply = <&dummy_vreg>;
    VP-supply = <&dummy_vreg>;
    cirrus,boost-ind-nanohenry = <1000>;
    cirrus,boost-cap-microfarad = <4>;
    cirrus,boost-ipk-milliamp = <4500>;
  };
```

## Kconfig
```kconfig
# SPDX-License-Identifier: GPL-2.0
#
# For a description of the syntax of this configuration file,
# see Documentation/kbuild/kconfig-language.txt.
#
mainmenu "Linux/$ARCH $KERNELVERSION Kernel Configuration"

config SRCARCH
	string
	option env="SRCARCH"

config ANDROID_VERSION
	string
	option env="ANDROID_VERSION"

config ANDROID_MAJOR_VERSION
	string
	option env="ANDROID_MAJOR_VERSION"

source "arch/$SRCARCH/Kconfig"
```
