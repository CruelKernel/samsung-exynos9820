## drivers/input/Kconfig
```kconfig
#
# Input device configuration
#

menu "Input device support"
	depends on !UML

config INPUT
	tristate "Generic input layer (needed for keyboard, mouse, ...)" if EXPERT
	default y
	help
	  Say Y here if you have any input device (mouse, keyboard, tablet,
	  joystick, steering wheel ...) connected to your system and want
	  it to be available to applications. This includes standard PS/2
	  keyboard and mouse.

	  Say N here if you have a headless (no monitor, no keyboard) system.

	  More information is available: <file:Documentation/input/input.txt>

	  If unsure, say Y.

	  To compile this driver as a module, choose M here: the
	  module will be called input.

if INPUT

config INPUT_LEDS
	tristate "Export input device LEDs in sysfs"
	depends on LEDS_CLASS
	default INPUT
	help
	  Say Y here if you would like to export LEDs on input devices
	  as standard LED class devices in sysfs.

	  If unsure, say Y.

	  To compile this driver as a module, choose M here: the
	  module will be called input-leds.

config INPUT_FF_MEMLESS
	tristate "Support for memoryless force-feedback devices"
	help
	  Say Y here if you have memoryless force-feedback input device
	  such as Logitech WingMan Force 3D, ThrustMaster FireStorm Dual
	  Power 2, or similar. You will also need to enable hardware-specific
	  driver.

	  If unsure, say N.

	  To compile this driver as a module, choose M here: the
	  module will be called ff-memless.

config INPUT_POLLDEV
	tristate "Polled input device skeleton"
	help
	  Say Y here if you are using a driver for an input
	  device that periodically polls hardware state. This
	  option is only useful for out-of-tree drivers since
	  in-tree drivers select it automatically.

	  If unsure, say N.

	  To compile this driver as a module, choose M here: the
	  module will be called input-polldev.

config INPUT_SPARSEKMAP
	tristate "Sparse keymap support library"
	help
	  Say Y here if you are using a driver for an input
	  device that uses sparse keymap. This option is only
	  useful for out-of-tree drivers since in-tree drivers
	  select it automatically.

	  If unsure, say N.

	  To compile this driver as a module, choose M here: the
	  module will be called sparse-keymap.

config INPUT_MATRIXKMAP
	tristate "Matrix keymap support library"
	help
	  Say Y here if you are using a driver for an input
	  device that uses matrix keymap. This option is only
	  useful for out-of-tree drivers since in-tree drivers
	  select it automatically.

	  If unsure, say N.

	  To compile this driver as a module, choose M here: the
	  module will be called matrix-keymap.

comment "Userland interfaces"

config INPUT_MOUSEDEV
	tristate "Mouse interface"
	help
	  Say Y here if you want your mouse to be accessible as char devices
	  13:32+ - /dev/input/mouseX and 13:63 - /dev/input/mice as an
	  emulated IntelliMouse Explorer PS/2 mouse. That way, all user space
	  programs (including SVGAlib, GPM and X) will be able to use your
	  mouse.

	  If unsure, say Y.

	  To compile this driver as a module, choose M here: the
	  module will be called mousedev.

config INPUT_MOUSEDEV_PSAUX
	bool "Provide legacy /dev/psaux device"
	depends on INPUT_MOUSEDEV
	help
	  Say Y here if you want your mouse also be accessible as char device
	  10:1 - /dev/psaux. The data available through /dev/psaux is exactly
	  the same as the data from /dev/input/mice.

	  If unsure, say Y.

config INPUT_MOUSEDEV_SCREEN_X
	int "Horizontal screen resolution"
	depends on INPUT_MOUSEDEV
	default "1024"
	help
	  If you're using a digitizer, or a graphic tablet, and want to use
	  it as a mouse then the mousedev driver needs to know the X window
	  screen resolution you are using to correctly scale the data. If
	  you're not using a digitizer, this value is ignored.

config INPUT_MOUSEDEV_SCREEN_Y
	int "Vertical screen resolution"
	depends on INPUT_MOUSEDEV
	default "768"
	help
	  If you're using a digitizer, or a graphic tablet, and want to use
	  it as a mouse then the mousedev driver needs to know the X window
	  screen resolution you are using to correctly scale the data. If
	  you're not using a digitizer, this value is ignored.

config INPUT_JOYDEV
	tristate "Joystick interface"
	help
	  Say Y here if you want your joystick or gamepad to be
	  accessible as char device 13:0+ - /dev/input/jsX device.

	  If unsure, say Y.

	  More information is available: <file:Documentation/input/joystick.txt>

	  To compile this driver as a module, choose M here: the
	  module will be called joydev.

config INPUT_EVDEV
	tristate "Event interface"
	select SEC_INPUT_BOOSTER
	help
	  Say Y here if you want your input device events be accessible
	  under char device 13:64+ - /dev/input/eventX in a generic way.

	  To compile this driver as a module, choose M here: the
	  module will be called evdev.

config INPUT_EVBUG
	tristate "Event debugging"
	help
	  Say Y here if you have a problem with the input subsystem and
	  want all events (keypresses, mouse movements), to be output to
	  the system log. While this is useful for debugging, it's also
	  a security threat - your keypresses include your passwords, of
	  course.

	  If unsure, say N.

	  To compile this driver as a module, choose M here: the
	  module will be called evbug.

config INPUT_APMPOWER
	tristate "Input Power Event -> APM Bridge" if EXPERT
	depends on INPUT && APM_EMULATION
	help
	  Say Y here if you want suspend key events to trigger a user
	  requested suspend through APM. This is useful on embedded
	  systems where such behaviour is desired without userspace
	  interaction. If unsure, say N.

	  To compile this driver as a module, choose M here: the
	  module will be called apm-power.

config INPUT_KEYRESET
	bool "Reset key"
	depends on INPUT
	select INPUT_KEYCOMBO
	---help---
	  Say Y here if you want to reboot when some keys are pressed;

config INPUT_TOUCHSCREEN_TCLMV2
	bool "touchscreen tclmv2"
	depends on I2C
	help
	  Say Y here if you need to use tclm.

	  If unsure, say N.

config INPUT_KEYCOMBO
	bool "Key combo"
	depends on INPUT
	---help---
	  Say Y here if you want to take action when some keys are pressed;

config HALL
	tristate "Enable HALL IC"
	default n
	help
	  Say Y here if you want to enable Hall IC Feature
	  and send a event when cover state is changed.
	  Active gpio state is low and active event value is 0.

	  If unsure, say N.

config HALL_EVENT_REVERSE
	tristate "Adjusting the status value of HALL IC"
	default y
	depends on HALL
	depends on ANDROID_MAJOR_VERSION >= "q"
	help
	  Adjusting the status value of HALL IC.
	  This was required from input FW.

	  If unsure, say N.

config CERTIFY_HALL
	tristate "Enable CERTIFY HALL IC"
	default n
	help
	  Say Y here if you want to enable Certify Hall IC Feature and
	  send a event when cover is detected.
	  Active gpio state is low and active event value is 1.

	  If unsure, say N.

config HALL_NEW_NODE
	bool "Chang the node location of HALL IC"
	default y
	depends on HALL
	depends on ANDROID_MAJOR_VERSION >= "r"
	help
	  Say Y here if you want to change the location of hall ic node.
	  it was decided with the framework to be changed from R OS
	  The previous versions of R OS are created before the change.
	  If unsure, say N.

config SEC_AUTO_INPUT
	tristate "Samsung auto input"
	depends on !SAMSUNG_PRODUCT_SHIP
	default y
	help
	  Say Y here if you use auto input function.

	  If unsure, say N.

	  To compile this driver as a module, choose M here: the
	  module will be called autoinput.

config TOUCHSCREEN_DUMP_MODE
	bool "touchscreen dump mode"
	depends on I2C
	help
	  Say Y here if you need to get raw data.
	  
	  If unsure, say N.

config SEC_INPUT_BOOSTER
	bool "SEC INPUT BOOSTER"
	depends on INPUT_EVDEV
	default y
	help
	  Say Y here if you need to enable Input Booster.

	  It's triggered in evdev module.

comment "Input Device Drivers"

source "drivers/input/keyboard/Kconfig"

source "drivers/input/mouse/Kconfig"

source "drivers/input/joystick/Kconfig"

source "drivers/input/tablet/Kconfig"

source "drivers/input/touchscreen/Kconfig"

source "drivers/input/misc/Kconfig"

source "drivers/input/rmi4/Kconfig"

source "drivers/input/wacom/Kconfig"

endif

menu "Hardware I/O ports"

source "drivers/input/serio/Kconfig"

source "drivers/input/gameport/Kconfig"

endmenu

endmenu
```

## drivers/input/keyboard/stm/fsr1ad04/Kconfig
```kconfig
#
# Samsung Electronics KEY driver configuration
#

config KEYBOARD_STM_FSR
        tristate "Samsung Electronics Keyboard"
        depends on I2C
        help
          Say Y here if you want support for FSR key controllers.
          If unsure, say N.
```

## drivers/input/wacom/Kconfig
```kconfig
#
# Wacom configuration
#

config INPUT_WACOM
	tristate "Wacom penabled i2c touchscreen"
	depends on I2C
	help
	  Say Y here if you have an Wacom penabled i2c touchscreen
	  connected to your system.

	  If unsure, say N.

	  To compile this driver as a module, choose M here: the
	  module will be called wacom_GXXX.

config EPEN_WACOM_W9020
	tristate "Wacom W9020 penabled i2c touchscreen"
	depends on I2C
	help
	  Say Y here if you have an Wacom G10PM penabled i2c touchscreen
	  connected to your system.

	  If unsure, say N.

	  To compile this driver as a module, choose M here: the
	  module will be called wacom_W9020.
```

## drivers/kperfmon/Kconfig
```kconfig
# drivers/kperfmon/Kconfig
#
# Copyright (c) 2010-2011 Samsung Electronics Co., Ltd.
#		http://www.samsung.com/
#
# Licensed under GPLv2

config KPERFMON
	bool "Enable performance log"
	default n
	help
	  Samsung performance log(OLOG).
```

## drivers/mcps/Kconfig
```kconfig
#
# MCPS configuration
#
config MCPS
	bool "MCPS configuration"
	default m
	help
		It will improve RPS mechanism using A-RPS(Advanced RPS) .
		A-RPS allow available core to take a more network flow.

config MCPS_GRO_ENABLE
    bool "Enable GRO on MCPS"
    default y
    depends on MCPS=y
    help
        It will allow MCPS to enable Generic Receive Offload(GRO)

config MCPS_DEBUG_PRINTK
	int "MCPS Debugging printk"
	default 3
	depends on MCPS=y
	help
		It occur a printk at all time. It may be cause a sluggish.
		So It should be false on Device for sales or testing of performance.

config MQTCP_DEBUG_PRINTK
    bool "MQTCP Debugging printk"
    default n
    depends on MCPS=y
    help
        It occur a printk at all time. It may be cause a sluggish.
        So It should be false on Device for sales or testing of performance.

config MCPS_DEBUG_SYSTRACE
    bool "MCPS debugging systrace"
    default n
    depends on MCPS=y
    help
        Test...

config MCPS_DEBUG
    bool "MCPS debug dump"
    default y
    depends on MCPS=y
    help
        ....

config MCPS_CHUNK_GRO
    bool "MCPS one chunk one gro"
    default y
    depends on MCPS=y
    help
        ....

config MCPS_ICB
    bool "MCPS Initial Connection Booster"
    default n
    depends on MCPS=y && ARCH_EXYNOS
    help
        Improving initial TCP throughput by cpu frequency boosting and adaptive gro setting

config MCPS_V2
    bool "MCPS v2"
    default y
    depends on MCPS=y
    help
        The MCPS v2 adopts some of the GRO function chains.
        This allows more detailed operation of GRO and to lead GROed packets to ARPS after GRO flush.

config MCPS_GRO_PER_SESSION
    bool "MCPS gro per session"
    default y
    depends on MCPS=y
    help
        Determines the number of packets to be combined using GRO per session.

config MCPS_ICGB
    bool "MCPS Initial Connection GRO Booster"
    default y
    depends on MCPS=y && MCPS_GRO_PER_SESSION=y
    help
        Adjust GRO policy according to the features of the session to optimize the throughput of the session.
```

## drivers/media/platform/exynos/Kconfig
```kconfig
#
# Exynos multimedia device drivers
#
config VIDEO_EXYNOS
        bool "Exynos Multimedia Devices"
        depends on ARCH_EXYNOS
        default y
        help
          This is a representative exynos multimedia device.

if VIDEO_EXYNOS
        source "drivers/media/platform/exynos/mfc/Kconfig"
        source "drivers/media/platform/exynos/camera-pp/Kconfig"
        source "drivers/media/platform/exynos/repeater/Kconfig"
        source "drivers/media/platform/exynos/tsmux/Kconfig"
        source "drivers/media/platform/exynos/jsqz/Kconfig"
endif

config MEDIA_EXYNOS
        bool
        depends on VIDEO_EXYNOS
        default y
        help
          Compile mdev to use exynos media device driver.
```

## drivers/media/platform/exynos/camera-pp/Kconfig
```kconfig
#
# Exynos Camera PostProcessing IP device drivers
#
config VIDEO_EXYNOS_CAMERA_POSTPROCESS
		bool "Exynos Camera Post-Processing Devices"
		depends on VIDEO_EXYNOS
		select V4L2_MEM2MEM_DEV
		select MEDIA_M2M1SHOT
		select VIDEOBUF2_DMA_SG
		default n
		help
			This is a representative exynos Camera PostProcessing device.

source "drivers/media/platform/exynos/camera-pp/gdc/Kconfig"
source "drivers/media/platform/exynos/camera-pp/str/Kconfig"
```
